AUTOSAR XML (schema 00049)
package /SomeIpServiceInterfaceDeployment
  someip service interface deployment HashFunctionCtx_Someip: service-interface=HashFunctionCtx, service-interface-id=26, service-interface-version={major-version=0, minor-version=0}
    9 x someip method deployment, all with transport-protocol=UDP:
      Start: method=Start, method-id=1
      Update: method=Update, method-id=2
      Finish: method=Finish, method-id=3
      GetDigest: method=GetDigest, method-id=4
      GetDigestService: method=GetDigestService, method-id=5
      StartNP: method=StartNP, method-id=6
      StartSecretSeed: method=StartSecretSeed, method-id=7
      UpdateUint8: method=UpdateUint8, method-id=8
      UpdateRestrictedUseObject: method=UpdateRestrictedUseObject, method-id=9
