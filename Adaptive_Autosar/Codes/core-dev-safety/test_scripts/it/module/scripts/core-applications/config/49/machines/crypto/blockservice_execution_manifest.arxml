AUTOSAR XML (schema 00049)
package /ServiceInstanceToPortMapping
  service instance to port prototype mapping BlockServiceToPortPrototypeMapping: port-prototype=rootSwComponentPrototype.PPortBlockService, process-design=qt_crypto_instance1, process=qt_crypto_instance1, service-instance=BlockService
