AUTOSAR XML (schema 00048)
package /Processes
  process qt_driver_application: design=qt_driver_application, executable=qt_driver_application, state-dependent-startup-config{function-group-state=UcmMasterApplicationStates.Ucm_Master_Application1, resource-group=ResourceGroup, startup-config=qt_driver_application}
