AUTOSAR XML (schema 00049)
package /ServiceInterface
  service interface CryptoObject
    namespaces:
      4 x symbol props:
        qt
        crypto
        cryptoprovider_001
        cryptoobject
    methods:
      8 x operation:
        Downcast: possible-ap-error=[UndefinedApplicationError, BadObjectType]
          4 x arg:
            whichObject: type=uint8_t, direction=IN
            response: type=uint64_t, direction=OUT
            instanceId: type=uint8_t, direction=IN
            keyInstanceId: type=uint8_t, direction=IN
        GetCryptoPrimitiveId: possible-ap-error=UndefinedApplicationError
          4 x arg:
            response: type=uint32_t, direction=OUT
            whichObject: type=uint8_t, direction=IN
            instanceId: type=uint8_t, direction=IN
            cryptoPrimitiveObjectId: type=uint8_t, direction=IN
        GetObjectId: possible-ap-error=UndefinedApplicationError
          arg response: type=CryptoObjectIdentifier, direction=OUT
          arg whichObject: type=uint8_t, direction=IN
          arg instanceId: type=uint8_t, direction=IN
        GetPayloadSize: possible-ap-error=UndefinedApplicationError
          arg response: type=uint64_t, direction=OUT
          arg whichObject: type=uint8_t, direction=IN
          arg instanceId: type=uint8_t, direction=IN
        HasDependence: possible-ap-error=UndefinedApplicationError
          arg response: type=CryptoObjectIdentifier, direction=OUT
          arg whichObject: type=uint8_t, direction=IN
          arg instanceId: type=uint8_t, direction=IN
        IsExportable: possible-ap-error=UndefinedApplicationError
          arg response: type=uint64_t, direction=OUT
          arg whichObject: type=uint8_t, direction=IN
          arg instanceId: type=uint8_t, direction=IN
        IsSession: possible-ap-error=UndefinedApplicationError
          arg response: type=uint64_t, direction=OUT
          arg whichObject: type=uint8_t, direction=IN
          arg instanceId: type=uint8_t, direction=IN
        Save: possible-ap-error=[UndefinedApplicationError, IncompatibleObject, ContentRestrictions, InsufficientCapacity, ModifiedResource, UnreservedResource]
          arg response: type=uint64_t, direction=OUT
          arg whichObject: type=uint8_t, direction=IN
          arg instanceId: type=uint8_t, direction=IN
