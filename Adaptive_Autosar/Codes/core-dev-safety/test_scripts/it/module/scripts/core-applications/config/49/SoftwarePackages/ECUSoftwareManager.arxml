AUTOSAR XML (schema 00049)
package /arPackage
  software cluster Swcl_TransferExit_0006: category=SWCL, claimed-function-group=FunctionGroupSet_190/FuncGroup, conflicts-to=operator=LOGICAL-AND, depends-on=operator=LOGICAL-OR, design=SwClusterDesign, software-cluster-doip-diagnostic-address{address-semantics=FUNCTIONAL-ADDRESS, diagnostic-address=17473}, license=AVIN, release-notes=InitialApplication, type-approval=2018/858, vendor-id=1447315780, version=1.0.0.0
  software package sw_pkg_TransferExit_0006: category=TestPackage, action-type=INSTALL, compressed-software-package-size=524288, maximum-supported-ucm-version=1.4.0.2, minimum-supported-ucm-version=1.0.0.0, packager-id=1347111236, software-cluster=Swcl_TransferExit_0006, uncompressed-software-cluster-size=655360
  software cluster SoftwareCluster_A: design=SwClusterDesign_A, version=1.0.0.0
  software cluster SoftwareCluster_B: design=SwClusterDesign_B
  software cluster design SwClusterDesign
  software cluster design SwClusterDesign_A
  software cluster design SwClusterDesign_B
  mode declaration group UCMPackageManagerStates_190
    mode on
    mode off
    mode Verify
  10 x software cluster, all with category=SWCL, conflicts-to=operator=LOGICAL-AND, design=SwClusterDesign, software-cluster-doip-diagnostic-address{address-semantics=FUNCTIONAL-ADDRESS, diagnostic-address=17473}, license=AVIN, release-notes=InitialApplication, type-approval=2018/858, vendor-id=1447315780, version=1.0.0.0:
    Swcl_Activate_0003: claimed-function-group=FunctionGroupSet_257_107_025_002/FuncGroup, depends-on=operator=LOGICAL-OR
    Swcl_UpdateRequest_0001: claimed-function-group=FunctionGroupSet_258/FuncGroup, depends-on=operator=LOGICAL-OR
    Swcl_Activate_0004: claimed-function-group=FunctionGroupSet_26_152_0084_002/FuncGroup, depends-on={operator=LOGICAL-OR, parts=software-cluster-dependency-compare-condition={compare-type=IS-EQUAL, software-cluster=SoftwareCluster_A, version=1.0.0.0}}
    Swcl_Activate_0005: claimed-function-group=FunctionGroupSet_242/FuncGroup, depends-on=operator=LOGICAL-OR
    Swcl_GetSwClusterDescription_001: claimed-function-group=FunctionGroupSet_185/FuncGroup, depends-on=operator=LOGICAL-OR
    Swcl_Activate_0006: claimed-function-group=FunctionGroupSet_263/FuncGroup, depends-on=operator=LOGICAL-OR
    Swcl_Activate_0007: claimed-function-group=FunctionGroupSet_085/FuncGroup, depends-on=operator=LOGICAL-OR
    Swcl_TransferExit_0007: claimed-function-group=FunctionGroupSet_213/FuncGroup, depends-on=operator=LOGICAL-OR
    Swcl_RevertProcessesSwPackages_0003: claimed-function-group=FunctionGroupSet_236/FuncGroup, depends-on=operator=LOGICAL-OR
    Swcl_ProcessSwPackage_0007: claimed-function-group=FunctionGroupSet_230/FuncGroup, depends-on=operator=LOGICAL-OR
  10 x software package, all with category=TestPackage, action-type=INSTALL, compressed-software-package-size=524288, maximum-supported-ucm-version=1.4.0.2, minimum-supported-ucm-version=1.0.0.0, packager-id=1347111236, uncompressed-software-cluster-size=655360:
    sw_pkg_Activate_0003: software-cluster=Swcl_Activate_0003
    sw_pkg_UpdateRequest_0001: software-cluster=Swcl_UpdateRequest_0001
    sw_pkg_Activate_0005: software-cluster=Swcl_Activate_0005
    sw_pkg_GetSwClusterDescription_001: software-cluster=Swcl_GetSwClusterDescription_001
    sw_pkg_TransferExit_0007: software-cluster=Swcl_TransferExit_0007
    sw_pkg_ProcessSwPackage_0007: software-cluster=Swcl_ProcessSwPackage_0007
    sw_pkg_RevertProcessesSwPackages_0003: software-cluster=Swcl_RevertProcessesSwPackages_0003
    sw_pkg_Activate_0007: software-cluster=Swcl_Activate_0007
    sw_pkg_Activate_0004: software-cluster=Swcl_Activate_0004
    sw_pkg_Activate_0006: software-cluster=Swcl_Activate_0006
  function group set FunctionGroupSet_190
    function-groups:
      mode declaration group prototype FuncGroup: type=UCMPackageManagerStates_190
  documentation InitialApplication
  documentation AVIN
  10 x mode declaration group:
    UCMPackageManagerStates_185
      mode on
      mode off
      mode Verify
    UCMPackageManagerStates_263
      mode on
      mode off
      mode Verify
    UCMPackageManagerStates_213
      mode on
      mode off
      mode Verify
    UCMPackageManagerStates_230
      mode on
      mode off
      mode Verify
    UCMPackageManagerStates_257_107_025_002
      mode on
      mode off
      mode Verify
    UCMPackageManagerStates_258
      mode on
      mode off
      mode Verify
    UCMPackageManagerStates_26_152_0084_002
      mode on
      mode off
      mode Verify
    UCMPackageManagerStates_242
      mode on
      mode off
      mode Verify
    UCMPackageManagerStates_085
      mode on
      mode off
      mode Verify
    UCMPackageManagerStates_236
      mode on
      mode off
      mode Verify
  10 x function group set:
    FunctionGroupSet_26_152_0084_002
      function-groups:
        mode declaration group prototype FuncGroup: type=UCMPackageManagerStates_26_152_0084_002
    FunctionGroupSet_257_107_025_002
      function-groups:
        mode declaration group prototype FuncGroup: type=UCMPackageManagerStates_257_107_025_002
    FunctionGroupSet_258
      function-groups:
        mode declaration group prototype FuncGroup: type=UCMPackageManagerStates_258
    FunctionGroupSet_085
      function-groups:
        mode declaration group prototype FuncGroup: type=UCMPackageManagerStates_085
    FunctionGroupSet_236
      function-groups:
        mode declaration group prototype FuncGroup: type=UCMPackageManagerStates_236
    FunctionGroupSet_185
      function-groups:
        mode declaration group prototype FuncGroup: type=UCMPackageManagerStates_185
    FunctionGroupSet_263
      function-groups:
        mode declaration group prototype FuncGroup: type=UCMPackageManagerStates_263
    FunctionGroupSet_242
      function-groups:
        mode declaration group prototype FuncGroup: type=UCMPackageManagerStates_242
    FunctionGroupSet_230
      function-groups:
        mode declaration group prototype FuncGroup: type=UCMPackageManagerStates_230
    FunctionGroupSet_213
      function-groups:
        mode declaration group prototype FuncGroup: type=UCMPackageManagerStates_213
  software cluster Swcl_Install_0001: category=SWCL, claimed-function-group=FunctionGroupSet_Install_0001/FuncGroup, conflicts-to=operator=LOGICAL-AND, depends-on=operator=LOGICAL-OR, design=SwClusterDesign, software-cluster-doip-diagnostic-address{address-semantics=FUNCTIONAL-ADDRESS, diagnostic-address=17473}, license=AVIN, release-notes=InitialApplication, type-approval=2018/858, vendor-id=1447315780, version=1.0.0.0
  function group set FunctionGroupSet_Install_0001
    function-groups:
      mode declaration group prototype FuncGroup: type=UCMPackageManagerStates_Instal_001
  mode declaration group UCMPackageManagerStates_Instal_001
    mode on
    mode off
    mode Verify
  software package sw_pkg_Install_0001: category=TestPackage, action-type=INSTALL, compressed-software-package-size=524288, maximum-supported-ucm-version=1.4.0.2, minimum-supported-ucm-version=1.0.0.0, packager-id=1347111236, software-cluster=Swcl_Install_0001, uncompressed-software-cluster-size=655360
  mode declaration group UCMPackageManagerStates_TransferStart_0001
    mode on
    mode off
    mode Verify
  function group set FunctionGroupSet_TransferStart_0001
    function-groups:
      mode declaration group prototype FuncGroup: type=UCMPackageManagerStates_TransferStart_0001
  software cluster Swcl_TransferStart_0001: category=SWCL, claimed-function-group=FunctionGroupSet_TransferStart_0001/FuncGroup, conflicts-to=operator=LOGICAL-AND, depends-on=operator=LOGICAL-OR, design=SwClusterDesign, software-cluster-doip-diagnostic-address{address-semantics=FUNCTIONAL-ADDRESS, diagnostic-address=17473}, license=AVIN, release-notes=InitialApplication, type-approval=2018/858, vendor-id=1447315780, version=1.0.0.0
  software package sw_pkg_TransferStart_0001: category=TestPackage, action-type=INSTALL, compressed-software-package-size=524288, maximum-supported-ucm-version=1.4.0.2, minimum-supported-ucm-version=1.0.0.0, packager-id=1347111236, software-cluster=Swcl_TransferStart_0001, uncompressed-software-cluster-size=655360
  mode declaration group UCMPackageManagerStates_TransferData_0001
    mode on
    mode off
    mode Verify
  function group set FunctionGroupSet_TransferData_0001
    function-groups:
      mode declaration group prototype functionGroups1: type=UCMPackageManagerStates_TransferData_0001
  software cluster swcl_TransferData_0001: category=SWCL, claimed-function-group=FunctionGroupSet_TransferData_0001/functionGroups1, conflicts-to=operator=LOGICAL-AND, depends-on=operator=LOGICAL-OR, design=SwClusterDesign, software-cluster-doip-diagnostic-address{address-semantics=FUNCTIONAL-ADDRESS, diagnostic-address=17473}, license=AVIN, release-notes=InitialApplication, type-approval=2018/858, vendor-id=1447315780, version=1.0.0.0
  software package sw_pkg_TransferData_0001: category=TestPackage, action-type=INSTALL, compressed-software-package-size=524288, maximum-supported-ucm-version=1.4.0.2, minimum-supported-ucm-version=1.0.0.0, packager-id=1347111236, software-cluster=swcl_TransferData_0001, uncompressed-software-cluster-size=655360
  mode declaration group UCMPackageManagerStates_TransferData_0002
    mode on
    mode off
    mode Verify
  function group set FunctionGroupSet_TransferData_0002
    function-groups:
      mode declaration group prototype functionGroups1: type=UCMPackageManagerStates_TransferData_0002
  software cluster Swcl_TransferData_0002: category=SWCL, claimed-function-group=FunctionGroupSet_TransferData_0002/functionGroups1, conflicts-to=operator=LOGICAL-AND, depends-on=operator=LOGICAL-OR, design=SwClusterDesign, software-cluster-doip-diagnostic-address{address-semantics=FUNCTIONAL-ADDRESS, diagnostic-address=17473}, license=AVIN, release-notes=InitialApplication, type-approval=2018/858, vendor-id=1447315780, version=1.0.0.0
  software package sw_pkg_TransferData_0002: category=TestPackage, action-type=INSTALL, compressed-software-package-size=524288, maximum-supported-ucm-version=1.4.0.2, minimum-supported-ucm-version=1.0.0.0, packager-id=1347111236, software-cluster=Swcl_TransferData_0002, uncompressed-software-cluster-size=655360
  mode declaration group UCMPackageManagerStates_TransferData_0003
    mode on
    mode off
    mode Verify
  function group set FunctionGroupSet_TransferData_0003
    function-groups:
      mode declaration group prototype functionGroups1: type=UCMPackageManagerStates_TransferData_0003
  mode declaration group UCMPackageManagerStates_TransferData_0004
    mode on
    mode off
    mode Verify
  function group set FunctionGroupSet_TransferData_0004
    function-groups:
      mode declaration group prototype functionGroups1: type=UCMPackageManagerStates_TransferData_0004
  software cluster Swcl_TransferData_0003: category=SWCL, claimed-function-group=FunctionGroupSet_TransferData_0003/functionGroups1, conflicts-to=operator=LOGICAL-AND, depends-on=operator=LOGICAL-OR, design=SwClusterDesign, software-cluster-doip-diagnostic-address{address-semantics=FUNCTIONAL-ADDRESS, diagnostic-address=17473}, license=AVIN, release-notes=InitialApplication, type-approval=2018/858, vendor-id=1447315780, version=1.0.0.0
  software cluster Swcl_TransferData_0004: category=SWCL, claimed-function-group=FunctionGroupSet_TransferData_0004/functionGroups1, conflicts-to=operator=LOGICAL-AND, depends-on=operator=LOGICAL-OR, design=SwClusterDesign, software-cluster-doip-diagnostic-address{address-semantics=FUNCTIONAL-ADDRESS, diagnostic-address=17473}, license=AVIN, release-notes=InitialApplication, type-approval=2018/858, vendor-id=1447315780, version=1.0.0.0
  software package sw_pkg_TransferData_0003: category=TestPackage, action-type=INSTALL, compressed-software-package-size=524288, maximum-supported-ucm-version=1.4.0.2, minimum-supported-ucm-version=1.0.0.0, packager-id=1347111236, software-cluster=Swcl_TransferData_0003, uncompressed-software-cluster-size=655360
  software package sw_pkg_TransferData_0004: category=TestPackage, action-type=INSTALL, compressed-software-package-size=524288, maximum-supported-ucm-version=1.4.0.2, minimum-supported-ucm-version=1.0.0.0, packager-id=1347111236, software-cluster=Swcl_TransferData_0004, uncompressed-software-cluster-size=655360
  mode declaration group UCMPackageManagerStates_TransferData_0005
    mode on
    mode off
    mode Verify
  function group set FunctionGroupSet_TransferData_0005
    function-groups:
      mode declaration group prototype functionGroups1: type=UCMPackageManagerStates_TransferData_0005
  software cluster Swcl_TransferData_0005: category=SWCL, claimed-function-group=FunctionGroupSet_TransferData_0005/functionGroups1, conflicts-to=operator=LOGICAL-AND, depends-on=operator=LOGICAL-OR, design=SwClusterDesign, software-cluster-doip-diagnostic-address{address-semantics=FUNCTIONAL-ADDRESS, diagnostic-address=17473}, license=AVIN, release-notes=InitialApplication, type-approval=2018/858, vendor-id=1447315780, version=1.0.0.0
  software package sw_pkg_TransferData_0005: category=TestPackage, action-type=INSTALL, compressed-software-package-size=524288, maximum-supported-ucm-version=2.4.0.2, minimum-supported-ucm-version=2.0.0.0, packager-id=1347111236, software-cluster=Swcl_TransferData_0005, uncompressed-software-cluster-size=655360
  mode declaration group UCMPackageManagerStates_TransferData_0006
    mode on
    mode off
    mode Verify
  function group set FunctionGroupSet_TransferData_0006
    function-groups:
      mode declaration group prototype functionGroups1: type=UCMPackageManagerStates_TransferData_0006
  software cluster Swcl_TransferData_0006: category=SWCL, claimed-function-group=FunctionGroupSet_TransferData_0006/functionGroups1, conflicts-to=operator=LOGICAL-AND, depends-on=operator=LOGICAL-OR, design=SwClusterDesign, software-cluster-doip-diagnostic-address{address-semantics=FUNCTIONAL-ADDRESS, diagnostic-address=17473}, license=AVIN, release-notes=InitialApplication, type-approval=2018/858, vendor-id=1447315780, version=1.0.0.0
  software package sw_pkg_TransferData_0006: category=TestPackage, action-type=INSTALL, compressed-software-package-size=524288, maximum-supported-ucm-version=1.4.0.2, minimum-supported-ucm-version=1.0.0.0, packager-id=1347111236, software-cluster=Swcl_TransferData_0006, uncompressed-software-cluster-size=655360
  mode declaration group UCMPackageManagerStates_TransferData_0008
    mode on
    mode off
    mode Verify
  function group set FunctionGroupSet_TransferData_0008
    function-groups:
      mode declaration group prototype functionGroups1: type=UCMPackageManagerStates_TransferData_0008
  software cluster Swcl_TransferData_0008: category=SWCL, claimed-function-group=FunctionGroupSet_TransferData_0008/functionGroups1, conflicts-to=operator=LOGICAL-AND, depends-on=operator=LOGICAL-OR, design=SwClusterDesign, software-cluster-doip-diagnostic-address{address-semantics=FUNCTIONAL-ADDRESS, diagnostic-address=17473}, license=AVIN, release-notes=InitialApplication, type-approval=2018/858, vendor-id=1447315780, version=1.0.0.0
  software package sw_pkg_TransferData_0008: category=TestPackage, action-type=INSTALL, compressed-software-package-size=524288, maximum-supported-ucm-version=1.4.0.2, minimum-supported-ucm-version=1.0.0.0, packager-id=1347111236, software-cluster=Swcl_TransferData_0008, uncompressed-software-cluster-size=655360
  mode declaration group UCMPackageManagerStates_TransferData_0009
    mode on
    mode off
    mode Verify
  function group set FunctionGroupSet_TransferData_0009
    function-groups:
      mode declaration group prototype functionGroups1: type=UCMPackageManagerStates_TransferData_0009
  software cluster Swcl_TransferData_0009: category=SWCL, claimed-function-group=FunctionGroupSet_TransferData_0009/functionGroups1, conflicts-to=operator=LOGICAL-AND, depends-on=operator=LOGICAL-OR, design=SwClusterDesign, software-cluster-doip-diagnostic-address{address-semantics=FUNCTIONAL-ADDRESS, diagnostic-address=17473}, license=AVIN, release-notes=InitialApplication, type-approval=2018/858, vendor-id=1447315780, version=1.0.0.0
  software package sw_pkg_TransferData_0009: category=TestPackage, action-type=INSTALL, compressed-software-package-size=524288, maximum-supported-ucm-version=1.4.0.2, minimum-supported-ucm-version=1.0.0.0, packager-id=1347111236, software-cluster=Swcl_TransferData_0009, uncompressed-software-cluster-size=655360
  function group set FunctionGroupSet_TransferData_0011
    function-groups:
      mode declaration group prototype functionGroups1: type=UCMPackageManagerStates_TransferData_0011
  mode declaration group UCMPackageManagerStates_TransferData_0011
    mode on
    mode off
    mode Verify
  software cluster Swcl_TransferData_0011: category=SWCL, claimed-function-group=FunctionGroupSet_TransferData_0011/functionGroups1, conflicts-to=operator=LOGICAL-AND, depends-on=operator=LOGICAL-OR, design=SwClusterDesign, software-cluster-doip-diagnostic-address{address-semantics=FUNCTIONAL-ADDRESS, diagnostic-address=17473}, license=AVIN, release-notes=InitialApplication, type-approval=2018/858, vendor-id=1447315780, version=3.0.0.0
  software package sw_pkg_TransferData_0011: category=TestPackage, action-type=INSTALL, compressed-software-package-size=524288, maximum-supported-ucm-version=2.0.0.0, minimum-supported-ucm-version=1.0.0.0, packager-id=1347111236, software-cluster=Swcl_TransferData_0011, uncompressed-software-cluster-size=655360
  function group set FunctionGroupSet_TransferData_0012
    function-groups:
      mode declaration group prototype functionGroups1: type=UCMPackageManagerStates_TransferData_0012
  mode declaration group UCMPackageManagerStates_TransferData_0012
    mode on
    mode off
    mode Verify
  software cluster Swcl_TransferData_0012: category=SWCL, claimed-function-group=FunctionGroupSet_TransferData_0012/functionGroups1, conflicts-to=operator=LOGICAL-AND, depends-on=operator=LOGICAL-OR, design=SwClusterDesign, software-cluster-doip-diagnostic-address{address-semantics=FUNCTIONAL-ADDRESS, diagnostic-address=17473}, license=AVIN, release-notes=InitialApplication, type-approval=2018/858, vendor-id=1447315780, version=1.0.
  software package sw_pkg_TransferData_0012: category=TestPackage, action-type=INSTALL, compressed-software-package-size=524288, maximum-supported-ucm-version=3.0.0.0, minimum-supported-ucm-version=1.0.0.0, packager-id=1347111236, software-cluster=Swcl_TransferData_0012, uncompressed-software-cluster-size=655360
  mode declaration group UCMPackageManagerStates_TransferData_0013
    mode on
    mode off
    mode Verify
  function group set FunctionGroupSet_TransferData_0013
    function-groups:
      mode declaration group prototype functionGroups1: type=UCMPackageManagerStates_TransferData_0013
  software cluster Swcl_TransferData_0013: category=SWCL, claimed-function-group=FunctionGroupSet_TransferData_0013/functionGroups1, conflicts-to=operator=LOGICAL-AND, depends-on=operator=LOGICAL-OR, design=SwClusterDesign, software-cluster-doip-diagnostic-address{address-semantics=FUNCTIONAL-ADDRESS, diagnostic-address=17473}, license=AVIN, release-notes=InitialApplication, type-approval=2018/858, vendor-id=1447315780, version=1.0.0.0
  software package sw_pkg_TransferData_0013: category=TestPackage, action-type=INSTALL, compressed-software-package-size=524288, maximum-supported-ucm-version=3.0.0.0, minimum-supported-ucm-version=1.0.0.0, packager-id=1347111236, software-cluster=Swcl_TransferData_0013, uncompressed-software-cluster-size=655360
  mode declaration group UCMPackageManagerStates_TransferExit_0001
    mode on
    mode off
    mode Verify
  function group set FunctionGroupSet_TransferExit_0001
    function-groups:
      mode declaration group prototype functionGroups1: type=UCMPackageManagerStates_TransferExit_0001
  software cluster Swcl_TransferExit_0001: category=SWCL, claimed-function-group=FunctionGroupSet_TransferExit_0001/functionGroups1, conflicts-to=operator=LOGICAL-AND, depends-on=operator=LOGICAL-OR, design=SwClusterDesign, software-cluster-doip-diagnostic-address{address-semantics=FUNCTIONAL-ADDRESS, diagnostic-address=17473}, license=AVIN, release-notes=InitialApplication, type-approval=2018/858, vendor-id=1447315780, version=1.0.0.0
  software package sw_pkg_TransferExit_0001: category=TestPackage, action-type=INSTALL, compressed-software-package-size=524288, maximum-supported-ucm-version=3.0.0.0, minimum-supported-ucm-version=1.0.0.0, packager-id=1347111236, software-cluster=Swcl_TransferExit_0001, uncompressed-software-cluster-size=655360
  mode declaration group UCMPackageManagerStates_TransferExit_0002
    mode on
    mode off
    mode Verify
  function group set FunctionGroupSet_TransferExit_0002
    function-groups:
      mode declaration group prototype functionGroups1: type=UCMPackageManagerStates_TransferExit_0002
  software cluster Swcl_TransferExit_0002: category=SWCL, claimed-function-group=FunctionGroupSet_TransferExit_0002/functionGroups1, conflicts-to=operator=LOGICAL-AND, depends-on=operator=LOGICAL-OR, design=SwClusterDesign, software-cluster-doip-diagnostic-address{address-semantics=FUNCTIONAL-ADDRESS, diagnostic-address=17473}, license=AVIN, release-notes=InitialApplication, type-approval=2018/858, vendor-id=1447315780, version=1.0.0.0
  software package sw_pkg_TransferExit_0002: category=TestPackage, action-type=INSTALL, compressed-software-package-size=524288, maximum-supported-ucm-version=3.0.0.0, minimum-supported-ucm-version=1.0.0.0, packager-id=1347111236, software-cluster=Swcl_TransferExit_0002, uncompressed-software-cluster-size=655360
  mode declaration group UCMPackageManagerStates_TransferExit_0003
    mode on
    mode off
    mode Verify
  function group set FunctionGroupSet_TransferExit_0003
    function-groups:
      mode declaration group prototype functionGroups1: type=UCMPackageManagerStates_TransferExit_0003
  software cluster Swcl_TransferExit_0003: category=SWCL, claimed-function-group=FunctionGroupSet_TransferExit_0003/functionGroups1, conflicts-to=operator=LOGICAL-AND, depends-on=operator=LOGICAL-OR, design=SwClusterDesign, software-cluster-doip-diagnostic-address{address-semantics=FUNCTIONAL-ADDRESS, diagnostic-address=17473}, license=AVIN, release-notes=InitialApplication, type-approval=2018/858, vendor-id=1447315780, version=1.0.0.0
  software package sw_pkg_TransferExit_0003: category=TestPackage, action-type=INSTALL, compressed-software-package-size=524288, maximum-supported-ucm-version=3.0.0.0, minimum-supported-ucm-version=1.0.0.0, packager-id=1347111236, software-cluster=Swcl_TransferExit_0003, uncompressed-software-cluster-size=655360
  mode declaration group UCMPackageManagerStates_TransferExit_0004
    mode on
    mode off
    mode Verify
  function group set FunctionGroupSet_TransferExit_0004
    function-groups:
      mode declaration group prototype functionGroups1: type=UCMPackageManagerStates_TransferExit_0004
  software cluster Swcl_TransferExit_0004: category=SWCL, claimed-function-group=FunctionGroupSet_TransferExit_0004/functionGroups1, conflicts-to=operator=LOGICAL-AND, depends-on=operator=LOGICAL-OR, design=SwClusterDesign, software-cluster-doip-diagnostic-address{address-semantics=FUNCTIONAL-ADDRESS, diagnostic-address=17473}, license=AVIN, release-notes=InitialApplication, type-approval=2018/858, vendor-id=1447315780, version=1.0.0.0
  software package sw_pkg_TransferExit_0004: category=TestPackage, action-type=INSTALL, compressed-software-package-size=524288, maximum-supported-ucm-version=3.0.0.0, minimum-supported-ucm-version=1.0.0.0, packager-id=1347111236, software-cluster=Swcl_TransferExit_0004, uncompressed-software-cluster-size=655360
  mode declaration group UCMPackageManagerStates_DeleteTransfer_0001
    mode on
    mode off
    mode Verify
  function group set FunctionGroupSet_DeleteTransfer_0001
    function-groups:
      mode declaration group prototype functionGroups1: type=UCMPackageManagerStates_DeleteTransfer_0001
  software cluster Swcl_DeleteTransfer_0001: category=SWCL, claimed-function-group=FunctionGroupSet_DeleteTransfer_0001/functionGroups1, conflicts-to=operator=LOGICAL-AND, depends-on=operator=LOGICAL-OR, design=SwClusterDesign, software-cluster-doip-diagnostic-address{address-semantics=FUNCTIONAL-ADDRESS, diagnostic-address=17473}, license=AVIN, release-notes=InitialApplication, type-approval=2018/858, vendor-id=1447315780, version=1.0.0.0
  software package sw_pkg_DeleteTransfer_0001: category=TestPackage, action-type=INSTALL, compressed-software-package-size=524288, maximum-supported-ucm-version=3.0.0.0, minimum-supported-ucm-version=1.0.0.0, packager-id=1347111236, software-cluster=Swcl_DeleteTransfer_0001, uncompressed-software-cluster-size=655360
  mode declaration group UCMPackageManagerStates_DeleteTransfer_0002
    mode on
    mode off
    mode Verify
  function group set FunctionGroupSet_DeleteTransfer_0002
    function-groups:
      mode declaration group prototype functionGroups1: type=UCMPackageManagerStates_DeleteTransfer_0002
  software cluster Swcl_DeleteTransfer_0002: category=SWCL, claimed-function-group=FunctionGroupSet_DeleteTransfer_0002/functionGroups1, conflicts-to=operator=LOGICAL-AND, depends-on=operator=LOGICAL-OR, design=SwClusterDesign, software-cluster-doip-diagnostic-address{address-semantics=FUNCTIONAL-ADDRESS, diagnostic-address=17473}, license=AVIN, release-notes=InitialApplication, type-approval=2018/858, vendor-id=1447315780, version=1.0.0.0
  software package sw_pkg_DeleteTransfer_0002: category=TestPackage, action-type=INSTALL, compressed-software-package-size=524288, maximum-supported-ucm-version=3.0.0.0, minimum-supported-ucm-version=1.0.0.0, packager-id=1347111236, software-cluster=Swcl_DeleteTransfer_0002, uncompressed-software-cluster-size=655360
  mode declaration group UCMPackageManagerStates_Cancel_0001
    mode on
    mode off
    mode Verify
  mode declaration group UCMPackageManagerStates_Cancel_0002
    mode on
    mode off
    mode Verify
  mode declaration group UCMPackageManagerStates_Cancel_0003
    mode on
    mode off
    mode Verify
  function group set FunctionGroupSet_Cancel_0001
    function-groups:
      mode declaration group prototype functionGroups1: type=UCMPackageManagerStates_Cancel_0001
  function group set FunctionGroupSet_Cancel_0003
    function-groups:
      mode declaration group prototype functionGroups1: type=UCMPackageManagerStates_Cancel_0003
  function group set FunctionGroupSet_Cancel_0002
    function-groups:
      mode declaration group prototype functionGroups1: type=UCMPackageManagerStates_Cancel_0002
  software cluster Swcl_Cancel_0003: category=SWCL, claimed-function-group=FunctionGroupSet_Cancel_0003/functionGroups1, conflicts-to=operator=LOGICAL-AND, depends-on=operator=LOGICAL-OR, design=SwClusterDesign, software-cluster-doip-diagnostic-address{address-semantics=FUNCTIONAL-ADDRESS, diagnostic-address=17473}, license=AVIN, release-notes=InitialApplication, type-approval=2018/858, vendor-id=1447315780, version=1.0.0.0
  software cluster Swcl_Cancel_0002: category=SWCL, claimed-function-group=FunctionGroupSet_Cancel_0002/functionGroups1, conflicts-to=operator=LOGICAL-AND, depends-on=operator=LOGICAL-OR, design=SwClusterDesign, software-cluster-doip-diagnostic-address{address-semantics=FUNCTIONAL-ADDRESS, diagnostic-address=17473}, license=AVIN, release-notes=InitialApplication, type-approval=2018/858, vendor-id=1447315780, version=1.0.0.0
  software cluster Swcl_Cancel_0001: category=SWCL, claimed-function-group=FunctionGroupSet_Cancel_0001/functionGroups1, conflicts-to=operator=LOGICAL-AND, depends-on=operator=LOGICAL-OR, design=SwClusterDesign, software-cluster-doip-diagnostic-address{address-semantics=FUNCTIONAL-ADDRESS, diagnostic-address=17473}, license=AVIN, release-notes=InitialApplication, type-approval=2018/858, vendor-id=1447315780, version=1.0.0.0
  software package sw_pkg_Cancel_0003: category=TestPackage, action-type=INSTALL, compressed-software-package-size=524288, maximum-supported-ucm-version=3.0.0.0, minimum-supported-ucm-version=1.0.0.0, packager-id=1347111236, software-cluster=Swcl_Cancel_0003, uncompressed-software-cluster-size=655360
  software package sw_pkg_Cancel_0001: category=TestPackage, action-type=INSTALL, compressed-software-package-size=524288, maximum-supported-ucm-version=3.0.0.0, minimum-supported-ucm-version=1.0.0.0, packager-id=1347111236, software-cluster=Swcl_Cancel_0001, uncompressed-software-cluster-size=655360
  software package sw_pkg_Cancel_0002: category=TestPackage, action-type=INSTALL, compressed-software-package-size=524288, maximum-supported-ucm-version=3.0.0.0, minimum-supported-ucm-version=1.0.0.0, packager-id=1347111236, software-cluster=Swcl_Cancel_0002, uncompressed-software-cluster-size=655360
  mode declaration group UCMPackageManagerStates_ProcessSwPackage_0001
    mode on
    mode off
    mode Verify
  mode declaration group UCMPackageManagerStates_ProcessSwPackage_0002
    mode on
    mode off
    mode Verify
  mode declaration group UCMPackageManagerStates_ProcessSwPackage_0003
    mode on
    mode off
    mode Verify
  function group set FunctionGroupSet_ProcessSwPackage_0003
    function-groups:
      mode declaration group prototype functionGroups1: type=UCMPackageManagerStates_ProcessSwPackage_0003
  function group set FunctionGroupSet_ProcessSwPackage_0002
    function-groups:
      mode declaration group prototype functionGroups1: type=UCMPackageManagerStates_ProcessSwPackage_0002
  function group set FunctionGroupSet_ProcessSwPackage_0001
    function-groups:
      mode declaration group prototype functionGroups1: type=UCMPackageManagerStates_ProcessSwPackage_0001
  software cluster Swcl_ProcessSwPackage_0003: category=SWCL, claimed-function-group=FunctionGroupSet_ProcessSwPackage_0003/functionGroups1, conflicts-to=operator=LOGICAL-AND, depends-on=operator=LOGICAL-OR, design=SwClusterDesign, software-cluster-doip-diagnostic-address{address-semantics=FUNCTIONAL-ADDRESS, diagnostic-address=17473}, license=AVIN, release-notes=InitialApplication, type-approval=2018/858, vendor-id=1447315780, version=1.0.0.0
  software cluster Swcl_ProcessSwPackage_0002: category=SWCL, claimed-function-group=FunctionGroupSet_ProcessSwPackage_0002/functionGroups1, conflicts-to=operator=LOGICAL-AND, depends-on=operator=LOGICAL-OR, design=SwClusterDesign, software-cluster-doip-diagnostic-address{address-semantics=FUNCTIONAL-ADDRESS, diagnostic-address=17473}, license=AVIN, release-notes=InitialApplication, type-approval=2018/858, vendor-id=1447315780, version=1.0.0.0
  software cluster Swcl_ProcessSwPackage_0001: category=SWCL, claimed-function-group=FunctionGroupSet_ProcessSwPackage_0001/functionGroups1, conflicts-to=operator=LOGICAL-AND, depends-on=operator=LOGICAL-OR, design=SwClusterDesign, software-cluster-doip-diagnostic-address{address-semantics=FUNCTIONAL-ADDRESS, diagnostic-address=17473}, license=AVIN, release-notes=InitialApplication, type-approval=2018/858, vendor-id=1447315780, version=1.0.0.0
  software package sw_pkg_ProcessSwPackage_{0001..0003}: category=TestPackage, action-type=INSTALL, compressed-software-package-size=524288, maximum-supported-ucm-version=3.0.0.0, minimum-supported-ucm-version=1.0.0.0, packager-id=1347111236, software-cluster=Swcl_ProcessSwPackage_{0001..0003}, uncompressed-software-cluster-size=655360
  mode declaration group UCMPackageManagerStates_ProcessSwPackage_0004
    mode on
    mode off
    mode Verify
  mode declaration group UCMPackageManagerStates_ProcessSwPackage_0005
    mode on
    mode off
    mode Verify
  mode declaration group UCMPackageManagerStates_ProcessSwPackage_0006
    mode on
    mode off
    mode Verify
  function group set FunctionGroupSet_ProcessSwPackage_0006
    function-groups:
      mode declaration group prototype functionGroups1: type=UCMPackageManagerStates_ProcessSwPackage_0006
  function group set FunctionGroupSet_ProcessSwPackage_0005
    function-groups:
      mode declaration group prototype functionGroups1: type=UCMPackageManagerStates_ProcessSwPackage_0005
  function group set FunctionGroupSet_ProcessSwPackage_0004
    function-groups:
      mode declaration group prototype functionGroups1: type=UCMPackageManagerStates_ProcessSwPackage_0004
  software cluster Swcl_ProcessSwPackage_0004: category=SWCL, claimed-function-group=FunctionGroupSet_ProcessSwPackage_0004/functionGroups1, conflicts-to=operator=LOGICAL-AND, depends-on=operator=LOGICAL-OR, design=SwClusterDesign, software-cluster-doip-diagnostic-address{address-semantics=FUNCTIONAL-ADDRESS, diagnostic-address=17473}, license=AVIN, release-notes=InitialApplication, type-approval=2018/858, vendor-id=1447315780, version=1.0.0.0
  software cluster Swcl_ProcessSwPackage_0006: category=SWCL, claimed-function-group=FunctionGroupSet_ProcessSwPackage_0006/functionGroups1, conflicts-to=operator=LOGICAL-AND, depends-on=operator=LOGICAL-OR, design=SwClusterDesign, software-cluster-doip-diagnostic-address{address-semantics=FUNCTIONAL-ADDRESS, diagnostic-address=17473}, license=AVIN, release-notes=InitialApplication, type-approval=2018/858, vendor-id=1447315780, version=1.0.0.0
  software cluster Swcl_ProcessSwPackage_0005: category=SWCL, claimed-function-group=FunctionGroupSet_ProcessSwPackage_0005/functionGroups1, conflicts-to=operator=LOGICAL-AND, depends-on=operator=LOGICAL-OR, design=SwClusterDesign, software-cluster-doip-diagnostic-address{address-semantics=FUNCTIONAL-ADDRESS, diagnostic-address=17473}, license=AVIN, release-notes=InitialApplication, type-approval=2018/858, vendor-id=1447315780, version=1.0.0.0
  software package sw_pkg_ProcessSwPackage_0006: category=TestPackage, action-type=REMOVE, compressed-software-package-size=524288, maximum-supported-ucm-version=3.0.0.0, minimum-supported-ucm-version=1.0.0.0, packager-id=1347111236, software-cluster=Swcl_ProcessSwPackage_0006, uncompressed-software-cluster-size=655360
  software package sw_pkg_ProcessSwPackage_0004: category=TestPackage, action-type=UPDATE, compressed-software-package-size=524288, maximum-supported-ucm-version=3.0.0.0, minimum-supported-ucm-version=1.0.0.0, packager-id=1347111236, software-cluster=Swcl_ProcessSwPackage_0004, uncompressed-software-cluster-size=655360
  software package sw_pkg_ProcessSwPackage_0005: category=TestPackage, action-type=INSTALL, compressed-software-package-size=524288, maximum-supported-ucm-version=3.0.0.0, minimum-supported-ucm-version=1.0.0.0, packager-id=1347111236, software-cluster=Swcl_ProcessSwPackage_0005, uncompressed-software-cluster-size=655360
  mode declaration group UCMPackageManagerStates_RevertProcessedSwPackages_0002
    mode on
    mode off
    mode Verify
  mode declaration group UCMPackageManagerStates_RevertProcessedSwPackages_0003
    mode on
    mode off
    mode Verify
  mode declaration group UCMPackageManagerStates_RevertProcessedSwPackages_0001
    mode on
    mode off
    mode Verify
  function group set FunctionGroupSet_RevertProcessedSwPackages_0003
    function-groups:
      mode declaration group prototype functionGroups1: type=UCMPackageManagerStates_RevertProcessedSwPackages_0003
  function group set FunctionGroupSet_RevertProcessedSwPackages_0002
    function-groups:
      mode declaration group prototype functionGroups1: type=UCMPackageManagerStates_RevertProcessedSwPackages_0002
  function group set FunctionGroupSet_RevertProcessedSwPackages_0001
    function-groups:
      mode declaration group prototype functionGroups1: type=UCMPackageManagerStates_RevertProcessedSwPackages_0001
  software package sw_pkg_GetSwPackages_0001: category=TestPackage, action-type=INSTALL, compressed-software-package-size=524288, maximum-supported-ucm-version=3.0.0.0, minimum-supported-ucm-version=1.0.0.0, packager-id=1347111236, software-cluster=Swcl_GetSwPackages_0001, uncompressed-software-cluster-size=655360
  software package sw_pkg_RevertProcessedSwPackages_0001: category=TestPackage, action-type=INSTALL, compressed-software-package-size=524288, maximum-supported-ucm-version=3.0.0.0, minimum-supported-ucm-version=1.0.0.0, packager-id=1347111236, software-cluster=Swcl_RevertProcessedSwPackages_0001, uncompressed-software-cluster-size=655360
  software package sw_pkg_RevertProcessedSwPackages_0002: category=TestPackage, action-type=INSTALL, compressed-software-package-size=524288, maximum-supported-ucm-version=3.0.0.0, minimum-supported-ucm-version=1.0.0.0, packager-id=1347111236, software-cluster=Swcl_RevertProcessedSwPackages_0002, uncompressed-software-cluster-size=655360
  software cluster Swcl_RevertProcessedSwPackages_0002: category=SWCL, claimed-function-group=FunctionGroupSet_RevertProcessedSwPackages_0002/functionGroups1, conflicts-to=operator=LOGICAL-AND, depends-on=operator=LOGICAL-OR, design=SwClusterDesign, software-cluster-doip-diagnostic-address{address-semantics=FUNCTIONAL-ADDRESS, diagnostic-address=17473}, license=AVIN, release-notes=InitialApplication, type-approval=2018/858, vendor-id=1447315780, version=1.0.0.0
  software cluster Swcl_RevertProcessedSwPackages_0001: category=SWCL, claimed-function-group=FunctionGroupSet_RevertProcessedSwPackages_0001/functionGroups1, conflicts-to=operator=LOGICAL-AND, depends-on=operator=LOGICAL-OR, design=SwClusterDesign, software-cluster-doip-diagnostic-address{address-semantics=FUNCTIONAL-ADDRESS, diagnostic-address=17473}, license=AVIN, release-notes=InitialApplication, type-approval=2018/858, vendor-id=1447315780, version=1.0.0.0
  mode declaration group UCMPackageManagerStates_GetSwPackages_0001
    mode on
    mode off
    mode Verify
  mode declaration group UCMPackageManagerStates_GetSwPackages_0002
    mode on
    mode off
    mode Verify
  function group set FunctionGroupSet_GetSwPackages_0002
    function-groups:
      mode declaration group prototype functionGroups1: type=UCMPackageManagerStates_GetSwPackages_0002
  function group set FunctionGroupSet_GetSwPackages_0001
    function-groups:
      mode declaration group prototype functionGroups1: type=UCMPackageManagerStates_GetSwPackages_0001
  software cluster Swcl_GetSwPackages_0002: category=SWCL, claimed-function-group=FunctionGroupSet_GetSwPackages_0002/functionGroups1, conflicts-to=operator=LOGICAL-AND, depends-on=operator=LOGICAL-OR, design=SwClusterDesign, software-cluster-doip-diagnostic-address{address-semantics=FUNCTIONAL-ADDRESS, diagnostic-address=17473}, license=AVIN, release-notes=InitialApplication, type-approval=2018/858, vendor-id=1447315780, version=1.0.0.0
  software cluster Swcl_GetSwPackages_0001: category=SWCL, claimed-function-group=FunctionGroupSet_GetSwPackages_0001/functionGroups1, conflicts-to=operator=LOGICAL-AND, depends-on=operator=LOGICAL-OR, design=SwClusterDesign, software-cluster-doip-diagnostic-address{address-semantics=FUNCTIONAL-ADDRESS, diagnostic-address=17473}, license=AVIN, release-notes=InitialApplication, type-approval=2018/858, vendor-id=1447315780, version=1.0.0.0
  software package sw_pkg_GetSwPackages_0002: category=TestPackage, action-type=INSTALL, compressed-software-package-size=524288, maximum-supported-ucm-version=3.0.0.0, minimum-supported-ucm-version=1.0.0.0, packager-id=1347111236, software-cluster=Swcl_GetSwPackages_0002, uncompressed-software-cluster-size=655360
  mode declaration group UCMPackageManagerStates_GetSwProcessProgress_0002
    mode on
    mode off
    mode Verify
  mode declaration group UCMPackageManagerStates_GetSwProcessProgress_0001
    mode on
    mode off
    mode Verify
  function group set FunctionGroupSet_GetSwProcessProgress_0002
    function-groups:
      mode declaration group prototype functionGroups1: type=UCMPackageManagerStates_GetSwProcessProgress_0002
  function group set FunctionGroupSet_GetSwProcessProgress_0001
    function-groups:
      mode declaration group prototype functionGroups1: type=UCMPackageManagerStates_GetSwProcessProgress_0001
  software cluster Swcl_GetSwProcessProgress_0001: category=SWCL, claimed-function-group=FunctionGroupSet_GetSwProcessProgress_0001/functionGroups1, conflicts-to=operator=LOGICAL-AND, depends-on=operator=LOGICAL-OR, design=SwClusterDesign, software-cluster-doip-diagnostic-address{address-semantics=FUNCTIONAL-ADDRESS, diagnostic-address=17473}, license=AVIN, release-notes=InitialApplication, type-approval=2018/858, vendor-id=1447315780, version=1.0.0.0
  software cluster Swcl_GetSwProcessProgress_0002: category=SWCL, claimed-function-group=FunctionGroupSet_GetSwProcessProgress_0002/functionGroups1, conflicts-to=operator=LOGICAL-AND, depends-on=operator=LOGICAL-OR, design=SwClusterDesign, software-cluster-doip-diagnostic-address{address-semantics=FUNCTIONAL-ADDRESS, diagnostic-address=17473}, license=AVIN, release-notes=InitialApplication, type-approval=2018/858, vendor-id=1447315780, version=1.0.0.0
  software package sw_pkg_GetSwProcessProgress_0002: category=TestPackage, action-type=INSTALL, compressed-software-package-size=524288, maximum-supported-ucm-version=3.0.0.0, minimum-supported-ucm-version=1.0.0.0, packager-id=1347111236, software-cluster=Swcl_GetSwProcessProgress_0002, uncompressed-software-cluster-size=655360
  software package sw_pkg_GetSwProcessProgress_0001: category=TestPackage, action-type=INSTALL, compressed-software-package-size=524288, maximum-supported-ucm-version=3.0.0.0, minimum-supported-ucm-version=1.0.0.0, packager-id=1347111236, software-cluster=Swcl_GetSwProcessProgress_0001, uncompressed-software-cluster-size=655360
  mode declaration group UCMPackageManagerStates_Activate_0001
    mode on
    mode off
    mode Verify
  mode declaration group UCMPackageManagerStates_Activate_0002
    mode on
    mode off
    mode Verify
  function group set FunctionGroupSet_Activate_0002
    function-groups:
      mode declaration group prototype functionGroups1: type=UCMPackageManagerStates_Activate_0002
  function group set FunctionGroupSet_Activate_0001
    function-groups:
      mode declaration group prototype functionGroups1: type=UCMPackageManagerStates_Activate_0001
  software cluster Swcl_Activate_0002: category=SWCL, claimed-function-group=FunctionGroupSet_Activate_0002/functionGroups1, conflicts-to=operator=LOGICAL-AND, depends-on=operator=LOGICAL-OR, design=SwClusterDesign, software-cluster-doip-diagnostic-address{address-semantics=FUNCTIONAL-ADDRESS, diagnostic-address=17473}, license=AVIN, release-notes=InitialApplication, type-approval=2018/858, vendor-id=1447315780, version=1.0.0.0
  software cluster Swcl_Activate_0001: category=SWCL, claimed-function-group=FunctionGroupSet_Activate_0001/functionGroups1, conflicts-to=operator=LOGICAL-AND, depends-on=operator=LOGICAL-OR, design=SwClusterDesign, software-cluster-doip-diagnostic-address{address-semantics=FUNCTIONAL-ADDRESS, diagnostic-address=17473}, license=AVIN, release-notes=InitialApplication, type-approval=2018/858, vendor-id=1447315780, version=1.0.0.0
  software package sw_pkg_Activate_0001: category=TestPackage, action-type=INSTALL, compressed-software-package-size=524288, maximum-supported-ucm-version=3.0.0.0, minimum-supported-ucm-version=1.0.0.0, packager-id=1347111236, software-cluster=Swcl_Activate_0001, uncompressed-software-cluster-size=655360
  software package sw_pkg_Activate_0002: category=TestPackage, action-type=INSTALL, compressed-software-package-size=524288, maximum-supported-ucm-version=3.0.0.0, minimum-supported-ucm-version=1.0.0.0, packager-id=1347111236, software-cluster=Swcl_Activate_0002, uncompressed-software-cluster-size=655360
  mode declaration group UCMPackageManagerStates_Rollback_0001
    mode on
    mode off
    mode Verify
  function group set FunctionGroupSet_Rollback_0001
    function-groups:
      mode declaration group prototype functionGroups1: type=UCMPackageManagerStates_Rollback_0001
  software cluster Swcl_Rollback_0001: category=SWCL, claimed-function-group=FunctionGroupSet_Rollback_0001/functionGroups1, conflicts-to=operator=LOGICAL-AND, depends-on=operator=LOGICAL-OR, design=SwClusterDesign, software-cluster-doip-diagnostic-address{address-semantics=FUNCTIONAL-ADDRESS, diagnostic-address=17473}, license=AVIN, release-notes=InitialApplication, type-approval=2018/858, vendor-id=1447315780, version=1.0.0.0
  software package sw_pkg_Rollback_0001: category=TestPackage, action-type=INSTALL, compressed-software-package-size=524288, maximum-supported-ucm-version=3.0.0.0, minimum-supported-ucm-version=1.0.0.0, packager-id=1347111236, software-cluster=Swcl_Rollback_0001, uncompressed-software-cluster-size=655360
  mode declaration group UCMPackageManagerStates_Finish_0001
    mode on
    mode off
    mode Verify
  function group set FunctionGroupSet_Finish_0001
    function-groups:
      mode declaration group prototype functionGroups1: type=UCMPackageManagerStates_Finish_0001
  software cluster Swcl_Finish_0001: category=SWCL, claimed-function-group=FunctionGroupSet_Finish_0001/functionGroups1, conflicts-to=operator=LOGICAL-AND, depends-on=operator=LOGICAL-OR, design=SwClusterDesign, software-cluster-doip-diagnostic-address{address-semantics=FUNCTIONAL-ADDRESS, diagnostic-address=17473}, license=AVIN, release-notes=InitialApplication, type-approval=2018/858, vendor-id=1447315780, version=1.0.0.0
  software package sw_pkg_Finish_0001: category=TestPackage, action-type=INSTALL, compressed-software-package-size=524288, maximum-supported-ucm-version=3.0.0.0, minimum-supported-ucm-version=1.0.0.0, packager-id=1347111236, software-cluster=Swcl_Finish_0001, uncompressed-software-cluster-size=655360
  4 x mode declaration group:
    UCMPackageManagerStates_StatusReporting_0003
      mode on
      mode off
      mode Verify
    UCMPackageManagerStates_StatusReporting_0004
      mode on
      mode off
      mode Verify
    UCMPackageManagerStates_StatusReporting_0001
      mode on
      mode off
      mode Verify
    UCMPackageManagerStates_StatusReporting_0002
      mode on
      mode off
      mode Verify
  4 x function group set:
    FunctionGroupSet_StatusReporting_0003
      function-groups:
        mode declaration group prototype functionGroups1: type=UCMPackageManagerStates_StatusReporting_0003
    FunctionGroupSet_StatusReporting_0002
      function-groups:
        mode declaration group prototype functionGroups1: type=UCMPackageManagerStates_StatusReporting_0002
    FunctionGroupSet_StatusReporting_0001
      function-groups:
        mode declaration group prototype functionGroups1: type=UCMPackageManagerStates_StatusReporting_0001
    FunctionGroupSet_StatusReporting_0004
      function-groups:
        mode declaration group prototype functionGroups1: type=UCMPackageManagerStates_StatusReporting_0004
  4 x software cluster, all with category=SWCL, conflicts-to=operator=LOGICAL-AND, depends-on=operator=LOGICAL-OR, design=SwClusterDesign, software-cluster-doip-diagnostic-address{address-semantics=FUNCTIONAL-ADDRESS, diagnostic-address=17473}, license=AVIN, release-notes=InitialApplication, type-approval=2018/858, vendor-id=1447315780, version=1.0.0.0:
    Swcl_StatusReporting_0004: claimed-function-group=FunctionGroupSet_StatusReporting_0004/functionGroups1
    Swcl_StatusReporting_0003: claimed-function-group=FunctionGroupSet_StatusReporting_0003/functionGroups1
    Swcl_StatusReporting_0002: claimed-function-group=FunctionGroupSet_StatusReporting_0002/functionGroups1
    Swcl_StatusReporting_0001: claimed-function-group=FunctionGroupSet_StatusReporting_0001/functionGroups1
  4 x mode declaration group:
    UCMPackageManagerStates_Rollback_0003
      mode on
      mode off
      mode Verify
    UCMPackageManagerStates_Rollback_0004
      mode on
      mode off
      mode Verify
    UCMPackageManagerStates_Rollback_0002
      mode on
      mode off
      mode Verify
    UCMPackageManagerStates_GetHistory_0001
      mode on
      mode off
      mode Verify
  4 x function group set:
    FunctionGroupSet_GetHistory_0001
      function-groups:
        mode declaration group prototype functionGroups1: type=UCMPackageManagerStates_GetHistory_0001
    FunctionGroupSet_Rollback_0004
      function-groups:
        mode declaration group prototype functionGroups1: type=UCMPackageManagerStates_Rollback_0004
    FunctionGroupSet_Rollback_0003
      function-groups:
        mode declaration group prototype functionGroups1: type=UCMPackageManagerStates_Rollback_0003
    FunctionGroupSet_Rollback_0002
      function-groups:
        mode declaration group prototype functionGroups1: type=UCMPackageManagerStates_Rollback_0002
  4 x software cluster, all with category=SWCL, conflicts-to=operator=LOGICAL-AND, depends-on=operator=LOGICAL-OR, design=SwClusterDesign, software-cluster-doip-diagnostic-address{address-semantics=FUNCTIONAL-ADDRESS, diagnostic-address=17473}, license=AVIN, release-notes=InitialApplication, type-approval=2018/858, vendor-id=1447315780, version=1.0.0.0:
    Swcl_Rollback_0003: claimed-function-group=FunctionGroupSet_Rollback_0003/functionGroups1
    Swcl_Rollback_0002: claimed-function-group=FunctionGroupSet_Rollback_0002/functionGroups1
    Swcl_GetHistory_0001: claimed-function-group=FunctionGroupSet_GetHistory_0001/functionGroups1
    Swcl_Rollback_0004: claimed-function-group=FunctionGroupSet_Rollback_0004/functionGroups1
  8 x software package, all with category=TestPackage, action-type=INSTALL, compressed-software-package-size=524288, maximum-supported-ucm-version=3.0.0.0, minimum-supported-ucm-version=1.0.0.0, packager-id=1347111236, uncompressed-software-cluster-size=655360:
    sw_pkg_Rollback_0004: software-cluster=Swcl_Rollback_0004
    sw_pkg_GetHistory_0001: software-cluster=Swcl_GetHistory_0001
    sw_pkg_Rollback_0002: software-cluster=Swcl_Rollback_0002
    sw_pkg_Rollback_0003: software-cluster=Swcl_Rollback_0003
    sw_pkg_StatusReporting_0003: software-cluster=Swcl_StatusReporting_0003
    sw_pkg_StatusReporting_0004: software-cluster=Swcl_StatusReporting_0004
    sw_pkg_StatusReporting_0001: software-cluster=Swcl_StatusReporting_0001
    sw_pkg_StatusReporting_0002: software-cluster=Swcl_StatusReporting_0002
  software cluster Swcl_GetSwClusterChangeInfo_0001: category=SWCL, claimed-function-group=FunctionGroupSet_GetSwClusterChangeInfo_0001/functionGroups1, conflicts-to=operator=LOGICAL-AND, depends-on=operator=LOGICAL-OR, design=SwClusterDesign, software-cluster-doip-diagnostic-address{address-semantics=FUNCTIONAL-ADDRESS, diagnostic-address=17473}, license=AVIN, release-notes=InitialApplication, type-approval=2018/858, vendor-id=1447315780, version=1.0.0.0
  mode declaration group UCMPackageManagerStates_GetSwClusterChangeInfo_0001
    mode on
    mode off
    mode Verify
  function group set FunctionGroupSet_GetSwClusterChangeInfo_0001
    function-groups:
      mode declaration group prototype functionGroups1: type=UCMPackageManagerStates_GetSwClusterChangeInfo_0001
  software package sw_pkg_GetSwClusterChangeInfo_0001: category=TestPackage, action-type=INSTALL, compressed-software-package-size=524288, maximum-supported-ucm-version=3.0.0.0, minimum-supported-ucm-version=1.0.0.0, packager-id=1347111236, software-cluster=Swcl_GetSwClusterChangeInfo_0001, uncompressed-software-cluster-size=655360
