AUTOSAR XML (schema 00048)
package /ServiceInstanceToPortMapping
  service instance to port prototype mapping SymmetricKeyWrapperCtxToPortMapping: port-prototype=rootSwComponentPrototype.PPortSymmetricKeyWrapperCtx, process=qt_crypto_instance1, service-instance=SymmetricKeyWrapperCtx
