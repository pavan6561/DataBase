AUTOSAR XML (schema 00049)
package /ServiceInstances
  required someip service instance UpdateRequest_Canoe_Required: service-interface-deployment=UpdateRequest_Canoe_Someip, required-service-instance-id=1, sd-client-config=SomeipSdClientServiceInstance
package /ServiceInstanceMachineMapping
  someip service instance to machine mapping UpdateRequest_Canoe_InstanceToMachineMapping: communication-connector=EthernetCommunicationConnector, service-instance=UpdateRequest_Canoe_Required, udp-port=9000
