AUTOSAR XML (schema 00048)
package /ServiceInstanceToPortMapping
  service instance to port prototype mapping BlockServiceToPortPrototypeMapping: port-prototype=rootSwComponentPrototype.PPortBlockService, process=qt_crypto_instance1, service-instance=BlockService
