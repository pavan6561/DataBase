AUTOSAR XML (schema 00048)
package /ServiceInstances
  provided someip service instance CryptoObject: service-interface-deployment=CryptoObject_Someip, sd-server-config=SomeipSdServerServiceInstance, service-instance-id=1
package /ServiceInstanceToMachineMappings
  someip service instance to machine mapping CryptoObjectToMachineMapping: communication-connector=EthernetCommunicationConnector, service-instance=CryptoObject, udp-port=4024
