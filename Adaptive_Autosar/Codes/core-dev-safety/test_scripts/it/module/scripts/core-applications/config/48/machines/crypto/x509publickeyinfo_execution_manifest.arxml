AUTOSAR XML (schema 00048)
package /ServiceInstanceToPortMapping
  service instance to port prototype mapping X509PublicKeyInfoToPortMapping: port-prototype=rootSwComponentPrototype.PPortX509PublicKeyInfo, process=qt_crypto_instance1, service-instance=X509PublicKeyInfo
