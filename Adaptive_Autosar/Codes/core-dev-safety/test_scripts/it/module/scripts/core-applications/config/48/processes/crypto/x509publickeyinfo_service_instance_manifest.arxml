AUTOSAR XML (schema 00048)
package /ServiceInstances
  provided someip service instance X509PublicKeyInfo: service-interface-deployment=X509PublicKeyInfo_Someip, sd-server-config=SomeipSdServerServiceInstance, service-instance-id=1
