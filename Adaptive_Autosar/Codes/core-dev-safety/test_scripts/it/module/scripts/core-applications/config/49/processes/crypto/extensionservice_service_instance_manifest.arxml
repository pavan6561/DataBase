AUTOSAR XML (schema 00049)
package /ServiceInstances
  provided someip service instance ExtensionService: service-interface-deployment=ExtensionService_Someip, sd-server-config=SomeipSdServerServiceInstance, service-instance-id=1
package /ServiceInstanceToMachineMappings
  someip service instance to machine mapping ExtensionServiceToMachineMapping: communication-connector=EthernetCommunicationConnector, service-instance=ExtensionService, udp-port=4026
