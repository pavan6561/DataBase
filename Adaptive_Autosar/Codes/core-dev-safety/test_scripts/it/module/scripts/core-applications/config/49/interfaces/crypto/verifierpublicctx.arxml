AUTOSAR XML (schema 00049)
package /ServiceInterface
  service interface VerifierPublicCtx
    namespaces:
      4 x symbol props:
        qt
        crypto
        cryptoprovider_001
        verifier
    methods:
      8 x operation:
        GetSignatureService: possible-ap-error=UndefinedApplicationError
          arg verifierId: type=uint8_t, direction=IN
          arg response: type=uint64_t, direction=OUT
        Reset: possible-ap-error=UndefinedApplicationError
          arg verifierId: type=uint8_t, direction=IN
          arg response: type=uint64_t, direction=OUT
        SetKey: possible-ap-error=[IncompatibleObject, UsageViolation, UndefinedApplicationError]
          arg verifierId: type=uint8_t, direction=IN
          arg key: type=uint8_t, direction=IN
          arg response: type=uint64_t, direction=OUT
        Verify: possible-ap-error=[UninitializedContext, InvalidInputSize, UndefinedApplicationError]
          5 x arg:
            verifierId: type=uint8_t, direction=IN
            value: type=ByteArray, direction=IN
            signature: type=ByteArray, direction=IN
            context: type=ByteArray, direction=IN
            response: type=returnBool, direction=OUT
        VerifyPrehashedConstSig: possible-ap-error=[ProcessingNotStarted, InvalidArgument, UndefinedApplicationError]
          5 x arg:
            verifierId: type=uint8_t, direction=IN
            hashFn: type=uint16_t, direction=IN
            signature: type=uint16_t, direction=IN
            context: type=ByteArray, direction=IN
            response: type=returnBool, direction=OUT
        VerifyPrehashed: possible-ap-error=[IncompatibleObject, IncompatibleArguments, BadObjectReference, UndefinedApplicationError]
          6 x arg:
            verifierId: type=uint8_t, direction=IN
            hashAlgId: type=uint16_t, direction=IN
            hashValue: type=ByteArray, direction=IN
            signature: type=uint16_t, direction=IN
            context: type=ByteArray, direction=IN
            response: type=returnBool, direction=OUT
        VerifyPrehashedROMSig: possible-ap-error=[ProcessingNotFinished, InvalidArgument, UndefinedApplicationError]
          5 x arg:
            verifierId: type=uint8_t, direction=IN
            hashFn: type=uint16_t, direction=IN
            signature: type=ByteArray, direction=IN
            context: type=ByteArray, direction=IN
            response: type=returnBool, direction=OUT
        IsInitialized
          arg verifierId: type=uint8_t, direction=IN
          arg response: type=uint16_t, direction=OUT
