AUTOSAR XML (schema 00049)
package /ServiceInterface
  service interface DigestService
    namespaces:
      4 x symbol props:
        qt
        crypto
        cryptoprovider_001
        digestservice
    methods:
      4 x operation:
        Compare: possible-ap-error=[BruteForceRisk, ProcessingNotFinished, UndefinedApplicationError]
          4 x arg:
            expected: type=ByteArray, direction=IN
            offset: type=uint32_t, direction=IN
            response: type=returnBool, direction=OUT
            digestId: type=uint8_t, direction=IN
        GetDigestSize: possible-ap-error=UndefinedApplicationError
          arg response: type=uint32_t, direction=OUT
          arg digestId: type=uint8_t, direction=IN
        IsFinished: possible-ap-error=UndefinedApplicationError
          arg response: type=returnBool, direction=OUT
          arg digestId: type=uint8_t, direction=IN
        IsStarted: possible-ap-error=UndefinedApplicationError
          arg response: type=returnBool, direction=OUT
          arg digestId: type=uint8_t, direction=IN
