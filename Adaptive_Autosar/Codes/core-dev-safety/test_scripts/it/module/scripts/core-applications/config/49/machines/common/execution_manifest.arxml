AUTOSAR XML (schema 00049)
package /StartupConfigSets
  mode declaration group MachineState: initial-mode=MachineState/Off
    5 x mode:
      Startup
      Shutdown
      Restart
      Off
      Verify
  startup config set Processes
    22 x startup config, all with scheduling-policy=SCHEDULING-POLICY-ROUND-ROBIN:
      qt_phm_instance1_startupconfig: environment-variables=tag-with-optional-value={key=LOG_CONFIG_PATH, value=/opt/qt_phm_instance1/etc/log_config.json}, scheduling-priority=12
      qt_stateManager_startupconfig: environment-variables=tag-with-optional-value={key=LOG_CONFIG_PATH, value=/opt/qt_statemanager/etc/log_config.json}, scheduling-priority=11
      phm_core_startupconfig: scheduling-priority=10
        environment-variables:
          key=PHM_CONFIGURATION, value=/opt/phm-core/etc/phm.json
          key=LOG_CONFIG_PATH, value=/opt/phm-core/etc/log_config.json
      ara_dlt_daemon_startupconfig: scheduling-priority=9
      qt_crypto_instance1_startupconfig: environment-variables=tag-with-optional-value={key=LOG_CONFIG_PATH, value=/opt/qt_crypto_instance1/etc/log_config.json}, scheduling-priority=13
      qt_ucm_instance1_startupconfig: environment-variables=tag-with-optional-value={key=LOG_CONFIG_PATH, value=/opt/qt_ucm_instance1/etc/log_config.json}, scheduling-priority=14
      ara_someip_routing_daemon_startupconfig: scheduling-priority=8
      qt_cm_instance{1..3}_startupconfig: environment-variables=tag-with-optional-value={key=LOG_CONFIG_PATH, value=/opt/qt_cm_instance{1..3}/etc/log_config.json}, scheduling-priority=17
      package_manager_startupconfig: scheduling-priority=10
        environment-variables:
          key=UCM_CONFIG_JSON, value=/opt/package_manager/etc/ucm_config.json
          key=LOG_CONFIG_PATH, value=/opt/package_manager/etc/log_config.json
          key=UCM_INSTANCE_SPECIFIER, value=package_manager/rootSwComponentPrototype/PPortPackageManagement
          key=UCM_KVS_CURRENTSTATUS, value=package_manager/rootSwComponentPrototype/SwPackageCurrentStatusPRPort
          key=UCM_KVS_TRANSFERSTATUS, value=package_manager/rootSwComponentPrototype/SwPackageTransferStatusPRPort
          key=UCM_CRYPTO_INSTANCE_SPECIFIER, value=package_manager/rootSwComponentPrototype/package_manager/RPortCryptoProviderUCMPrototype
      update_adapter_startupconfig: environment-variables=tag-with-optional-value={key=LOG_CONFIG_PATH, value=/opt/updateadapter/etc/log_config.json}, scheduling-priority=10
      qt_phm_instance2_startupconfig: environment-variables=tag-with-optional-value={key=LOG_CONFIG_PATH, value=/opt/qt_phm_instance2/etc/log_config.json}, scheduling-priority=20
      crypto_core_startupconfig: scheduling-priority=25
        environment-variables:
          key=LOG_CONFIG_PATH, value=/opt/crypto-core/etc/log_config.json
          key=CRYPTO_CONFIGURATION, value=/opt/crypto-core/etc/crypto_config.json
      statemanager: scheduling-priority=31
        environment-variables:
          key=SM_PERSISTENCY, value=/opt/statemanager/var/statemanagerdata
          key=LOG_CONFIG_PATH, value=/opt/statemanager/etc/log_config.json
      qt_phm_instance3_startupconfig: environment-variables=tag-with-optional-value={key=LOG_CONFIG_PATH, value=/opt/qt_phm_instance3/etc/log_config.json}, scheduling-priority=15
      vehicle_package_manager: scheduling-priority=12
        environment-variables:
          key=VSOMEIP_CONFIGURATION, value=/opt/vehicle_package_manager/etc/vsomeip.json
          key=VPM_INSTANCE_SPECIFIER, value=vehicle_package_manager/vehicle_package_manager_root/VehiclePackageManagementPPort
          key=VDA_INSTANCE_SPECIFIER, value=vehicle_package_manager/vehicle_package_manager_root/VehicleDriverApplicationPPort
          key=VSM_INSTANCE_SPECIFIER, value=vehicle_package_manager/vehicle_package_manager_root/VehicleStateManagementPPort
      qt_cm_instance4_startupconfig: environment-variables=tag-with-optional-value={key=LOG_CONFIG_PATH, value=/opt/qt_cm_instance4/etc/log_config.json}, scheduling-priority=17
      qt_ota_client: environment-variables=tag-with-optional-value={key=LOG_CONFIG_PATH, value=/opt/qt_ota_client/etc/log_config.json}, scheduling-priority=12
      vehicle_package_manager: scheduling-priority=12
        environment-variables:
          key=VSOMEIP_CONFIGURATION, value=/opt/vehicle_package_manager/etc/vsomeip.json
          key=VPM_INSTANCE_SPECIFIER, value=vehicle_package_manager/vehicle_package_manager_root/VehiclePackageManagementPPort
          key=VDA_INSTANCE_SPECIFIER, value=vehicle_package_manager/vehicle_package_manager_root/VehicleDriverApplicationPPort
          key=VSM_INSTANCE_SPECIFIER, value=vehicle_package_manager/vehicle_package_manager_root/VehicleStateManagementPPort
      qt_driver_application: environment-variables=tag-with-optional-value={key=LOG_CONFIG_PATH, value=/opt/qt_driver_application/etc/log_config.json}, scheduling-priority=13
      qt_vehicle_state_manager: environment-variables=tag-with-optional-value={key=LOG_CONFIG_PATH, value=/opt/qt_vehicle_state_manager/etc/log_config.json}, scheduling-priority=13
  7 x mode declaration group:
    PHMApplicationStates: initial-mode=PHMApplicationStates/Off
      6 x mode:
        PHM_Instance1
        PHM_Instance2
        PHM_Instance_1_2
        Off
        Verify
        PHM_Instance3
    CryptoApplicationStates: initial-mode=CryptoApplicationStates/Off
      5 x mode:
        Crypto_Instance1
        Crypto_Instance2
        Crypto_Instance_1_2
        Off
        Verify
    ComApplicationStates: initial-mode=ComApplicationStates/Off
      5 x mode:
        Com_Instance{1..3}
        Off
        Verify
    UCMApplicationStates: initial-mode=UCMApplicationStates/Off
      5 x mode:
        Ucm_Instance1
        Ucm_Instance2
        Ucm_Instance_1_2
        Off
        Verify
    ProcessStateMachine
      mode Running
      mode Terminated
    UCMPackageManagerStates: initial-mode=UCMPackageManagerStates/Off
      mode Off
      mode Verify
      mode On
    UcmMasterApplicationStates: initial-mode=UcmMasterApplicationStates/Off
      5 x mode:
        Ucm_Master_Application1
        Ucm_Master_Application2
        Ucm_Master_Application_1_2
        Off
        Verify
package /FunctionGroupSets
  function group set FunctionGroupSet
    function-groups:
      8 x mode declaration group prototype:
        MachineFG: type=MachineState
        PHMApplicationStates: type=PHMApplicationStates
        CryptoApplicationStates: type=CryptoApplicationStates
        ComApplicationStates: type=ComApplicationStates
        UCMApplicationStates: type=UCMApplicationStates
        UCMPackageManagerStates: type=UCMPackageManagerStates
        TSyncApplicationStates: type=TSyncApplicationStates
        UcmMasterApplicationStates: type=UcmMasterApplicationStates
