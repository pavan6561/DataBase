AUTOSAR XML (schema 00049)
package /ServiceInstanceToPortMapping
  service instance to port prototype mapping ProvidedApplicationVehiclePackageManagementToPortPrototypeMapping: port-prototype=qt_ota_client_root.PPortApplicationVehiclePackageManagement, process-design=qt_ota_client, process=qt_ota_client, service-instance=ProvidedSomeIpApplicationVehiclePackageManagementIstance
  service instance to port prototype mapping RequiredVehiclePackageManagerToPortPrototypeMapping: port-prototype=qt_ota_client_root.RPortPrototypeVehiclePackageManager, process-design=qt_ota_client, process=qt_ota_client, service-instance=RequiredVehiclePackageManagement
package /ServiceInstanceToMachineMapping
  someip service instance to machine mapping QtOtaClientToMachineMapping: communication-connector=EthernetCommunicationConnector, service-instance=ProvidedSomeIpApplicationVehiclePackageManagementIstance, udp-port=8002
