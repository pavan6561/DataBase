AUTOSAR XML (schema 00048)
package /ServiceInstanceToPortPrototypeMappings
  service instance to port prototype mapping CryptoProviderPortMapping: port-prototype=rootSwComponentPrototype.PPortCryptoProvider, process=qt_crypto_instance1, service-instance=CryptoProvider
