AUTOSAR XML (schema 00048)
package /SomeIpServiceInterfaceDeployment
  someip service interface deployment BlockService_Someip: service-interface=BlockService, service-interface-id=73, service-interface-version={major-version=0, minor-version=0}
    4 x someip method deployment, all with transport-protocol=UDP:
      GetActualIvBitLength: method=GetActualIvBitLength, method-id=1
      GetBlockSize: method=GetBlockSize, method-id=2
      GetIvSize: method=GetIvSize, method-id=3
      IsValidIvSize: method=IsValidIvSize, method-id=4
