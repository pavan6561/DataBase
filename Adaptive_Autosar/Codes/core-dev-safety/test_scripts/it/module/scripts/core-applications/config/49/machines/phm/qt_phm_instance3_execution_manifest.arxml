AUTOSAR XML (schema 00049)
package /ProcessToMachineMappings
  process to machine mapping set PHMProcessToMachineMappingSet
    process to machine mapping QtPhmInstance3ToMachineMappings: machine=QtMachine, process=qt_phm_instance3, shall-not-run-on=Cores0
package /ServiceInstanceToPortPrototypeMappings
  service instance to port prototype mapping QtPHMInstance3PortMapping0001: port-prototype=rootSwComponentPrototype.PAliveInstane3, process-design=qt_phm_instance3, process=qt_phm_instance3, service-instance=qt_phm_instance3
