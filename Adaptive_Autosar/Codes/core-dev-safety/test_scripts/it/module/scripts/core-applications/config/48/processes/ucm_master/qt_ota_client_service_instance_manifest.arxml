AUTOSAR XML (schema 00048)
package /ServiceInstances
  provided someip service instance ProvidedSomeIpApplicationVehiclePackageManagementIstance: service-interface-deployment=ApplicationVehiclePackageManagement_Someip, sd-server-config=SomeipSdServerServiceInstance, service-instance-id=5
    someip provided event group transferStateEventGroup: event-group=VpmSomeipEventGroup, multicast-threshold=1
  required someip service instance RequiredVehiclePackageManagement: service-interface-deployment=VehiclePackageManagementSomeIp, required-service-instance-id=909, sd-client-config=SomeipSdClientServiceInstance
