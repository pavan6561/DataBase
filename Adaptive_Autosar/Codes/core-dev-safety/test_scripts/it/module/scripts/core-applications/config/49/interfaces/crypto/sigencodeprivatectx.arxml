AUTOSAR XML (schema 00049)
package /ServiceInterface
  service interface SigEncodePrivateCtx
    namespaces:
      4 x symbol props:
        qt
        crypto
        cryptoprovider_001
        encode
    methods:
      5 x operation:
        GetMaxInputSize: possible-ap-error=UndefinedApplicationError
          arg encodeId: type=uint8_t, direction=IN
          arg suppressPadding: type=bool, direction=IN
          arg response: type=uint64_t, direction=OUT
        GetMaxOutputSize: possible-ap-error=UndefinedApplicationError
          arg encodeId: type=uint8_t, direction=IN
          arg suppressPadding: type=bool, direction=IN
          arg response: type=uint64_t, direction=OUT
        SignAndEncode: possible-ap-error=[InvalidInputSize, UninitializedContext, UndefinedApplicationError]
          arg encodeId: type=uint8_t, direction=IN
          arg input: type=ByteArray, direction=IN
          arg response: type=returnByteArray, direction=OUT
        Reset: possible-ap-error=UndefinedApplicationError
          arg encodeId: type=uint8_t, direction=IN
          arg response: type=uint64_t, direction=OUT
        SetKey: possible-ap-error=[IncompatibleObject, UsageViolation, UndefinedApplicationError]
          arg encodeId: type=uint8_t, direction=IN
          arg key: type=uint8_t, direction=IN
          arg response: type=uint64_t, direction=OUT
