AUTOSAR XML (schema 00049)
package /ServiceInterface
  service interface PrivateKey
    namespaces:
      4 x symbol props:
        qt
        crypto
        cryptoprovider_001
        privatekey
    methods:
      operation GetPublicKey: possible-ap-error=UndefinedApplicationError
        arg privateKey: type=uint8_t, direction=IN
        arg publicKey: type=uint8_t, direction=IN
        arg response: type=uint64_t, direction=OUT
