AUTOSAR XML (schema 00049)
package /ServiceInstances
  provided someip service instance DigestService: service-interface-deployment=DigestService_Someip, sd-server-config=SomeipSdServerServiceInstance, service-instance-id=1
package /ServiceInstanceToMachineMappings
  someip service instance to machine mapping DigestServiceToMachineMapping: communication-connector=EthernetCommunicationConnector, service-instance=DigestService, udp-port=4019
