AUTOSAR XML (schema 00049)
package /SomeIpServiceInterfaceDeployment
  someip service interface deployment AuthCipherCtx_Someip: service-interface=AuthCipherCtx, service-interface-id=30, service-interface-version={major-version=0, minor-version=0}
    14 x someip method deployment, all with transport-protocol=UDP:
      StartReadOnlyMemRegion: method=StartReadOnlyMemRegion, method-id=1
      UpdateReadOnlyMemoryRegion: method=UpdateAssociatedDataReadOnlyMemRegion, method-id=2
      UpdateAssociatedData: method=UpdateAssociatedData, method-id=3
      Reset: method=Reset, method-id=4
      GetMaxAssociatedDataSize: method=GetMaxAssociatedDataSize, method-id=5
      GetDigest: method=GetDigest, method-id=6
      GetTransformation: method=GetTransformation, method-id=7
      Check: method=Check, method-id=8
      ProcessConfidentialData: method=ProcessConfidentialData, method-id=9
      ProcessConfidentialDataReadWrite: method=ProcessConfidentialDataReadWrite, method-id=10
      SetKey: method=SetKey, method-id=11
      StartSecretSeed: method=StartSecretSeed, method-id=12
      UpdateAssociatedDataRestrictedUseObject: method=UpdateAssociatedDataRestrictedUseObject, method-id=13
      isInitialized: method=isInitialized, method-id=14
