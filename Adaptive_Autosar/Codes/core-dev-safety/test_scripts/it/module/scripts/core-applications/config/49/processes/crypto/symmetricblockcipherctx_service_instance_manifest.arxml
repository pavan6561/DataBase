AUTOSAR XML (schema 00049)
package /ServiceInstances
  provided someip service instance SymmetricBlockCipherCtx: service-interface-deployment=SymmetricBlockCipherCtx_Someip, sd-server-config=SomeipSdServerServiceInstance, service-instance-id=1
