AUTOSAR XML (schema 00049)
package /ServiceInstanceToPortPrototypeMappings
  service instance to port prototype mapping QtPHMInstance2PortMapping0001: port-prototype=rootSwComponentPrototype2.PAliveSupervision0002, process-design=qt_phm_instance2, process=qt_phm_instance2, service-instance=qt_phm_instance2
