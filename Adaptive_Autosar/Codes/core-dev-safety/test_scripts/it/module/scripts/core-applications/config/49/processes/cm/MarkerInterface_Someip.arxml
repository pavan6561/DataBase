AUTOSAR XML (schema 00049)
package /ServiceInterfaceDeployments
  someip service interface deployment MarkerInterface_Someip: service-interface=MarkerInterface, service-interface-id=108, service-interface-version={major-version=0, minor-version=0}
package /ServiceInstances
  provided someip service instance MarkerInterface_qt_cm_instance4_ProvidedSomeipServiceInstance: service-interface-deployment=MarkerInterface_Someip, sd-server-config=SomeipSdServerServiceInstance, service-instance-id=109
  required someip service instance MarkerInterface_qt_cm_instance3_RequiredSomeipServiceInstance: service-interface-deployment=MarkerInterface_Someip, required-service-instance-id=109, sd-client-config=SomeipSdClientServiceInstance
package /ServiceInstanceToMachineMappings
  someip service instance to machine mapping MarkerInterface_qt_cm_instance4_Provided_ServiceInstance_toMachine: communication-connector=EthernetCommunicationConnector, service-instance=MarkerInterface_qt_cm_instance4_ProvidedSomeipServiceInstance, udp-port=3010
  someip service instance to machine mapping MarkerInterface_qt_cm_instance3_Required_ServiceInstance_toMachine: communication-connector=EthernetCommunicationConnector, service-instance=MarkerInterface_qt_cm_instance3_RequiredSomeipServiceInstance, udp-port=0
package /ServiceInstanceToPortPrototypeMappings
  service instance to port prototype mapping MarkerInterface_qt_cm_instance4_ProvidedSomeipInstance_PMarkerInterface_toPort: port-prototype=rootSwComponentPrototype.PMarkerInterface, process-design=qt_cm_instance4, process=qt_cm_instance4, service-instance=MarkerInterface_qt_cm_instance4_ProvidedSomeipServiceInstance
  service instance to port prototype mapping MarkerInterface_qt_cm_instance3_RequiredSomeipInstance_RMarkerInterface_toPort: port-prototype=rootSwComponentPrototype.RMarkerInterface, process-design=qt_cm_instance3, process=qt_cm_instance3, service-instance=MarkerInterface_qt_cm_instance3_RequiredSomeipServiceInstance
package /SomeipSdTimingConfigs
  someip sd client event group timing config SomeipSdClientEventGroupTimingConfig: request-response-delay={max-value=1.0, min-value=0.0}, time-to-live=10
