AUTOSAR XML (schema 00049)
package /CppImplementationDataTypes
  17 x std cpp implementation data type, all with type-emitter=TYPE_EMITTER_ARA:
    RadarObjects: category=STRUCTURE
      namespaces:
        symbol props ara
        symbol props com
        symbol props sample
      cpp implementation data type element subElements1: type-reference=ByteArray
      cpp implementation data type element subElements2: type-reference=LongArray
    Position: category=STRUCTURE
      namespaces:
        symbol props ara
        symbol props com
        symbol props sample
      cpp implementation data type element x: type-reference=int32_t
      cpp implementation data type element y: type-reference=int16_t
      cpp implementation data type element z: type-reference=int64_t
    ArrayCppIdt: category=ARRAY, array-size=3, cpp-template-argument=TypeRefCppIdt, type-reference=TypeRefCppIdt
    TypeRefCppIdt: type-reference=int32_t
    AssociativeMapCppIdt: category=ASSOCIATIVE_MAP, template-arguments=[TypeRefCppIdt, TypeRefCppIdt]
    VectorCppIdt: category=VECTOR, cpp-template-argument=TypeRefCppIdt
    Distances: category=STRUCTURE
      namespaces:
        symbol props ara
        symbol props com
        symbol props sample
      cpp implementation data type element subElements1: type-reference=uint8_t
      cpp implementation data type element subElements2: type-reference=uint16_t
    Duration: category=STRUCTURE
      namespaces:
        symbol props ara
        symbol props com
        symbol props sample
      cpp implementation data type element subElements1: type-reference=uint32_t
      cpp implementation data type element subElements2: type-reference=uint64_t
    Vector_control: category=VECTOR, cpp-template-argument=int8_t
    Vector_analysis: category=VECTOR, cpp-template-argument=int16_t
    Vector_distance: category=VECTOR, cpp-template-argument=int32_t
    Array_analysis: category=ARRAY, array-size=4, cpp-template-argument=int64_t
    Array_distance: category=ARRAY, array-size=2, cpp-template-argument=int32_t
    Array_control: category=ARRAY, array-size=5, cpp-template-argument=int16_t
    EventSubscriptionStates: base-type=std_uint8_t, compu {0x00=kSubscribed, 0x01=kNotSubscribed, 0x02=kSubscriptionPending}, implementation-data-type=uint8_t, type-reference=uint8_t
    Enum_response: base-type=std_uint8_t, compu {0x00=kSuccess, 0x01=kGeneralReject, 0x02=kGeneralMemoryError, 0x03=kTransferIdInvalid, 0x04=kOperationNotPermitted}, implementation-data-type=uint8_t, type-reference=uint8_t
    SLT_response: base-type=std_uint8_t, compu {0x00=kSuccess, 0x01=kGeneralReject, 0x02=kGeneralMemoryError, 0x03=kTransferIdInvalid, 0x04=kOperationNotPermitted}, implementation-data-type=uint8_t, type-reference=uint8_t
