AUTOSAR XML (schema 00048)
package /ServiceInstances
  provided someip service instance SignatureService: service-interface-deployment=SignatureService_Someip, sd-server-config=SomeipSdServerServiceInstance, service-instance-id=1
package /ServiceInstanceToMachineMappings
  someip service instance to machine mapping SignatureServiceToMachineMapping: communication-connector=EthernetCommunicationConnector, service-instance=SignatureService, udp-port=4027
