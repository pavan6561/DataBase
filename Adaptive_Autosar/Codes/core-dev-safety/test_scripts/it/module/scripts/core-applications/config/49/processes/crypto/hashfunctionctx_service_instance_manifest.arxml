AUTOSAR XML (schema 00049)
package /ServiceInstances
  provided someip service instance HashFunctionCtx: service-interface-deployment=HashFunctionCtx_Someip, sd-server-config=SomeipSdServerServiceInstance, service-instance-id=1
