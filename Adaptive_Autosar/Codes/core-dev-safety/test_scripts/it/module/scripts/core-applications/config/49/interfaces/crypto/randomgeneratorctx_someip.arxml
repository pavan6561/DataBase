AUTOSAR XML (schema 00049)
package /SomeIpServiceInterfaceDeployment
  someip service interface deployment RandomGeneratorCtx_Someip: service-interface=RandomGeneratorCtx, service-interface-id=25, service-interface-version={major-version=0, minor-version=0}
    6 x someip method deployment, all with transport-protocol=UDP:
      AddEntropy: method=AddEntropy, method-id=1
      Generate: method=Generate, method-id=2
      Seed: method=Seed, method-id=3
      SeedSecret: method=SeedSecret, method-id=4
      SetKey: method=SetKey, method-id=5
      GetExtensionService: method=GetExtensionService, method-id=6
