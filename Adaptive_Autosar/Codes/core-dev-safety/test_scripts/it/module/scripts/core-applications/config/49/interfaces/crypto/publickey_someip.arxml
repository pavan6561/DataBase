AUTOSAR XML (schema 00049)
package /SomeIpServiceInterfaceDeployment
  someip service interface deployment PublicKey_Someip: service-interface=PublicKey, service-interface-id=76, service-interface-version={major-version=0, minor-version=0}
    someip method deployment CheckKey: method=CheckKey, method-id=1, transport-protocol=UDP
    someip method deployment HashPublicKey: method=HashPublicKey, method-id=2, transport-protocol=UDP
    someip method deployment ExportPublicly: method=ExportPublicly, method-id=3, transport-protocol=UDP
