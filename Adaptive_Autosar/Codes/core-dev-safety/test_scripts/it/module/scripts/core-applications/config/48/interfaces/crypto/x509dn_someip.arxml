AUTOSAR XML (schema 00048)
package /SomeIpServiceInterfaceDeployment
  someip service interface deployment X509DN_Someip: service-interface=X509DN, service-interface-id=45, service-interface-version={major-version=0, minor-version=0}
    6 x someip method deployment, all with transport-protocol=TCP:
      GetDnString: method=GetDnString, method-id=2
      GetAttribute: method=GetAttribute, method-id=1
      SetAttribute: method=SetAttribute, method-id=3
      SetDn: method=SetDn, method-id=4
      VerifyMyProvider: method=VerifyMyProvider, method-id=5
      ExportPublicly: method=ExportPublicly, method-id=6
