AUTOSAR XML (schema 00049)
package /Machines
  machine QtMachine: machine-design=QtMachine
    time sync module instantiation TimeSyncModuleInstantiation
      synchronized time base consumer UTC_Consumer: network-time-consumer=UTC_Slave1
      synchronized time base consumer GPS_Consumer: network-time-consumer=GPS_Slave1
      synchronized time base consumer IST_OFS_Consumer: network-time-consumer=IST_OFS_Slaves1
      4 x synchronized time base provider:
        KST_Provider: network-time-provider=KST_Masters1, time-sync-correction={allow-provider-rate-correction=true, rate-corrections-per-measurement-duration=2, rate-deviation-measurement-duration=6.0}
        EST_Provider: network-time-provider=EST_Masters1, time-sync-correction={allow-provider-rate-correction=false, rate-corrections-per-measurement-duration=2, rate-deviation-measurement-duration=6.0}
        CET_OFS_Provider: network-time-provider=CET_OFS_Masters1, time-sync-correction={allow-provider-rate-correction=true, rate-corrections-per-measurement-duration=2, rate-deviation-measurement-duration=6.0}
        PST_OFS_Provider: network-time-provider=PST_OFS_Masters1, time-sync-correction={allow-provider-rate-correction=false, rate-corrections-per-measurement-duration=2, rate-deviation-measurement-duration=6.0}
      synchronized time base consumer JST_Consumer: network-time-consumer=JST_Slave1
      synchronized time base consumer MIT_OFS_Consumer: network-time-consumer=MIT_OFS_Slave1
