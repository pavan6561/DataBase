AUTOSAR XML (schema 00048)
package /ServiceInstanceToPortMapping
  service instance to port prototype mapping RestrictedUseObjectToPortPrototypeMapping: port-prototype=rootSwComponentPrototype.PPortRestrictedUseObject, process=qt_crypto_instance1, service-instance=RestrictedUseObject
