AUTOSAR XML (schema 00048)
package /SomeIpServiceInterfaceDeployment
  someip service interface deployment VerifierPublicCtx_Someip: service-interface=VerifierPublicCtx, service-interface-id=35, service-interface-version={major-version=0, minor-version=0}
    8 x someip method deployment, all with transport-protocol=UDP:
      GetSignatureService: method=GetSignatureService, method-id=1
      Reset: method=Reset, method-id=2
      SetKey: method=SetKey, method-id=3
      Verify: method=Verify, method-id=4
      VerifyPrehashedConstSig: method=VerifyPrehashedConstSig, method-id=5
      VerifyPrehashed: method=VerifyPrehashed, method-id=6
      VerifyPrehashedROMSig: method=VerifyPrehashedROMSig, method-id=7
      IsInitialized: method=IsInitialized, method-id=8
