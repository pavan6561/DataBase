AUTOSAR XML (schema 00048)
package /SomeIpServiceInterfaceDeployment
  someip service interface deployment SerializeString_Someip: service-interface=SerializeString, service-interface-id=102, service-interface-version={major-version=0, minor-version=0}
    9 x someip event deployment, all with transport-protocol=UDP:
      EventString2MSBF_Someip: event=Event_String2MSBF, event-id=27
      EventString2MSBL_Someip: event=Event_String2MSBL, event-id=28
      EventString4MSBF_Someip: event=Event_String4MSBF, event-id=29
      EventString4MSBL_Someip: event=Event_String4MSBL, event-id=30
      EventStringOne_Someip: event=Event_StringOne, event-id=31
      EventStringBothNoLength_Someip: event=Event_StringBothNoLength, event-id=32
      EventStringBothNoByteOrder_Someip: event=Event_StringBothNoByteOrder, event-id=33
      EventStringNoLength_Someip: event=Event_StringNoLength, event-id=34
      EventStringNoByteOrder_Someip: event=Event_StringNoByteOrder, event-id=35
    someip event group EventDataType_Someip: event-group-id=402, event=[SerializeString_Someip/EventString2MSBF_Someip, SerializeString_Someip/EventString2MSBL_Someip, SerializeString_Someip/EventString4MSBF_Someip, SerializeString_Someip/EventString4MSBL_Someip, SerializeString_Someip/EventStringOne_Someip, SerializeString_Someip/EventStringBothNoLength_Someip, SerializeString_Someip/EventStringBothNoByteOrder_Someip, SerializeString_Someip/EventStringNoLength_Someip, SerializeString_Someip/EventStringNoByteOrder_Someip]
  someip service interface deployment SerializeStringCanoe_Someip: service-interface=SerializeString_Canoe, service-interface-id=102, service-interface-version={major-version=0, minor-version=0}
    9 x someip event deployment, all with transport-protocol=UDP:
      EventString2MSBF_Someip: event=Event_String2MSBF, event-id=27
      EventString2MSBL_Someip: event=Event_String2MSBL, event-id=28
      EventString4MSBF_Someip: event=Event_String4MSBF, event-id=29
      EventString4MSBL_Someip: event=Event_String4MSBL, event-id=30
      EventStringOne_Someip: event=Event_StringOne, event-id=31
      EventStringBothNoLength_Someip: event=Event_StringBothNoLength, event-id=32
      EventStringBothNoByteOrder_Someip: event=Event_StringBothNoByteOrder, event-id=33
      EventStringNoLength_Someip: event=Event_StringNoLength, event-id=34
      EventStringNoByteOrder_Someip: event=Event_StringNoByteOrder, event-id=35
    someip event group EventDataType_Someip: event-group-id=402, event=[SerializeStringCanoe_Someip/EventString2MSBF_Someip, SerializeStringCanoe_Someip/EventString2MSBL_Someip, SerializeStringCanoe_Someip/EventString4MSBF_Someip, SerializeStringCanoe_Someip/EventString4MSBL_Someip, SerializeStringCanoe_Someip/EventStringOne_Someip, SerializeStringCanoe_Someip/EventStringBothNoLength_Someip, SerializeStringCanoe_Someip/EventStringBothNoByteOrder_Someip, SerializeStringCanoe_Someip/EventStringNoLength_Someip, SerializeStringCanoe_Someip/EventStringNoByteOrder_Someip]
package /ServiceInstances
  provided someip service instance SerializeString_qt_cm_instance2_ProvidedSomeipServiceInstance: service-interface-deployment=SerializeString_Someip, sd-server-config=SomeipSdServerServiceInstance, service-instance-id=101
    someip provided event group providedEventGroups: event-group=SerializeString_Someip/EventDataType_Someip, multicast-threshold=1
  required someip service instance SerializeString_qt_cm_instance2_RequiredSomeipServiceInstance: service-interface-deployment=SerializeStringCanoe_Someip, required-service-instance-id=105, sd-client-config=SomeipSdClientServiceInstance
    someip required event group requiredEventGroups: event-group=SerializeString_Someip/EventDataType_Someip
package /ServiceInstanceToMachineMappings
  someip service instance to machine mapping SerializeString_qt_cm_instance2_Provided_ServiceInstance_toMachine: communication-connector=EthernetCommunicationConnector, service-instance=SerializeString_qt_cm_instance2_ProvidedSomeipServiceInstance, udp-port=3003
  someip service instance to machine mapping SerializeString_qt_cm_instance2_Required_ServiceInstance_toMachine: communication-connector=EthernetCommunicationConnector, service-instance=SerializeString_qt_cm_instance2_RequiredSomeipServiceInstance, udp-port=0
package /ServiceInstanceToPortMapping
  service instance to port prototype mapping SerializeString_qt_cm_instance2_ProvidedSomeipServiceInstance_PSerializeString_toPort: port-prototype=rootSwComponentPrototype.PSerializeString, process=qt_cm_instance2, service-instance=SerializeString_qt_cm_instance2_ProvidedSomeipServiceInstance
  service instance to port prototype mapping SerializeString_qt_cm_instance2_RequiredSomeipServiceInstance_RSerializeString_toPort: port-prototype=rootSwComponentPrototype.RSerializeString, process=qt_cm_instance2, service-instance=SerializeString_qt_cm_instance2_RequiredSomeipServiceInstance
