AUTOSAR XML (schema 00048)
package /Processes
  process vehicle_state_manager: design=vehicle_state_manager, executable=vehicle_state_manager
