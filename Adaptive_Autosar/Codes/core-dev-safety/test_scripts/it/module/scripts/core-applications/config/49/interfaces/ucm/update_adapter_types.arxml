AUTOSAR XML (schema 00049)
package /CompuMethods/UpdateAdapter
  compu method PackageManagerStatusTypeEnum: 0x00=kIdle, 0x01=kReady, 0x02=kBusy, 0x03=kExternalActivate, 0x04=kExternalRollback
  compu method DataCopyStatusTypeEnum: 0x00=kUnknown, 0x01=kSuccess, 0x02=kFailure
package /CppImplementationDataTypes
  6 x std cpp implementation data type, all with category=TYPE_REFERENCE, type-emitter=TYPE_EMITTER_ARA, type-reference=uint8_t:
    UAActivateStatusType: compu {0x00=kUnknown, 0x01=kSuccess, 0x02=kErrorDuringActivation}
      namespaces:
        symbol props ara
        symbol props ucm
        symbol props pkgmgr
    UAIsFinishedType: compu {0x00=kWorking, 0x01=kFinished}
    UARollbackStatusType: compu {0x00=kUnknown, 0x02=kErrorDuringRollback, 0x01=kSuccess}
      namespaces:
        symbol props ara
        symbol props ucm
        symbol props pkgmgr
    UADataCopyStatusType: compu {0x00=kUnknown, 0x02=kErrorDuringRollback, 0x01=kSuccess}
    UAPackageManagerStatusType: compu-method=PackageManagerStatusTypeEnum
    UpdateStatusType: compu-method=PackageManagerStatusTypeEnum
