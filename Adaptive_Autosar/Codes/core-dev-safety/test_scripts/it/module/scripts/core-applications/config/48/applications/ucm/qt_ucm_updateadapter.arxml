AUTOSAR XML (schema 00048)
package /AdaptiveApplicationSwComponents
  adaptive application sw component type qt_ucm_updateadapter: category=APPLICATION_LEVEL
    require port UpdateAdapterRport: required-interface=UpdateAdapter
