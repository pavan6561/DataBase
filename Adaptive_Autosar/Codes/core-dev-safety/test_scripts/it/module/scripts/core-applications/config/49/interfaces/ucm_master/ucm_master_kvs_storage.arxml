AUTOSAR XML (schema 00049)
package /PersistencyKeyValueStorage
  persistency key value storage VehiclePackageTransferStatusDatabase: uri=/opt/vehicle_package_manager/var/vehiclepackage_transfer_status_database.json
