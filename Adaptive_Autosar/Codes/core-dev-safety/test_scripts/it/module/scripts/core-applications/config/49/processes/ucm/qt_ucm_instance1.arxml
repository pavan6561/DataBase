AUTOSAR XML (schema 00049)
package /Processes
  process qt_ucm_instance1: design=qt_ucm_instance1, executable=qt_ucm_instance1, state-dependent-startup-config{function-group-state=UCMApplicationStates.Ucm_Instance1, resource-group=ResourceGroup, startup-config=qt_ucm_instance1_startupconfig}
