AUTOSAR XML (schema 00049)
package /ServiceInterfaces
  service interface MarkerInterface
    namespaces:
      symbol props ara
      symbol props com
      symbol props sample
