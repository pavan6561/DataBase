AUTOSAR XML (schema 00048)
package /ServiceInstanceToPortMapping
  service instance to port prototype mapping MsgRecoveryPublicCtxToPortMapping: port-prototype=rootSwComponentPrototype.PPortMsgRecoveryPublicCtx, process=qt_crypto_instance1, service-instance=MsgRecoveryPublicCtx
