AUTOSAR XML (schema 00048)
package /ServiceInterface
  service interface ExtensionService
    namespaces:
      4 x symbol props:
        qt
        crypto
        cryptoprovider_001
        es
    methods:
      7 x operation, all with possible-ap-error=UndefinedApplicationError:
        GetActualKeyBitLength
          arg extenId: type=uint8_t, direction=IN
          arg response: type=uint32_t, direction=OUT
        GetActualKeyCOUID
          arg extenId: type=uint8_t, direction=IN
          arg response: type=uint64_t, direction=OUT
        GetAllowedUsage
          arg extenId: type=uint8_t, direction=IN
          arg response: type=uint64_t, direction=OUT
        GetMaxKeyBitLength
          arg extenId: type=uint8_t, direction=IN
          arg response: type=uint64_t, direction=OUT
        GetMinKeyBitLength
          arg extenId: type=uint8_t, direction=IN
          arg response: type=uint64_t, direction=OUT
        IsKeyBitLengthSupported
          arg extenId: type=uint8_t, direction=IN
          arg keyBitLength: type=uint32_t, direction=IN
          arg response: type=uint64_t, direction=OUT
        IsKeyAvailable
          arg extenId: type=uint8_t, direction=IN
          arg response: type=returnBool, direction=OUT
