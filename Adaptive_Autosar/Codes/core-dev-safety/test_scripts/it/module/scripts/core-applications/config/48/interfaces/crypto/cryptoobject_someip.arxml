AUTOSAR XML (schema 00048)
package /SomeIpServiceInterfaceDeployment
  someip service interface deployment CryptoObject_Someip: service-interface=CryptoObject, service-interface-id=80, service-interface-version={major-version=0, minor-version=0}
    8 x someip method deployment, all with transport-protocol=UDP:
      Downcast: method=Downcast, method-id=1
      GetCryptoPrimitiveId: method=GetCryptoPrimitiveId, method-id=2
      GetObjectId: method=GetObjectId, method-id=3
      GetPayloadSize: method=GetPayloadSize, method-id=4
      HasDependence: method=HasDependence, method-id=5
      IsExportable: method=IsExportable, method-id=6
      IsSession: method=IsSession, method-id=7
      Save: method=Save, method-id=8
