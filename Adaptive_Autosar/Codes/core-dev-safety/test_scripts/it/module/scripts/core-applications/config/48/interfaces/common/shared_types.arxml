AUTOSAR XML (schema 00048)
package /CppImplementationDataTypes
  30 x std cpp implementation data type:
    String: category=STRING, type-emitter=TYPE_EMITTER_ARA
      namespaces:
        symbol props ara
        symbol props core
        symbol props string
    returnGenerateResponse: category=STRUCTURE, type-emitter=TYPE_EMITTER_ARA
      cpp implementation data type element errorValue: category=VALUE, type-reference=uint64_t
      cpp implementation data type element data: type-reference=ByteArray
    ByteArray: category=VECTOR, cpp-template-argument=uint8_t, type-emitter=TYPE_EMITTER_ARA
    returnResponse: category=STRUCTURE, type-emitter=TYPE_EMITTER_ARA
      cpp implementation data type element ack: category=VALUE, type-reference=uint8_t
      cpp implementation data type element return_value_bsw: category=VALUE, type-reference=uint8_t
    uint32_t: category=VALUE, base-type=std_int32_t, type-emitter=cstdint
    uint64_t: category=VALUE, base-type=std_uint64_t, type-emitter=cstdint
    uint8_t: category=VALUE, base-type=std_uint8_t, type-emitter=cstdint
    uint16_t: category=VALUE, base-type=std_int16_t, type-emitter=cstdint
    int8_t: category=VALUE, base-type=std_int8_t, type-emitter=cstdint
    int16_t: category=VALUE, base-type=std_int16_t, type-emitter=cstdint
    int64_t: category=VALUE, base-type=std_int64_t, type-emitter=cstdint
    float: category=VALUE
    double: category=VALUE
    bool: category=VALUE
    int32_t: category=VALUE, base-type=std_int32_t, type-emitter=cstdint
    LongArray: category=ARRAY, array-size=3, cpp-template-argument=uint64_t
    returnValues: category=STRUCTURE, type-emitter=TYPE_EMITTER_ARA
      cpp implementation data type element return_value_testcom: category=VALUE, type-reference=uint8_t
      cpp implementation data type element return_value_bsw: category=VALUE, type-reference=uint8_t
    returnStartResponse: category=STRUCTURE, type-emitter=TYPE_EMITTER_ARA
      cpp implementation data type element errorValue: type-reference=uint64_t
      cpp implementation data type element data: type-reference=uint8_t
    returnUpdateResponse: category=STRUCTURE, type-emitter=TYPE_EMITTER_ARA
      cpp implementation data type element errorValue: category=VALUE, type-reference=uint64_t
      cpp implementation data type element data: type-reference=uint8_t
    returnFinishResponse: category=STRUCTURE, type-emitter=TYPE_EMITTER_ARA
      cpp implementation data type element errorValue: category=VALUE, type-reference=uint64_t
      cpp implementation data type element data: type-reference=ByteArray
    returnGetDigestResponse: category=STRUCTURE, type-emitter=TYPE_EMITTER_ARA
      cpp implementation data type element errorValue: category=VALUE, type-reference=uint64_t
      cpp implementation data type element data: type-reference=ByteArray
    bool: category=VALUE, type-emitter=cstint
    returnCryptoTransform: category=STRUCTURE, type-emitter=TYPE_EMITTER_ARA
      cpp implementation data type element errorValue: category=VALUE, type-reference=uint64_t
      cpp implementation data type element data: type-reference=uint64_t
    returnEncryptData: category=STRUCTURE, type-emitter=TYPE_EMITTER_ARA
      cpp implementation data type element errorValue: category=VALUE, type-reference=uint64_t
      cpp implementation data type element data: type-reference=ByteArray
    returnProcessBlocks: category=STRUCTURE, type-emitter=TYPE_EMITTER_ARA
      cpp implementation data type element errorValue: category=VALUE, type-reference=uint64_t
      cpp implementation data type element data: type-reference=ByteArray
    returnProcessBytes: category=STRUCTURE, type-emitter=TYPE_EMITTER_ARA
      cpp implementation data type element errorValue: category=VALUE, type-reference=uint64_t
      cpp implementation data type element data: type-reference=ByteArray
    returnBool: category=STRUCTURE, type-emitter=TYPE_EMITTER_ARA
      cpp implementation data type element errorValue: category=VALUE, type-reference=uint64_t
      cpp implementation data type element data: type-reference=CppImplementationDataTypes/bool
    returnByteArray: category=STRUCTURE, type-emitter=TYPE_EMITTER_ARA
      cpp implementation data type element errorValue: category=VALUE, type-reference=uint64_t
      cpp implementation data type element data: type-reference=ByteArray
    returnString: category=STRUCTURE, type-emitter=TYPE_EMITTER_ARA
      cpp implementation data type element string: type-reference=String
      cpp implementation data type element errorValue: type-reference=uint64_t
    TransferIdType_Canoe: category=ARRAY, array-size=16, cpp-template-argument=uint8_t, type-emitter=TYPE_EMITTER_ARA
