AUTOSAR XML (schema 00048)
package /ServiceInstanceToPortMapping
  service instance to port prototype mapping PrivateKeyToPortPrototypeMapping: port-prototype=rootSwComponentPrototype.PPortPrivateKey, process=qt_crypto_instance1, service-instance=PrivateKey
