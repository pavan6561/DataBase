AUTOSAR XML (schema 00048)
package /Process
  process crypto_core: executable=crypto_core, state-dependent-startup-config{function-group-state=MachineFG.Startup, resource-group=ResourceGroups2, startup-config=crypto_core_startupconfig}
package /Executables
  executable crypto_core
    root sw component prototype rootSwComponentPrototype: application-type=crypto_core
package /AdaptiveApplicationSwComponets
  adaptive application sw component type crypto_core: category=APPLICATION_LEVEL
