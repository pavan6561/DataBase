AUTOSAR XML (schema 00048)
package /ServiceInstances
  provided someip service instance X509Provider: service-interface-deployment=X509Provider_Someip, sd-server-config=SomeipSdServerServiceInstance, service-instance-id=1
package /ServiceInstanceToMachineMappings
  6 x someip service instance to machine mapping, all with communication-connector=EthernetCommunicationConnector:
    X509ProviderInterfaceToMachineMapping: service-instance=X509Provider, tcp-port=4031
    BasicCertInfoToMachineMapping: service-instance=BasicCertInfo, udp-port=4036
    CertificateToMachineMapping: service-instance=Certificate, tcp-port=4032
    CertSignRequestToMachineMapping: service-instance=CertSignRequest, udp-port=4035
    X509PublicKeyInfoToMachineMapping: service-instance=X509PublicKeyInfo, tcp-port=4033
    X509DNToMachineMapping: service-instance=X509DN, tcp-port=4034
