AUTOSAR XML (schema 00049)
package /AdaptiveApplicationSwComponentTypes
  adaptive application sw component type qt_statemanager: category=APPLICATION_LEVEL
    provide port PStateManager: provided-interface=StateManager
package /Executables
  executable qt_statemanager
    root sw component prototype rootSwComponentPrototype: application-type=qt_statemanager
package /ProcessDesign
  process design qt_statemanager: executable=qt_statemanager
