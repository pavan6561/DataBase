AUTOSAR XML (schema 00048)
package /ServiceInstanceToPortMapping
  service instance to port prototype mapping RequiredUpdateRequestCanoeInstanceToPortPrototypeMapping: port-prototype=rootSwComponentPrototype_sm_ucm_stub.RPortPrototype_sm_ucm_stub, process=statemanager, service-instance=UpdateRequest_Canoe_Required
