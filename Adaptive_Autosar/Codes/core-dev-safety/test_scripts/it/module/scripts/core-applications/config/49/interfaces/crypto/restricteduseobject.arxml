AUTOSAR XML (schema 00049)
package /ServiceInterface
  service interface RestrictedUseObject
    namespaces:
      4 x symbol props:
        qt
        crypto
        cryptoprovider_001
        restricteduseobject
    methods:
      operation GetAllowedUsage: possible-ap-error=UndefinedApplicationError
        arg response: type=uint64_t, direction=OUT
        arg instanceId: type=uint8_t, direction=IN
        arg whichObject: type=uint8_t, direction=IN
