AUTOSAR XML (schema 00049)
package /SomeIpServiceInterfaceDeployment
  someip service interface deployment MessageAuthCodeCtx_Someip: service-interface=MessageAuthCodeCtx, service-interface-id=50, service-interface-version={major-version=0, minor-version=0}
    14 x someip method deployment, all with transport-protocol=UDP:
      Check: method=Check, method-id=1
      Finish: method=Finish, method-id=2
      GetDigestService: method=GetDigestService, method-id=3
      GetDigest: method=GetDigest, method-id=4
      Reset: method=Reset, method-id=5
      SetKey: method=SetKey, method-id=6
      StartReadOnlyMemRegion: method=StartReadOnlyMemRegion, method-id=7
      StartSecretSeed: method=StartSecretSeed, method-id=8
      UpdateReadOnlyMemRegion: method=UpdateReadOnlyMemRegion, method-id=9
      Update: method=Update, method-id=10
      UpdateRestrictedUseObject: method=UpdateRestrictedUseObject, method-id=11
      isInitialized: method=isInitialized, method-id=12
      GetCryptoPrimitiveId: method=GetCryptoPrimitiveId, method-id=13
      VerifyMyProvider: method=VerifyMyProvider, method-id=14
