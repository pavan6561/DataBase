AUTOSAR XML (schema 00049)
package /ara/ucm/pkgmgr/portinterfaces
  service interface VehicleStateManager
    namespaces:
      symbol props ara
      symbol props ucm
    field SafetyPolicy: type=SafetyPolicyType, has-getter=true, has-notifier=true, has-setter=false  # Vehicle state computed by the Vehicle State Manager Adaptive Application.Vehicle state computed by the Vehicle State Manager Adaptive Application.
    methods:
      operation SafetyState: fire-and-forget=false  # To allow a new campaign to startTo allow a new campaign to start
        arg SafetyPolicy: type=SafetyPolicyType, direction=IN
        arg SafeToUpdate: type=bool, direction=OUT
