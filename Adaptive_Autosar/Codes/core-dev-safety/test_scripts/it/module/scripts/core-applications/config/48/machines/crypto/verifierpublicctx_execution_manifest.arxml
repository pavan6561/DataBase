AUTOSAR XML (schema 00048)
package /ServiceInstanceToPortMapping
  service instance to port prototype mapping VerifierPublicCtxToPortMapping: port-prototype=rootSwComponentPrototype.PPortVerifierPublicCtx, process=qt_crypto_instance1, service-instance=VerifierPublicCtx
