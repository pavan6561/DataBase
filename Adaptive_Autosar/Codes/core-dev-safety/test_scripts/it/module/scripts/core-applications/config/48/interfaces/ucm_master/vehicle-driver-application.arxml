AUTOSAR XML (schema 00048)
package /ara/ucm/pkgmgr/portinterfaces
  service interface VehicleDriverApplication: is-service=true
    namespaces:
      symbol props ara
      symbol props ucm
    4 x field, all with has-getter=true, has-notifier=true, has-setter=false:
      ApprovalRequired: type=bool  # Flag to inform Adaptive Application if approval from Vehicle Driver is required at current state based on Vehicle Package Manifest.
      CampaignState: type=CampaignStateType  # The current status of Campaign.
      SafetyPolicy: type=SafetyPolicyType  # Safety policy from the Vehicle Package to be computed by the Vehicle State Manager Adaptive Application.
      SafetyState: type=bool  # Vehicle state computed by the Vehicle State Manager Adaptive Application.
    methods:
      8 x operation, all with fire-and-forget=false:
        AllowCampaign  # To allow a new campaign to start
        CancelCampaign: possible-ap-error=[CancelFailed, InvalidTransferId, OperationNotPermitted]  # This method aborts an ongoing campaign processing of a Vehicle Package.
          arg DisableCampaign: type=bool, direction=IN  # To forbid new campaign
        DriverApproval  # Called by Adaptive Application to inform UCM Master of the driver's notification resolution (approve or reject)
          arg Approval: type=bool, direction=IN  # Driver's notification resolution
          arg SafetyPolicy: type=SafetyPolicyType, direction=IN  # Safety policy computed by the Vehicle State Manager Adaptive Application
        GetCampaignHistory  # Getter method to retrieve all actions that have been performed by UCM Master.
          arg timestampGE: type=uint64_t, direction=IN  # Earliest timestamp (inclusive)
          arg timestampLT: type=uint64_t, direction=IN  # Latest timestamp (exclusive)
          arg history: type=CampaignHistoryType, direction=OUT  # The history of all actions that have been performed by UCM Master.
        GetSwClusterDescription  # This method returns the general information of the Software Clusters present in the Adaptive Platform
          arg SoftwareClusterDescriptions: type=SwDescVectorType, direction=OUT  # List of SoftwareClusters general information
        GetSwPackageDescription  # This method returns the general information of the Software Packages that are part of current campaign handled by UCM Master.
          arg Packages: type=SwDescVectorType, direction=OUT  # List of Software Packages.
        GetSwProcessProgress  # Get the progress (0 - 100%) of the currently package processing.
          arg progress: type=uint8_t, direction=OUT  # The progress of the current package processing (0% - 100%). 0x00 ... 0x64, 0xFF for "‘No information available"’
        GetSwTransferProgress: possible-ap-error=[InsufficientComputationPower, InsufficientMemory, UnexpectedPackage]  # Get the progress (0 - 100%) of the currently package transferring.
          arg progress: type=uint8_t, direction=OUT  # The progress of the current package transferring (0% - 100%). 0x00 ... 0x64, 0xFF for "‘No information available"’
