AUTOSAR XML (schema 00048)
package /ServiceInstanceToPortMapping
  service instance to port prototype mapping MessageAuthCodeCtxToPortMapping: port-prototype=rootSwComponentPrototype.PPortMessageAuthCodeCtx, process=qt_crypto_instance1, service-instance=MessageAuthCodeCtx
