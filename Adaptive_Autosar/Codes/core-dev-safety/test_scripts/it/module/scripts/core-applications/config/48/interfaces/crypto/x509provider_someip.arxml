AUTOSAR XML (schema 00048)
package /ServiceInterfaceDeployments
  someip service interface deployment X509Provider_Someip: service-interface=X509Provider, service-interface-id=39, service-interface-version={major-version=0, minor-version=0}
    18 x someip method deployment, all with transport-protocol=TCP:
      LoadX509Provider: method=LoadX509Provider, method-id=1
      BuildDn: method=BuildDn, method-id=2
      CreateCertSignRequest: method=CreateCertSignRequest, method-id=3
      CountCertsInChain: method=CountCertsInChain, method-id=4
      CreateEmptyDn: method=CreateEmptyDn, method-id=5
      DecodeDn: method=DecodeDn, method-id=6
      FindCertByDn: method=FindCertByDn, method-id=7
      FindCertByKeyIds: method=FindCertByKeyIds, method-id=8
      FindCertBySn: method=FindCertBySn, method-id=9
      ParseCertSignRequest: method=ParseCertSignRequest, method-id=10
      Import: method=Import, method-id=11
      LoadCertificate: method=LoadCertificate, method-id=12
      ParseCertChain: method=ParseCertChain, method-id=13
      ParseCert: method=ParseCert, method-id=14
      Remove: method=Remove, method-id=15
      VerifyCert: method=VerifyCert, method-id=16
      VerifyCertChain: method=VerifyCertChain, method-id=17
      ParseCertChainVector: method=ParseCertChainVector, method-id=18
