AUTOSAR XML (schema 00048)
package /ServiceInterfaces
  service interface CryptoProvider
    namespaces:
      symbol props qt
      symbol props crypto
      symbol props cryptoprovider_001
    methods:
      21 x operation:
        CreateAuthCipherCtx: possible-ap-error=[InvalidArgument, UnknownIdentifier, UndefinedApplicationError]
          4 x arg:
            instanceSpecifier: type=String, direction=IN
            authId: type=uint8_t, direction=IN
            algName: type=String, direction=IN
            response: type=uint64_t, direction=OUT
        CreateHashFunctionCtx: possible-ap-error=[InvalidArgument, UnknownIdentifier, UndefinedApplicationError]
          4 x arg:
            instanceSpecifier: type=String, direction=IN
            hashId: type=uint8_t, direction=IN
            algName: type=String, direction=IN
            response: type=uint64_t, direction=OUT
        CreateKeyDerivationFunctionCtx: possible-ap-error=[InvalidArgument, UnknownIdentifier]
          4 x arg:
            instanceSpecifier: type=String, direction=IN
            kdfId: type=uint8_t, direction=IN
            algName: type=String, direction=IN
            response: type=uint64_t, direction=OUT
        CreateMessageAuthCodeCtx: possible-ap-error=[InvalidArgument, UnknownIdentifier]
          4 x arg:
            instanceSpecifier: type=String, direction=IN
            macId: type=uint8_t, direction=IN
            algName: type=String, direction=IN
            response: type=uint64_t, direction=OUT
        CreateRandomGeneratorCtx: possible-ap-error=[BusyResource, UnknownIdentifier, UndefinedApplicationError]
          5 x arg:
            instanceSpecifier: type=String, direction=IN
            rngId: type=uint8_t, direction=IN
            algName: type=String, direction=IN
            initialize: type=bool, direction=IN
            response: type=uint64_t, direction=OUT
        CreateStreamCipherCtx: possible-ap-error=[InvalidArgument, UnknownIdentifier]
          4 x arg:
            instanceSpecifier: type=String, direction=IN
            streamId: type=uint8_t, direction=IN
            algName: type=String, direction=IN
            response: type=uint64_t, direction=OUT
        CreateSymmetricBlockCipherCtx: possible-ap-error=UnknownIdentifier
          4 x arg:
            instanceSpecifier: type=String, direction=IN
            blockId: type=uint8_t, direction=IN
            algName: type=String, direction=IN
            response: type=uint64_t, direction=OUT
        CreateSymmetricKeyWrapperCtx: possible-ap-error=[InvalidArgument, UnknownIdentifier]
          4 x arg:
            instanceSpecifier: type=String, direction=IN
            kwrapId: type=uint8_t, direction=IN
            algName: type=String, direction=IN
            response: type=uint64_t, direction=OUT
        LoadCryptoProvider
          arg instanceSpecifier: type=String, direction=IN
          arg response: type=uint8_t, direction=OUT
        ConvertToAlgId
          arg primitiveName: type=String, direction=IN
          arg response: type=uint16_t, direction=OUT
          arg instanceSpecifier: type=String, direction=IN
        CreateSignature: possible-ap-error=[UnknownIdentifier, InvalidArgument, IncompatibleArguments, InvalidInputSize, UndefinedApplicationError]
          8 x arg:
            instanceSpecifier: type=String, direction=IN
            singnatureInsatanceId: type=uint16_t, direction=IN
            signAlgId: type=String, direction=IN
            value: type=ByteArray, direction=IN
            key: type=uint64_t, direction=IN
            hashAlgId: type=uint64_t, direction=IN
            response: type=uint64_t, direction=OUT
            whichObject: type=uint8_t, direction=IN
        GenerateSymmetricKey: possible-ap-error=[UnknownIdentifier, IncompatibleArguments, UndefinedApplicationError]
          7 x arg:
            instanceSpecifier: type=String, direction=IN
            algName: type=String, direction=IN
            instanceKeyId: type=uint16_t, direction=IN
            allowedUsage: type=uint32_t, direction=IN
            isSession: type=bool, direction=IN
            isExportable: type=bool, direction=IN
            response: type=uint64_t, direction=OUT
        GenerateSeed: possible-ap-error=[UnknownIdentifier, IncompatibleArguments, UndefinedApplicationError]
          7 x arg:
            instanceSpecifier: type=String, direction=IN
            algName: type=String, direction=IN
            instanceSeedId: type=uint16_t, direction=IN
            allowedUsage: type=uint32_t, direction=IN
            isSession: type=bool, direction=IN
            isExportable: type=bool, direction=IN
            response: type=uint64_t, direction=OUT
        CreateEncryptorPublicCtx: possible-ap-error=[InvalidArgument, UnknownIdentifier, UndefinedApplicationError]
          4 x arg:
            instanceSpecifier: type=String, direction=IN
            encryptPublicCtxId: type=uint8_t, direction=IN
            algName: type=String, direction=IN
            response: type=uint64_t, direction=OUT
        CreateDecryptorPrivateCtx: possible-ap-error=[UnknownIdentifier, InvalidArgument, UndefinedApplicationError]
          4 x arg:
            instanceSpecifier: type=String, direction=IN
            decryptPrivateCtxId: type=uint8_t, direction=IN
            algName: type=String, direction=IN
            response: type=uint64_t, direction=OUT
        GeneratePrivateKey: possible-ap-error=[UnknownIdentifier, IncompatibleArguments, UndefinedApplicationError]
          7 x arg:
            instanceSpecifier: type=String, direction=IN
            algName: type=String, direction=IN
            keyInstanceId: type=uint8_t, direction=IN
            allowedUsage: type=uint32_t, direction=IN
            isSession: type=bool, direction=IN
            isExportable: type=bool, direction=IN
            response: type=uint64_t, direction=OUT
        CreateVerifierPublicCtx: possible-ap-error=[InvalidArgument, UnknownIdentifier, UndefinedApplicationError]
          4 x arg:
            instanceSpecifier: type=String, direction=IN
            verifierId: type=uint8_t, direction=IN
            algName: type=String, direction=IN
            response: type=uint64_t, direction=OUT
        CreateSignerPrivateCtx: possible-ap-error=[InvalidArgument, UnknownIdentifier, UndefinedApplicationError]
          4 x arg:
            instanceSpecifier: type=String, direction=IN
            signerId: type=uint8_t, direction=IN
            algName: type=String, direction=IN
            response: type=uint64_t, direction=OUT
        CreateSigEncodePrivateCtx: possible-ap-error=[InvalidArgument, UnknownIdentifier, UndefinedApplicationError]
          4 x arg:
            instanceSpecifier: type=String, direction=IN
            encodeId: type=uint8_t, direction=IN
            algName: type=String, direction=IN
            response: type=uint64_t, direction=OUT
        CreateMsgRecoveryPublicCtx: possible-ap-error=[InvalidArgument, UnknownIdentifier, UndefinedApplicationError]
          4 x arg:
            instanceSpecifier: type=String, direction=IN
            msgId: type=uint8_t, direction=IN
            algName: type=String, direction=IN
            response: type=uint64_t, direction=OUT
        ConvertToAlgName: possible-ap-error=[UnknownIdentifier, UndefinedApplicationError]
          arg algId: type=uint16_t, direction=IN
          arg instanceSpecifier: type=String, direction=IN
          arg response: type=returnString, direction=OUT
