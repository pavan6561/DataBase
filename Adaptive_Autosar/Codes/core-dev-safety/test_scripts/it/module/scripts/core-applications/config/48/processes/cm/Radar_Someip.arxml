AUTOSAR XML (schema 00048)
package /ServiceInterfaceDeployments
  someip service interface deployment Radar_Someip: service-interface=Radar, service-interface-id=99, service-interface-version={major-version=0, minor-version=0}
    someip event deployment BrakeEvent_Someip: event=BrakeEvent, event-id=1, transport-protocol=UDP
    someip field deployment UpdateRate_Someip: field=UpdateRate
      get get: method-id=3001, transport-protocol=UDP
      notifier notifier: event-id=3000, transport-protocol=UDP
      set set: method-id=300, transport-protocol=UDP
    someip method deployment Adjust_Someip: method=Adjust, method-id=32000, transport-protocol=UDP
    someip method deployment Calibrate_Someip: method=Calibrate, method-id=32010, transport-protocol=UDP
    someip method deployment Update_Someip: method=Update, method-id=32020, transport-protocol=UDP
    someip event group SomeipEventGroup: event-group-id=1, event=BrakeEvent_Someip
    someip event group SomeipEventGroupField: event-group-id=3, event=notifier
