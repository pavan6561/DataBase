AUTOSAR XML (schema 00049)
package /Machines
  machine QtMachine: default-application-timeout=exit-timeout-value=1.0, machine-design=QtMachine
    os module instantiation Linux
      resource group ResourceGroup: cpu-usage=95, mem-usage=2000000000
      resource group ResourceGroups2: cpu-usage=95, mem-usage=2000000000
    crypto module instantiation CryptoModuleInstantiation
      crypto provider CryptoOpenSSLProvider: category=OpenSSL
        crypto key slot DefaultKeySlot: crypto-alg-id=PBKDF2, crypto-object-type=SYMMETRIC-KEY, key-slot-allowed-modification={allow-content-type-change=true, exportability=true, max-number-of-allowed-updates=4, restrict-update=false}, key-slot-content-allowed-usages=[allowed-keyslot-usage=ALLOW-DATA-DECRYPTION, allowed-keyslot-usage=ALLOW-DATA-DECRYPTION], slot-capacity=128, slot-type=MACHINE
    ucm module instantiation UcmModuleInstantiation: identifier=1
    processor Processors
      processor core Cores0: core-id=0
