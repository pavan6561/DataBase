AUTOSAR XML (schema 00048)
package /ServiceInterfaceDeployments
  someip service interface deployment UpdateAdapter_Someip: service-interface=UpdateAdapter, service-interface-id=1415, service-interface-version={major-version=0, minor-version=0}
    someip field deployment UpdateStatus: field=UpdateStatus
      get getUpdateStatus: method-id=1, transport-protocol=TCP
      notifier onUpdateStatus: event-id=32770, transport-protocol=UDP
    someip method deployment SetActivateStatus: method=SetActivateStatus, method-id=3, transport-protocol=TCP
    someip method deployment SetRollbackStatus: method=SetRollbackStatus, method-id=4, transport-protocol=TCP
    someip event group onUpdateStatus: event-group-id=1, event=onUpdateStatus
