AUTOSAR XML (schema 00049)
package /SomeIpServiceInterfaceDeployment
  someip service interface deployment SymmetricBlockCipherCtx_Someip: service-interface=SymmetricBlockCipherCtx, service-interface-id=32, service-interface-version={major-version=0, minor-version=0}
    9 x someip method deployment, all with transport-protocol=UDP:
      GetCryptoService: method=GetCryptoService, method-id=1
      GetTransformation: method=GetTransformation, method-id=2
      IsMaxInputOnly: method=IsMaxInputOnly, method-id=3
      IsMaxOutputOnly: method=IsMaxOutputOnly, method-id=4
      ProcessBlocksuppressPadding: method=ProcessBlocksuppressPadding, method-id=5
      ProcessBlocks: method=ProcessBlocks, method-id=6
      Reset: method=Reset, method-id=7
      SetKey: method=SetKey, method-id=8
      isInitialized: method=isInitialized, method-id=9
