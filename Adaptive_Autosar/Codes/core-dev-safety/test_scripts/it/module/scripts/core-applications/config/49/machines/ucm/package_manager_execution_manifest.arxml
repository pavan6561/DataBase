AUTOSAR XML (schema 00049)
package /Processes
  process package_manager: design=package_manager, executable=package_manager, state-dependent-startup-config{function-group-state=MachineFG.Startup, resource-group=ResourceGroup, startup-config=package_manager_startupconfig}
package /ServiceInstanceToPortPrototypeMappings
  service instance to port prototype mapping PackageManagementToRequiredPortMapping: port-prototype=rootSwComponentPrototype.RPortPackageManagement, process-design=qt_ucm_instance1, process=qt_ucm_instance1, service-instance=PackageManagementRequired
  service instance to port prototype mapping PackageManagementToProvidedPortMapping: port-prototype=rootSwComponentPrototype.PPortPackageManagement, process-design=package_manager, process=package_manager, service-instance=PackageManagementProvided
  service instance to port prototype mapping UpdateAdapterToProvidedPortMapping: port-prototype=rootSwComponentPrototype.PUpdateAdapter, process-design=package_manager, process=package_manager, service-instance=UpdateAdapterProvided
