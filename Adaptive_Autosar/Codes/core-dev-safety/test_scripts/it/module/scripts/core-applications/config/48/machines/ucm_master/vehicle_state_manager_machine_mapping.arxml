AUTOSAR XML (schema 00048)
package /ServiceInstanceToMachineMapping
  someip service instance to machine mapping QtVSMAppicationToMachineMapping: communication-connector=EthernetCommunicationConnector, service-instance=ProvidedSomeipApplicationVehicleStateManagerInstance, udp-port=8004
