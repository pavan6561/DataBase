AUTOSAR XML (schema 00048)
package /Processes
  process ara_dlt_daemon: design=ara_dlt_aemon, executable=ara_dlt_daemon, state-dependent-startup-config{function-group-state=MachineFG.Startup, resource-group=ResourceGroup, startup-config=ara_dlt_daemon_startupconfig}
    process state machine AraDltDaemon: type=ProcessStateMachine
package /Executables
  executable ara_dlt_daemon
    root sw component prototype rootSwComponentPrototype: application-type=ara_dlt_deamon
package /ProcessDesign
  process design ara_dlt_aemon: executable=ara_dlt_daemon
package /AdaptiveApplicationSwComponents
  adaptive application sw component type ara_dlt_deamon: category=APPLICATION_LEVEL
