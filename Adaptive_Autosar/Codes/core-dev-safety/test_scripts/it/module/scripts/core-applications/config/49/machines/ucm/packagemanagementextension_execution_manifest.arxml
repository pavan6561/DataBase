AUTOSAR XML (schema 00049)
package /ServiceInstanceToPortPrototypeMappings
  service instance to port prototype mapping UpdateAdapterToRequiredPortMapping: port-prototype=rootSwComponentPrototype.UpdateAdapterRport, process-design=qt_ucm_updateadapter, process=qt_ucm_updateadapter, service-instance=UpdateAdapterRequired
