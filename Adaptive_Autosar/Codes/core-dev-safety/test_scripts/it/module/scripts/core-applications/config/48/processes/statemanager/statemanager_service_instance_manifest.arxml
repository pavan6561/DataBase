AUTOSAR XML (schema 00048)
package /ServiceInstances
  provided someip service instance StateManager: service-interface-deployment=StateManager_Someip, sd-server-config=SomeipSdServerServiceInstance, service-instance-id=2
package /ServiceInstanceToMachineMappings
  someip service instance to machine mapping StateManagerToMachineMapping: communication-connector=EthernetCommunicationConnector, service-instance=StateManager, udp-port=2001
