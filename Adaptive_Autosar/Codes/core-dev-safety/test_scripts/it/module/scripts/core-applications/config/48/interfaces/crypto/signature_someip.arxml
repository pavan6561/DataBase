AUTOSAR XML (schema 00048)
package /SomeIpServiceInterfaceDeployment
  someip service interface deployment Signature_Someip: service-interface=Signature, service-interface-id=79, service-interface-version={major-version=0, minor-version=0}
    someip method deployment GetHashAlgId: method=GetHashAlgId, method-id=1, transport-protocol=UDP
    someip method deployment GetRequiredHashSize: method=GetRequiredHashSize, method-id=2, transport-protocol=UDP
