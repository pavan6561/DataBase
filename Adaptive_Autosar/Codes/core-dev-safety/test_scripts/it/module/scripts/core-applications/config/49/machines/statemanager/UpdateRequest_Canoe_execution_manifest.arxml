AUTOSAR XML (schema 00049)
package /ServiceInstanceToPortMapping
  service instance to port prototype mapping RequiredUpdateRequestCanoeInstanceToPortPrototypeMapping: port-prototype=rootSwComponentPrototype_ucm_sm_stub.RPortPrototype_sm_ucm_stub, process=statemanager, service-instance=UpdateRequest_Canoe_Required
