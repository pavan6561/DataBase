AUTOSAR XML (schema 00048)
package /Processes
  process ara_someip_routing_daemon: design=ara_someip_routing_daemon, executable=ara_someip_routing_daemon, state-dependent-startup-config{function-group-state=[MachineFG.Shutdown, MachineFG.Restart, MachineFG.Startup], resource-group=ResourceGroup, startup-config=ara_someip_routing_daemon_startupconfig}
    process state machine AraSomeipRoutingDaemonStateMachine: type=ProcessStateMachine
package /Executables
  executable ara_someip_routing_daemon
    root sw component prototype rootSwComponentPrototype: application-type=ara_vsomeipd
package /ProcessDesign
  process design ara_someip_routing_daemon: executable=ara_someip_routing_daemon
package /AdaptiveApplicationSwComponents
  adaptive application sw component type ara_vsomeipd: category=APPLICATION_LEVEL
