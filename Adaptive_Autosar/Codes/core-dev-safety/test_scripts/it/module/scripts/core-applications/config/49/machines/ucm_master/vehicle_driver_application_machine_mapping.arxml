AUTOSAR XML (schema 00049)
package /ServiceInstanceToMachineMapping
  someip service instance to machine mapping QtDriverApplicationToMachineMapping: communication-connector=EthernetCommunicationConnector, service-instance=ProvidedSomeIpApplicationVehicleDriverManagement, udp-port=8003
