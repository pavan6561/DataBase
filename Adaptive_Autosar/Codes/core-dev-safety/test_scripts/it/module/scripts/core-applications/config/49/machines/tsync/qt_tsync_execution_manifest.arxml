AUTOSAR XML (schema 00049)
package /Processes
  process qt_tsync_instance1: design=qt_tsync_instance1, executable=qt_tsync_instance1, state-dependent-startup-config{function-group-state=[TSyncApplicationStates.TSync_Instance1, TSyncApplicationStates.TSync_Core_Off], resource-group=ResourceGroup, startup-config=qt_tsync_instance1_startupConfig}
  process tsync_core: design=tsync_coreProcessDesign, executable=tsync_core, state-dependent-startup-config{function-group-state=TSyncApplicationStates.TSync_Instance1, resource-group=ResourceGroup, startup-config=tsync_core_startupConfig}
package /StartupConfigSets
  mode declaration group TSyncApplicationStates: initial-mode=Off
    4 x mode:
      TSync_Instance1
      Off
      Verify
      TSync_Core_Off
  startup config set TSyncStartupConfigSet
    startup config qt_tsync_instance1_startupConfig: environment-variables=tag-with-optional-value={key=LOG_CONFIG_PATH, value=/opt/qt_tsync_instance1/etc/log_config.json}, scheduling-policy=SCHEDULING-POLICY-ROUND-ROBIN, scheduling-priority=12
    startup config tsync_core_startupConfig: scheduling-policy=SCHEDULING-POLICY-ROUND-ROBIN, scheduling-priority=12
      environment-variables:
        key=LOG_CONFIG_PATH, value=/opt/tsync_core/etc/log_config.json
        key=TSYNC_CORE_MANIFEST, value=/opt/tsync_core/etc/tsync_core.json
package /ProcessToMachine
  process to machine mapping set TSyncProcessToMachineMappingSet
    process to machine mapping qt_tsync_instance1_processToMachine: machine=QtMachine, process=qt_tsync_instance1, shall-not-run-on=Cores0
    process to machine mapping tsync_core_processToMachineMappings: machine=QtMachine, process=tsync_core, shall-not-run-on=Cores0
package /FunctionGroupSet
  function group set TSyncFunctionGroupSet
    function-groups:
      mode declaration group prototype TSyncApplicationStates: type=TSyncApplicationStates
package /Softwarecluster
  software cluster TSyncSoftwareCluster: category=PLATFORM_CORE, claimed-function-group=TSyncApplicationStates, contained-process=[qt_tsync_instance1, tsync_core]
