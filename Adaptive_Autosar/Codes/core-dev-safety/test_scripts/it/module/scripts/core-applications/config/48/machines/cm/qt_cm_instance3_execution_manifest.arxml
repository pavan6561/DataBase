AUTOSAR XML (schema 00048)
package /ProcessDesigns
  process design qt_cm_instance3: executable=qt_cm_instance3
package /Processes
  process qt_cm_instance3: design=qt_cm_instance3, executable=qt_cm_instance3, state-dependent-startup-config{function-group-state=ComApplicationStates.Com_Instance3, resource-group=ResourceGroups2, startup-config=qt_cm_instance3_startupconfig}
