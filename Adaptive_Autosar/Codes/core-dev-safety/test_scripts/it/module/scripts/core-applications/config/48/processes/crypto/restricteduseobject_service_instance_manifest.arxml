AUTOSAR XML (schema 00048)
package /ServiceInstances
  provided someip service instance RestrictedUseObject: service-interface-deployment=RestrictedUseObject_Someip, sd-server-config=SomeipSdServerServiceInstance, service-instance-id=1
package /ServiceInstanceToMachineMappings
  someip service instance to machine mapping RestrictedUseObjectToMachineMapping: communication-connector=EthernetCommunicationConnector, service-instance=RestrictedUseObject, udp-port=4025
