AUTOSAR XML (schema 00049)
package /SomeIpServiceInterfaceDeployment
  someip service interface deployment SigEncodePrivateCtx_Someip: service-interface=SigEncodePrivateCtx, service-interface-id=37, service-interface-version={major-version=0, minor-version=0}
    5 x someip method deployment, all with transport-protocol=UDP:
      GetMaxInputSize: method=GetMaxInputSize, method-id=1
      GetMaxOutputSize: method=GetMaxOutputSize, method-id=2
      SignAndEncode: method=SignAndEncode, method-id=3
      Reset: method=Reset, method-id=4
      SetKey: method=SetKey, method-id=5
