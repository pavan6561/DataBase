AUTOSAR XML (schema 00048)
package /ServiceInstances
  provided someip service instance X509DN: service-interface-deployment=X509DN_Someip, sd-server-config=SomeipSdServerServiceInstance, service-instance-id=1
