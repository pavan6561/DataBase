AUTOSAR XML (schema 00049)
package /ServiceInstances
  provided someip service instance CryptoPrimitiveId: service-interface-deployment=CryptoPrimitiveId_Someip, sd-server-config=SomeipSdServerServiceInstance, service-instance-id=1
package /ServiceInstanceToMachineMappings
  someip service instance to machine mapping CryptoPrimitiveIdToMachineMapping: communication-connector=EthernetCommunicationConnector, service-instance=CryptoPrimitiveId, udp-port=4030
