AUTOSAR XML (schema 00049)
package /ServiceInstanceToPortPrototypeMappings
  service instance to port prototype mapping QtPHMInstance1PortMapping0001: port-prototype=rootSwComponentPrototype.PAliveSupervision0001, process-design=qt_phm_instance1, process=qt_phm_instance1, service-instance=qt_phm_instance1
