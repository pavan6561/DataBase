AUTOSAR XML (schema 00048)
package /ServiceInstanceToPortMappings
  service instance to port prototype mapping QtUCMInstance1ToPortMapping: port-prototype=rootSwComponentPrototype.PPortApplicationPackageManagement, process=qt_ucm_instance1, service-instance=qt_ucm_instance1
