AUTOSAR XML (schema 00049)
package /GlobalTimeDomains
  9 x global time domain, all with communication-cluster=Ethernet:
    UTC: domain-id=0, global-time-domain-propertys=eth-global-time-domain-props={destination-physical-address=01:80:C2:00:00:0E, message-compliance=IEEE802-1AS}, sync-loss-timeout=5.0
      global-time-masters:
        global time eth master UTC_Master1: sync-period=2.0, crc-secured=CRC-NOT-SUPPORTED, sub-tlv-config={ofs-sub-tlv=false, status-sub-tlv=false, time-sub-tlv=false, user-data-sub-tlv=false}
      global time eth slave UTC_Slave1: communication-connector=EthernetCommunicationConnector, time-leap-future-threshold=6.0, time-leap-healing-counter=3, time-leap-past-threshold=4.0, crc-validated=CRC-NOT-VALIDATED, time-hardware-correction-threshold=0.0
    GPS: domain-id=1, global-time-domain-propertys=eth-global-time-domain-props={destination-physical-address=01:80:C2:00:00:0E, message-compliance=IEEE802-1AS-AUTOSAR}, sync-loss-timeout=8.0
      global-time-masters:
        global time eth master GPS_Master1: is-system-wide-global-time-master=false, sync-period=2.0, sub-tlv-config={ofs-sub-tlv=true, status-sub-tlv=true, time-sub-tlv=false, user-data-sub-tlv=true}
      global time eth slave GPS_Slave1: crc-validated=CRC-NOT-VALIDATED, time-hardware-correction-threshold=0.0
    KST: domain-id=2, global-time-domain-propertys=eth-global-time-domain-props={destination-physical-address=01:80:C2:00:00:0E, message-compliance=IEEE802-1AS-AUTOSAR}, sync-loss-timeout=5.0
      global-time-masters:
        global time eth master KST_Masters1: communication-connector=EthernetCommunicationConnector, is-system-wide-global-time-master=true, sync-period=10.0, crc-secured=CRC-NOT-SUPPORTED, sub-tlv-config={ofs-sub-tlv=true, status-sub-tlv=true, user-data-sub-tlv=true}
    EST: domain-id=3, global-time-domain-propertys=eth-global-time-domain-props={destination-physical-address=01:80:C2:00:00:0E, eth-global-time-managed-coupling-port{pdelay-latency-threshold=3.0, pdelay-request-period=10.0, pdelay-resp-and-resp-follow-up-timeout=5.0, pdelay-response-enabled=true}, message-compliance=IEEE802-1AS-AUTOSAR}, sync-loss-timeout=5.0
      global-time-masters:
        global time eth master EST_Masters1: communication-connector=EthernetCommunicationConnector, is-system-wide-global-time-master=true, sync-period=5.0, crc-secured=CRC-NOT-SUPPORTED, sub-tlv-config={ofs-sub-tlv=true, status-sub-tlv=true, user-data-sub-tlv=true}
    IST: domain-id=16, global-time-domain-propertys=eth-global-time-domain-props={destination-physical-address=01:80:C2:00:00:0E, message-compliance=IEEE802-1AS-AUTOSAR}, offset-time-domain=GPS, sync-loss-timeout=4.0
      global time eth slave IST_OFS_Slaves1: communication-connector=EthernetCommunicationConnector, time-leap-future-threshold=5.0, time-leap-healing-counter=3, crc-validated=CRC-NOT-VALIDATED, time-hardware-correction-threshold=0.0
    CET: domain-id=17, global-time-domain-propertys=eth-global-time-domain-props={destination-physical-address=01:80:C2:00:00:0E, message-compliance=IEEE802-1AS-AUTOSAR}, offset-time-domain=KST, sync-loss-timeout=4.0
      global-time-masters:
        global time eth master CET_OFS_Masters1: communication-connector=EthernetCommunicationConnector, is-system-wide-global-time-master=true, sync-period=10.0, crc-secured=CRC-NOT-SUPPORTED, sub-tlv-config={ofs-sub-tlv=true, status-sub-tlv=true, user-data-sub-tlv=true}
    PST: domain-id=18, global-time-domain-propertys=eth-global-time-domain-props={destination-physical-address=01:80:C2:00:00:0E, eth-global-time-managed-coupling-port{pdelay-latency-threshold=3.0, pdelay-request-period=10.0, pdelay-resp-and-resp-follow-up-timeout=5.0, pdelay-response-enabled=true}, message-compliance=IEEE802-1AS-AUTOSAR}, offset-time-domain=EST, sync-loss-timeout=4.0
      global-time-masters:
        global time eth master PST_OFS_Masters1: communication-connector=EthernetCommunicationConnector, is-system-wide-global-time-master=true, sync-period=5.0, crc-secured=CRC-NOT-SUPPORTED, sub-tlv-config={ofs-sub-tlv=true, status-sub-tlv=true, user-data-sub-tlv=true}
    JST: domain-id=4, global-time-domain-propertys=eth-global-time-domain-props={destination-physical-address=01:80:C2:00:00:0E, eth-global-time-managed-coupling-port{pdelay-request-period=2.0, pdelay-resp-and-resp-follow-up-timeout=5.0, pdelay-response-enabled=true}, message-compliance=IEEE802-1AS-AUTOSAR}, sync-loss-timeout=8.0
      global-time-masters:
        global time eth master JST_Masters1: is-system-wide-global-time-master=false, sync-period=2.0, sub-tlv-config={ofs-sub-tlv=true, status-sub-tlv=true, user-data-sub-tlv=true}
      global time eth slave JST_Slave1: crc-validated=CRC-NOT-VALIDATED, time-hardware-correction-threshold=0.0
    MIT: domain-id=19, global-time-domain-propertys=eth-global-time-domain-props={destination-physical-address=01:80:C2:00:00:0E, eth-global-time-managed-coupling-port{pdelay-request-period=2.0, pdelay-resp-and-resp-follow-up-timeout=5.0, pdelay-response-enabled=true}, message-compliance=IEEE802-1AS-AUTOSAR}, offset-time-domain=JST, sync-loss-timeout=5.0
      global time eth slave MIT_OFS_Slave1: crc-validated=CRC-NOT-VALIDATED, time-hardware-correction-threshold=0.0
package /AppMapping
  9 x time sync port prototype to time base mapping, all with process=qt_tsync_instance1:
    TimeSyncPortPrototypeToTimeBaseMapping1: time-base-resource=UTC_Consumer, time-sync-r-port-prototype=tsync_instance_1_rootSwComponentPrototype.RUTCConsumerPort
    TimeSyncPortPrototypeToTimeBaseMapping2: time-base-resource=GPS_Consumer, time-sync-r-port-prototype=tsync_instance_1_rootSwComponentPrototype.RGPSConsumerPort
    TimeSyncPortPrototypeToTimeBaseMapping3: time-base-resource=KST_Provider, time-sync-p-port-prototype=tsync_instance_1_rootSwComponentPrototype.PKSTProviderPort
    TimeSyncPortPrototypeToTimeBaseMapping4: time-base-resource=EST_Provider, time-sync-p-port-prototype=tsync_instance_1_rootSwComponentPrototype.PESTProviderPort
    TimeSyncPortPrototypeToTimeBaseMapping5: time-base-resource=IST_OFS_Consumer, time-sync-r-port-prototype=tsync_instance_1_rootSwComponentPrototype.RISTOfsConsumerPort
    TimeSyncPortPrototypeToTimeBaseMapping6: time-base-resource=CET_OFS_Provider, time-sync-p-port-prototype=tsync_instance_1_rootSwComponentPrototype.PCETOfsProviderPort
    TimeSyncPortPrototypeToTimeBaseMapping7: time-base-resource=PST_OFS_Provider, time-sync-p-port-prototype=tsync_instance_1_rootSwComponentPrototype.PPSTOfsProviderPort
    TimeSyncPortPrototypeToTimeBaseMapping8: time-base-resource=JST_Consumer, time-sync-r-port-prototype=tsync_instance_1_rootSwComponentPrototype.RJSTConsumerPort
    TimeSyncPortPrototypeToTimeBaseMapping9: time-base-resource=MIT_OFS_Consumer, time-sync-r-port-prototype=tsync_instance_1_rootSwComponentPrototype.RMITOfsConsumerPort
