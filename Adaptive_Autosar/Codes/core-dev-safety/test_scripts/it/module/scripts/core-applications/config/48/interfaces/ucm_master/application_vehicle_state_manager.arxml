AUTOSAR XML (schema 00048)
package /ServiceInterfaces
  service interface ApplicationVehicleStateManager
    namespaces:
      symbol props ara
      symbol props com
    field VsmSafetyPolicy: type=String, has-getter=true, has-notifier=true, has-setter=true
    methods:
      operation SafetyState
        arg safetypolicy: type=SafetyPolicyType, direction=IN
        arg safetoupdate: type=bool, direction=OUT
