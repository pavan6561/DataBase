AUTOSAR XML (schema 00048)
package /EthernetCluster
  machine design QtMachine: service-discover-configs=someip-service-discovery={multicast-sd-ip-address=QtMachineSDNetworkEndpoint, someip-service-discovery-port=30490}
    ethernet communication connector EthernetCommunicationConnector: network-endpoint=QtMachineNetworkEndpoint, unicast-network-endpoint=QtMachineNetworkEndpoint
  ethernet cluster Ethernet
    ethernet physical channel EthernetPhysicalChannel: comm-connectors=QtMachine/EthernetCommunicationConnector
      network endpoint QtMachineNetworkEndpoint: network-endpoint-addresses=ipv-4-configuration={default-gateway=192.168.100.1, ipv-4-address=192.168.100.60, ipv-4-address-source=FIXED, network-mask=255.255.255.0}, priority=1
      network endpoint QtMachineSDNetworkEndpoint: network-endpoint-addresses=ipv-4-configuration={ipv-4-address=239.192.255.251, ipv-4-address-source=FIXED}
  machine design QtMachineDesignInstance2: service-discover-configs=someip-service-discovery={multicast-sd-ip-address=QtMachineSDNetworkEndpoint, someip-service-discovery-port=30490}
    ethernet communication connector EthernetCommunicationConnector: network-endpoint=QtMachineNetworkEndpoint, unicast-network-endpoint=QtMachineNetworkEndpoint
  machine design QTMachineDesignInstance3: service-discover-configs=someip-service-discovery={multicast-sd-ip-address=QtMachineSDNetworkEndpoint, someip-service-discovery-port=30490}
    ethernet communication connector EthernetCommunicationConnector1: network-endpoint=QtMachineNetworkEndpoint, unicast-network-endpoint=QtMachineNetworkEndpoint
