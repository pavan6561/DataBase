AUTOSAR XML (schema 00048)
package /SomeIpServiceInterfaceDeployment
  someip service interface deployment CertSignRequest_Someip: service-interface=CertSignRequest, service-interface-id=44, service-interface-version={major-version=0, minor-version=0}
    4 x someip method deployment, all with transport-protocol=UDP:
      Verify: method=Verify, method-id=1
      ExportASN1CertSignRequest: method=ExportASN1CertSignRequest, method-id=2
      GetSignature: method=GetSignature, method-id=3
      Version: method=Version, method-id=4
