AUTOSAR XML (schema 00048)
package /ServiceInterface
  service interface StreamCipherCtx
    namespaces:
      4 x symbol props:
        qt
        crypto
        cryptoprovider_001
        stream
    methods:
      17 x operation:
        CountBytesInCache: possible-ap-error=UndefinedApplicationError
          arg streamId: type=uint8_t, direction=IN
          arg response: type=uint64_t, direction=OUT
        EstimateMaxInputSize: possible-ap-error=UndefinedApplicationError
          arg streamId: type=uint8_t, direction=IN
          arg outputCapacity: type=uint64_t, direction=IN
          arg response: type=uint64_t, direction=OUT
        EstimateRequiredCapacity: possible-ap-error=UndefinedApplicationError
          4 x arg:
            streamId: type=uint8_t, direction=IN
            inputSize: type=uint64_t, direction=IN
            isFinal: type=bool, direction=IN
            response: type=uint64_t, direction=OUT
        FinishBytes: possible-ap-error=[InsufficientCapacity, InOutBuffersIntersect, ProcessingNotStarted, UndefinedApplicationError]
          arg streamId: type=uint8_t, direction=IN
          arg input: type=ByteArray, direction=IN
          arg response: type=returnFinishResponse, direction=OUT
        GetBlockService: possible-ap-error=UndefinedApplicationError
          arg streamId: type=uint8_t, direction=IN
          arg response: type=uint64_t, direction=OUT
        IsBytewiseMode: possible-ap-error=UndefinedApplicationError
          arg streamId: type=uint8_t, direction=IN
          arg response: type=returnBool, direction=OUT
        GetTransformation: possible-ap-error=[UninitializedContext, UndefinedApplicationError]
          arg streamId: type=uint8_t, direction=IN
          arg response: type=returnCryptoTransform, direction=OUT
        IsSeekableMode: possible-ap-error=UndefinedApplicationError
          arg streamId: type=uint8_t, direction=IN
          arg response: type=returnBool, direction=OUT
        ProcessBlocksReadOnlyMemRegion: possible-ap-error=[IncompatibleArguments, InvalidInputSize, InOutBuffersIntersect, InvalidUsageOrder, ProcessingNotStarted, UndefinedApplicationError]
          arg streamId: type=uint8_t, direction=IN
          arg input: type=ByteArray, direction=IN
          arg response: type=returnByteArray, direction=OUT
        ProcessBlocksReadWriteMemRegion: possible-ap-error=[InvalidInputSize, InvalidUsageOrder, ProcessingNotStarted, UndefinedApplicationError]
          arg streamId: type=uint8_t, direction=IN
          arg inOut: type=ByteArray, direction=INOUT
          arg response: type=uint64_t, direction=OUT
        ProcessBytesReadOnlyMemRegion: possible-ap-error=[InsufficientCapacity, InOutBuffersIntersect, ProcessingNotStarted, UndefinedApplicationError]
          arg streamId: type=uint8_t, direction=IN
          arg input: type=ByteArray, direction=IN
          arg response: type=returnProcessBytes, direction=OUT
        Reset: possible-ap-error=UndefinedApplicationError
          arg streamId: type=uint8_t, direction=IN
          arg response: type=uint64_t, direction=OUT
        Seek: possible-ap-error=[Unsupported, ProcessingNotStarted, BelowBoundary, InvalidArgument, UndefinedApplicationError]
          4 x arg:
            streamId: type=uint8_t, direction=IN
            offset: type=int64_t, direction=IN
            fromBegin: type=bool, direction=IN
            response: type=uint64_t, direction=OUT
        SetKey: possible-ap-error=[IncompatibleObject, UsageViolation, UndefinedApplicationError]
          4 x arg:
            streamId: type=uint8_t, direction=IN
            key: type=uint16_t, direction=IN
            transform: type=uint64_t, direction=IN
            response: type=uint64_t, direction=OUT
        StartReadOnlyMemRegion: possible-ap-error=[UninitializedContext, InvalidInputSize, Unsupported, UndefinedApplicationError]
          arg streamId: type=uint8_t, direction=IN
          arg iv: type=ByteArray, direction=IN
          arg response: type=uint64_t, direction=OUT
        StartSecretSeed: possible-ap-error=[UninitializedContext, InvalidInputSize, Unsupported, UsageViolation, UndefinedApplicationError]
          arg streamId: type=uint8_t, direction=IN
          arg secretSeedIv: type=uint16_t, direction=IN
          arg response: type=uint64_t, direction=OUT
        isInitialized: possible-ap-error=UndefinedApplicationError
          arg streamId: type=uint8_t, direction=IN
          arg response: type=returnBool, direction=OUT
