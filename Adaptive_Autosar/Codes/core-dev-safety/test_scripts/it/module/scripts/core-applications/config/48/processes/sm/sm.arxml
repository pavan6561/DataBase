AUTOSAR XML (schema 00048)
package /Executables
  executable statemanager
    root sw component prototype rootSwComponentPrototype_sm_ucm_stub: application-type=statemanager_ucm_stub
package /ProcessDesign
  process design statemanager: executable=statemanager
package /Processes
  process statemanager: design=statemanager, executable=statemanager, state-dependent-startup-config{execution-dependency=AraSomeipRoutingDaemonStateMachine.Running, function-group-state=MachineFG.Startup, resource-group=ResourceGroup, startup-config=statemanager}
