AUTOSAR XML (schema 00048)
package /ServiceInstanceToPortMapping
  service instance to port prototype mapping CryptoPrimitiveIdToPortPrototypeMapping: port-prototype=rootSwComponentPrototype.PPortCryptoPrimitiveId, process=qt_crypto_instance1, service-instance=CryptoPrimitiveId
