AUTOSAR XML (schema 00049)
package /ServiceInterfaces
  service interface DisplaySpeed
    namespaces:
      symbol props ara
      symbol props com
      symbol props sample
    events:
      18 x data:
        Event_struct: type=RadarObjects
        Event_vector: type=VectorCppIdt
        Event_array: type=ArrayCppIdt
        Event_maps: type=AssociativeMapCppIdt
        Event_struct_serialize: type=Struct_Serialize
        EventByteOrder: type=Struct_ByteOrder
        EventLengthField: type=Struct_LengthField
        Event_Order: type=StructLengthOrder
        Event_DynamicTrue: type=Dynamic_true
        Event_DynamicFalse: type=Dynamic_false
        Event_Length: type=LengthTypeOne
        Event_TLV: type=TLVLength
        Event_Length2MSBF: type=Length2MSBF
        Event_Length2MSBL: type=Length2MSBL
        Event_Length4MSBF: type=Length4MSBF
        Event_Length4MSBL: type=Length4MSBL
        Event_SomeIpSeg: type=VectorSomeipSeg
        Event_SameData: type=EventSameData
    13 x field, all with has-getter=true, has-notifier=true, has-setter=true:
      Condition: type=Position
      Identifier: type=Vector_distance
      Status: type=Array_distance
      PowerMode: type=AssociativeMapCppIdt
      PowerStruct: type=Struct_position_serialize
      ByteOrder: type=Struct_Byte
      StructOrder: type=Struct_order
      StructLength: type=StructLengthData
      DynamicTrue: type=Dynamictrue_Data
      DynamicFalse: type=DynamicFalseData
      LengthOne: type=DataTypeLength
      TLVDataLength: type=TLVDataType
      FieldSubscribe: type=FieldSubscribe
    methods:
      9 x operation:
        InitMonitor: possible-ap-error=[InvalidConfigString, InvalidParameter, GenericFailure]
          6 x arg:
            FaultDetection: type=Distances, direction=IN
            HandleMessage: type=Vector_analysis, direction=IN
            EnableStatus: type=Array_analysis, direction=IN
            ExecuteReset: type=Distances, direction=OUT
            PrepareForReset: type=Vector_analysis, direction=OUT
            NetworkRequest: type=Array_analysis, direction=OUT
        DataElement_struct
          arg Struct_In: type=Duration, direction=IN
          arg Struct_Out: type=Duration, direction=OUT
        DataElement_vector
          arg Vector_In: type=Vector_control, direction=IN
          arg Vector_Out: type=Vector_control, direction=OUT
        DataElement_array: possible-ap-error=[InvalidConfigString, InvalidParameter, GenericFailure]
          arg Array_In: type=Array_control, direction=IN
          arg Array_Out: type=Array_control, direction=OUT
        SubscriptionState
          arg SubscriptionState_In: type=EventSubscriptionStates, direction=IN
          arg SubscriptionState_Out: type=EventSubscriptionStates, direction=OUT
        SampleCount
          arg Sample_In: type=int8_t, direction=IN
          arg Sample_out: type=int8_t, direction=OUT
        DataElement_maps
          arg Maps_In: type=AssociativeMapCppIdt, direction=IN
          arg Maps_Out: type=AssociativeMapCppIdt, direction=OUT
        Echo_array: fire-and-forget=true
          arg text_array: type=ArrayCppIdt, direction=IN
        DataElement_TLV
          arg InTLV: type=DataTypeTLV, direction=IN
          arg OutTLV: type=DataTypeTLV, direction=OUT
package /TransformationPropsSets
  transformation props set StructTransformationPropsSet
    12 x ap someip transformation props:
      StructLegth2MSBF: byte-order=big-endian, size-of-struct-length-field=2
      NoLengthApSomeipTransformationProps
      ByteOrderApSomeipTransformationProps: byte-order=little-endian, size-of-struct-length-field=4
      NoByteOrderApSomeipTransformationProps: size-of-struct-length-field=1
      DymanicFalseApSomeipTransformationProps: byte-order=little-endian, is-dynamic-length-field-size=false, size-of-array-length-field=4, size-of-string-length-field=4, size-of-struct-length-field=4
      DynamicTrueApSomeipTransformationProps: byte-order=little-endian, is-dynamic-length-field-size=true, size-of-struct-length-field=4
      StructLength1ApSomeipTransformationProps: byte-order=little-endian, size-of-struct-length-field=1
      TLVApSomeipTransformationProps: byte-order=big-endian, is-dynamic-length-field-size=true, size-of-struct-length-field=4
      OptionalApSomeipTransformationProps: byte-order=little-endian, size-of-struct-length-field=4
      StructLength2MSBL: byte-order=little-endian, size-of-struct-length-field=2
      StructLength4MSBF: byte-order=big-endian, size-of-struct-length-field=4
      StructLength4MSBL: byte-order=little-endian, size-of-struct-length-field=4
package /TransformationPropsToServiceInterfaceMappingSets
  transformation props to service interface element mapping set StructTransformationPropsToServiceInterfaceElementMappingSet
    10 x transformation props to service interface element mapping:
      TLVStructmappings: event=Event_TLV, field=TLVDataLength, method=DataElement_TLV, tlv-data-id-definition=DataIDTlvDataIdDefinitionSet, transformation-props=TLVApSomeipTransformationProps
      ByteOrdermappings: event=EventLengthField, field=ByteOrder, transformation-props=ByteOrderApSomeipTransformationProps
      NoByteOrdermappings: event=Event_Order, field=StructLength, transformation-props=NoByteOrderApSomeipTransformationProps
      DynamicFalsemappings: event=Event_DynamicFalse, field=DynamicFalse, tlv-data-id-definition=DynamicFalseTlvDataIdDefinitionSet, transformation-props=DymanicFalseApSomeipTransformationProps
      DynamicTruemappings: event=Event_DynamicTrue, field=DynamicTrue, tlv-data-id-definition=DynamicTrueTlvDataIdDefinitionSet, transformation-props=DynamicTrueApSomeipTransformationProps
      Optionalmappings: event=EventByteOrder, tlv-data-id-definition=OptionalTlvDataIdDefinitionSet, transformation-props=OptionalApSomeipTransformationProps
      Length2MSBF: event=[Event_Length2MSBF, Event_struct_serialize], transformation-props=StructLegth2MSBF
      Length2MSBL: event=Event_Length2MSBL, transformation-props=StructLength2MSBL
      Length4MSBF: event=Event_Length4MSBF, transformation-props=StructLength4MSBF
      Length4MSBL: event=Event_Length4MSBL, transformation-props=StructLength4MSBL
package /SomeipDataPrototypeTransformationProps
  9 x someip data prototype transformation props:
    StructLength2MSBF: data-prototypes=Event_Length2MSBF, someip-transformation-props=StructLegth2MSBF
    NoLengthSomeipDataPrototypeTransformationProps: data-prototypes=Event_struct_serialize, someip-transformation-props=NoLengthApSomeipTransformationProps
    ByteOrderSomeipDataPrototypeTransformationProps: data-prototypes=StructOrder, someip-transformation-props=ByteOrderApSomeipTransformationProps
    NoByteOrderSomeipDataPrototypeTransformationProps: data-prototypes=EventLengthField.ByteOrder, someip-transformation-props=NoByteOrderApSomeipTransformationProps
    NoByteOrder: data-prototypes=StructLength.Event_Order, someip-transformation-props=NoByteOrderApSomeipTransformationProps
    StructLength1SomeipDataPrototypeTransformationProps: data-prototypes=LengthOne.Event_Length, someip-transformation-props=StructLength1ApSomeipTransformationProps
    StructLength2MSBL: data-prototypes=Event_Length2MSBL, someip-transformation-props=StructLength2MSBL
    StructLength4MSBF: data-prototypes=Event_Length4MSBF, someip-transformation-props=StructLength4MSBF
    StructLength4MSBL: data-prototypes=Event_Length4MSBL, someip-transformation-props=StructLength4MSBL
package /TlvDataIdDefinitionSet
  4 x tlv data id definition set:
    DataIDTlvDataIdDefinitionSet
      tlv-data-id-definitions:
        id=1, tlv-sub-element=subElements1
        id=2, tlv-sub-element=subElements1
        id=3, tlv-sub-element=Type8
        id=4, tlv-sub-element=Type16
        id=5, tlv-sub-element=Type32
        id=6, tlv-argument=InTLV, tlv-sub-element=Type64
        id=7, tlv-argument=OutTLV, tlv-sub-element=structSubElement
        id=8, tlv-sub-element=subElements2
        id=9, tlv-sub-element=subElements2
    DynamicFalseTlvDataIdDefinitionSet: tlv-data-id-definitions=[{id=1, tlv-sub-element=subElements1}, {id=2, tlv-sub-element=subElements2}]
    OptionalTlvDataIdDefinitionSet: tlv-data-id-definitions=[{id=1, tlv-sub-element=subElements1}, {id=2, tlv-sub-element=subElements2}]
    DynamicTrueTlvDataIdDefinitionSet: tlv-data-id-definitions=[{id=1, tlv-sub-element=subElements1}, {id=2, tlv-sub-element=subElements2}]
