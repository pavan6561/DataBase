AUTOSAR XML (schema 00048)
package /ServiceInterface
  service interface PublicKey
    namespaces:
      4 x symbol props:
        qt
        crypto
        cryptoprovider_001
        publickey
    methods:
      operation CheckKey: possible-ap-error=UndefinedApplicationError
        arg strongCheck: type=bool, direction=IN
        arg response: type=returnBool, direction=OUT
        arg publicKeyId: type=uint8_t, direction=IN
      operation HashPublicKey: possible-ap-error=UndefinedApplicationError
        arg publicKeyId: type=uint8_t, direction=IN
        arg hashId: type=uint8_t, direction=IN
        arg response: type=returnByteArray, direction=OUT
      operation ExportPublicly: possible-ap-error=[InsufficientCapacity, UnknownIdentifier, UnsupportedFormat, UndefinedApplicationError]
        arg publicKeyId: type=uint8_t, direction=IN
        arg formatId: type=uint8_t, direction=IN
        arg response: type=returnByteArray, direction=OUT
