AUTOSAR XML (schema 00049)
package /Processes
  process phm_core: design=phm_core, executable=phm_core, state-dependent-startup-config{function-group-state=MachineFG.Startup, resource-group=ResourceGroup, startup-config=phm_core_startupconfig}
package /Executables
  executable phm_core
    root sw component prototype rootSwComponentPrototype: application-type=qt_phm_instance1
package /ProcessDesign
  process design phm_core: executable=phm_core
