AUTOSAR XML (schema 00049)
package /ServiceInstances
  provided someip service instance CryptoService: service-interface-deployment=CryptoService_Someip, sd-server-config=SomeipSdServerServiceInstance, service-instance-id=1
package /ServiceInstanceToMachineMappings
  someip service instance to machine mapping CryptoServiceToMachineMapping: communication-connector=EthernetCommunicationConnector, service-instance=CryptoService, udp-port=4018
