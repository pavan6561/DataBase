AUTOSAR XML (schema 00049)
package /ServiceInterfaces
  provided someip service instance EncryptPublicCtx: service-interface-deployment=EncryptPublicCtx_Someip, sd-server-config=SomeipSdServerServiceInstance, service-instance-id=1
