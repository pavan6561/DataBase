AUTOSAR XML (schema 00048)
package /ServiceInstanceToPortMapping
  service instance to port prototype mapping CryptoServiceToPortPrototypeMapping: port-prototype=rootSwComponentPrototype.PPortCryptoService, process=qt_crypto_instance1, service-instance=CryptoService
