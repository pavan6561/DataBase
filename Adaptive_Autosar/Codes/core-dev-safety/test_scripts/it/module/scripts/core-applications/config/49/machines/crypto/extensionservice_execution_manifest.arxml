AUTOSAR XML (schema 00049)
package /ServiceInstanceToPortMapping
  service instance to port prototype mapping ExtensionServiceToPortPrototypeMapping: port-prototype=rootSwComponentPrototype.PPortExtensionService, process-design=qt_crypto_instance1, process=qt_crypto_instance1, service-instance=ExtensionService
