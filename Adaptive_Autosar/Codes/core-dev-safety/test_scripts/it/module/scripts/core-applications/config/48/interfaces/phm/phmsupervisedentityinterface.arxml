AUTOSAR XML (schema 00048)
package /PhmSupervisedEntityInterfaces
  8 x phm supervised entity interface:
    PhmSupervisedEntityInterface_Alive
      namespaces:
        symbol props ara
        symbol props phm
      phm checkpoint kInitialize: checkpoint-id=1
    PhmSupervisedEntityInterface_Deadline
      namespaces:
        symbol props ara
        symbol props phm
      phm checkpoint kDoorSource: checkpoint-id=3
      phm checkpoint kDoorTarget: checkpoint-id=4
    PhmSupervisedEntityInterface_Logical
      namespaces:
        symbol props ara
        symbol props phm
      4 x phm checkpoint:
        kStart: checkpoint-id=5
        kStop: checkpoint-id=6
        kResume: checkpoint-id=7
        kShutdown: checkpoint-id=8
    PhmSupervisedEntityInterface_GlobalExpiredToStopped
      namespaces:
        symbol props ara
        symbol props phm
      phm checkpoint kOK: checkpoint-id=9
      phm checkpoint kFailed: checkpoint-id=10
      phm checkpoint kExpired: checkpoint-id=11
    PhmSupervisedEntityInterface_AliveMultiple
      namespaces:
        symbol props ara
        symbol props phm
      phm checkpoint kAliveMultiple: checkpoint-id=13
    PhmSupervisedEntityInterface_DeadlineNegative
      namespaces:
        symbol props ara
        symbol props phm
      phm checkpoint kLightOn: checkpoint-id=14
      phm checkpoint kLightOff: checkpoint-id=15
    PhmSupervisedEntityInterface_Watchdog
      namespaces:
        symbol props ara
        symbol props phm
      5 x phm checkpoint:
        kIndicatorOn: checkpoint-id=16
        kIndicatorOff: checkpoint-id=17
        kPlay: checkpoint-id=18
        kPause: checkpoint-id=19
        kReverse: checkpoint-id=20
    PhmSupervisedEntityInterface_FunctionGrpModeRequest
      namespaces:
        symbol props ara
        symbol props phm
      phm checkpoint kWiperTimer1On: checkpoint-id=21
      phm checkpoint KWiperTimer1Off: checkpoint-id=22
package /PhmRecoveryActionInterfaces
  phm recovery action interface PhmRecoveryAction
    namespaces:
      symbol props ara
      symbol props phm
    recovery RecoveryMethod: fire-and-forget=true
  phm recovery action interface PhmRecoveryAction2
    namespaces:
      symbol props ara
      symbol props phm
    recovery RecoveryMethod: fire-and-forget=true
package /PhmHealthChannelInterfaces
  phm health channel interface PhmHealthChannelInterface_HCSupervision
    namespaces:
      symbol props ara
      symbol props phm
    phm health channel status kHigh: status-id=2
    phm health channel status kLow: status-id=1
