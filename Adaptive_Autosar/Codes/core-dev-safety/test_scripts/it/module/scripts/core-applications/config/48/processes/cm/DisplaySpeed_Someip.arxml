AUTOSAR XML (schema 00048)
package /ServiceInterfaceDeployments
  someip service interface deployment DisplaySpeed_Someip: service-interface=DisplaySpeed, service-interface-id=100, service-interface-version={major-version=0, minor-version=0}
    17 x someip event deployment, all with transport-protocol=UDP:
      EventStruct_Someip: event=Event_struct, event-id=10
      EventArray_Someip: event=Event_array, event-id=11
      EventVector_Someip: event=Event_vector, event-id=12, maximum-segment-length=1392, separation-time=0.0
      EventStruct_serialize_Someip: event=Event_struct_serialize, event-id=14
      EventByteOrder_Someip: event=EventByteOrder, event-id=15
      EventLegthField_Someip: event=EventLengthField, event-id=16
      EventOrder_Someip: event=Event_Order, event-id=17
      EventDynamicTrue_Someip: event=Event_DynamicTrue, event-id=18
      EventDynmaicFalse_Someip: event=Event_DynamicFalse, event-id=19
      EventLength_Someip: event=Event_Length, event-id=20
      EventTLV_Someip: event=Event_TLV, event-id=21
      EventLength2MSBF_Someip: event=Event_Length2MSBF, event-id=22
      EventLength2MSBL_Someip: event=Event_Length2MSBL, event-id=23
      EventLength4MSBF_Someip: event=Event_Length4MSBF, event-id=24
      EventLength4MSBL_Someip: event=Event_Length4MSBL, event-id=25
      EventSomeipSeg_Someip: event=Event_SomeIpSeg, event-id=26, maximum-segment-length=1392, separation-time=0.0
      EventSameData_Someip: event=Event_SameData, event-id=40
    12 x someip field deployment:
      Condition_Someip: field=Condition
        get get: method-id=200, transport-protocol=UDP
        notifier notifier: event-id=201, transport-protocol=UDP
        set set: method-id=202, transport-protocol=UDP
      Identifier_Someip: field=Identifier
        get get: method-id=204, transport-protocol=UDP
        notifier notifier: event-id=205, transport-protocol=UDP
        set set: method-id=206, transport-protocol=UDP
      Status_Someip: field=Status
        get get: method-id=207, transport-protocol=UDP
        notifier notifier: event-id=208, transport-protocol=UDP
        set set: method-id=209, transport-protocol=UDP
      PowerStruct_Someip: field=PowerStruct
        get get: method-id=255, transport-protocol=UDP
        notifier notifier: event-id=256, transport-protocol=UDP
        set set: method-id=257, transport-protocol=UDP
      Struct_order_Someip: field=StructOrder
        get get: method-id=260, transport-protocol=UDP
        notifier notifier: event-id=261, transport-protocol=UDP
        set set: method-id=262, transport-protocol=UDP
      ByteOrder_Someip: field=ByteOrder
        get get: method-id=263, transport-protocol=UDP
        notifier notifier: event-id=264, transport-protocol=UDP
        set set: method-id=265, transport-protocol=UDP
      StructLength_Someip: field=StructLength
        get get: method-id=266, transport-protocol=UDP
        notifier notifier: event-id=267, transport-protocol=UDP
        set set: method-id=268, transport-protocol=UDP
      DynamicTrue_Someip: field=DynamicTrue
        get get: method-id=269, transport-protocol=UDP
        notifier notifier: event-id=270, transport-protocol=UDP
        set set: method-id=271, transport-protocol=UDP
      DynamicFalse_Someip: field=DynamicFalse
        get get: method-id=272, transport-protocol=UDP
        notifier notifier: event-id=273, transport-protocol=UDP
        set set: method-id=274, transport-protocol=UDP
      DataLength_Someip: field=LengthOne
        get get: method-id=275, transport-protocol=UDP
        notifier notifier: event-id=276, transport-protocol=UDP
        set set: method-id=277, transport-protocol=UDP
      TLVDataLength_Someip: field=TLVDataLength
        get get: method-id=278, transport-protocol=UDP
        notifier notifier: event-id=279, transport-protocol=UDP
        set set: method-id=280, transport-protocol=UDP
      FieldSubscribe_Someip: field=FieldSubscribe
        get get: method-id=281, transport-protocol=UDP
        notifier notifier: event-id=282, transport-protocol=UDP
        set set: method-id=283, transport-protocol=UDP
    8 x someip method deployment, all with transport-protocol=UDP:
      InitialMode_Someip: method=InitMonitor, method-id=300
      DataElement_struct_Someip: method=DataElement_struct, method-id=301
      DataElement_vector_Someip: method=DataElement_vector, method-id=302
      DataElement_array_Someip: method=DataElement_array, method-id=303
      Echo_array_Someip: method=Echo_array, method-id=305
      SubscriptionState_Someip: method=SubscriptionState, method-id=306
      SampleCount_Someip: method=SampleCount, method-id=307
      DataElementTLV_Someip: method=DataElement_TLV, method-id=308
    someip event group EventDataType_Someip: event-group-id=400, event=[DisplaySpeed_Someip/EventStruct_Someip, DisplaySpeed_Someip/EventArray_Someip, DisplaySpeed_Someip/EventVector_Someip, DisplaySpeed_Someip/EventStruct_serialize_Someip, DisplaySpeed_Someip/EventByteOrder_Someip, DisplaySpeed_Someip/EventLegthField_Someip, DisplaySpeed_Someip/EventOrder_Someip, DisplaySpeed_Someip/EventDynamicTrue_Someip, DisplaySpeed_Someip/EventDynmaicFalse_Someip, DisplaySpeed_Someip/EventLength_Someip, DisplaySpeed_Someip/EventTLV_Someip, DisplaySpeed_Someip/EventLength2MSBF_Someip, DisplaySpeed_Someip/EventLength2MSBL_Someip, DisplaySpeed_Someip/EventLength4MSBF_Someip, DisplaySpeed_Someip/EventLength4MSBL_Someip, DisplaySpeed_Someip/EventSomeipSeg_Someip, DisplaySpeed_Someip/EventSameData_Someip]
    someip event group EventDataType_SomeipField: event-group-id=401, event=[Condition_Someip/notifier, Identifier_Someip/notifier, Status_Someip/notifier, PowerStruct_Someip/notifier, Struct_order_Someip/notifier, ByteOrder_Someip/notifier, StructLength_Someip/notifier, DynamicTrue_Someip/notifier, DynamicFalse_Someip/notifier, DataLength_Someip/notifier, TLVDataLength_Someip/notifier, FieldSubscribe_Someip/notifier]
  someip service interface deployment DisplaySpeed_Canoe_Someip: service-interface=DisplaySpeed_Canoe, service-interface-id=100, service-interface-version={major-version=0, minor-version=0}
    17 x someip event deployment, all with transport-protocol=UDP:
      EventStruct_Someip: event=Event_struct, event-id=10
      EventArray_Someip: event=Event_array, event-id=11
      EventVector_Someip: event=Event_vector, event-id=12, maximum-segment-length=1392, separation-time=0.0
      EventStruct_serialize_Someip: event=Event_struct_serialize, event-id=14
      EventByteOrder_Someip: event=EventByteOrder, event-id=15
      EventLegthField_Someip: event=EventLengthField, event-id=16
      EventOrder_Someip: event=Event_Order, event-id=17
      EventDynamicTrue_Someip: event=Event_DynamicTrue, event-id=18
      EventDynmaicFalse_Someip: event=Event_DynamicFalse, event-id=19
      EventLength_Someip: event=Event_Length, event-id=20
      EventTLV_Someip: event=Event_TLV, event-id=21
      EventLength2MSBF_Someip: event=Event_Length2MSBF, event-id=22
      EventLength2MSBL_Someip: event=Event_Length2MSBL, event-id=23
      EventLength4MSBF_Someip: event=Event_Length4MSBF, event-id=24
      EventLength4MSBL_Someip: event=Event_Length4MSBL, event-id=25
      EventSomeipSeg_Someip: event=Event_SomeIpSeg, event-id=26, maximum-segment-length=1392, separation-time=0.0
      EventSameData_Someip: event=Event_SameData, event-id=40
    12 x someip field deployment:
      Condition_Someip: field=Condition
        get get: method-id=200, transport-protocol=UDP
        notifier notifier: event-id=201, transport-protocol=UDP
        set set: method-id=202, transport-protocol=UDP
      Identifier_Someip: field=Identifier
        get get: method-id=204, transport-protocol=UDP
        notifier notifier: event-id=205, transport-protocol=UDP
        set set: method-id=206, transport-protocol=UDP
      Status_Someip: field=Status
        get get: method-id=207, transport-protocol=UDP
        notifier notifier: event-id=208, transport-protocol=UDP
        set set: method-id=209, transport-protocol=UDP
      PowerStruct_Someip: field=PowerStruct
        get get: method-id=255, transport-protocol=UDP
        notifier notifier: event-id=256, transport-protocol=UDP
        set set: method-id=257, transport-protocol=UDP
      Struct_order_Someip: field=StructOrder
        get get: method-id=260, transport-protocol=UDP
        notifier notifier: event-id=261, transport-protocol=UDP
        set set: method-id=262, transport-protocol=UDP
      ByteOrder_Someip: field=ByteOrder
        get get: method-id=263, transport-protocol=UDP
        notifier notifier: event-id=264, transport-protocol=UDP
        set set: method-id=265, transport-protocol=UDP
      StructLength_Someip: field=StructLength
        get get: method-id=266, transport-protocol=UDP
        notifier notifier: event-id=267, transport-protocol=UDP
        set set: method-id=268, transport-protocol=UDP
      DynamicTrue_Someip: field=DynamicTrue
        get get: method-id=269, transport-protocol=UDP
        notifier notifier: event-id=270, transport-protocol=UDP
        set set: method-id=271, transport-protocol=UDP
      DynamicFalse_Someip: field=DynamicFalse
        get get: method-id=272, transport-protocol=UDP
        notifier notifier: event-id=273, transport-protocol=UDP
        set set: method-id=274, transport-protocol=UDP
      DataLength_Someip: field=LengthOne
        get get: method-id=275, transport-protocol=UDP
        notifier notifier: event-id=276, transport-protocol=UDP
        set set: method-id=277, transport-protocol=UDP
      TLVDataLength_Someip: field=TLVDataLength
        get get: method-id=278, transport-protocol=UDP
        notifier notifier: event-id=279, transport-protocol=UDP
        set set: method-id=280, transport-protocol=UDP
      FieldSubscribe_Someip: field=FieldSubscribe
        get get: method-id=281, transport-protocol=UDP
        notifier notifier: event-id=282, transport-protocol=UDP
        set set: method-id=283, transport-protocol=UDP
    8 x someip method deployment, all with transport-protocol=UDP:
      InitialMode_Someip: method=InitMonitor, method-id=300
      DataElement_struct_Someip: method=DataElement_struct, method-id=301
      DataElement_vector_Someip: method=DataElement_vector, method-id=302
      DataElement_array_Someip: method=DataElement_array, method-id=303
      Echo_array_Someip: method=Echo_array, method-id=305
      SubscriptionState_Someip: method=SubscriptionState, method-id=306
      SampleCount_Someip: method=SampleCount, method-id=307
      DataElementTLV_Someip: method=DataElement_TLV, method-id=308
    someip event group EventDataType_Canoe_Someip: event-group-id=400, event=[DisplaySpeed_Canoe_Someip/EventStruct_Someip, DisplaySpeed_Canoe_Someip/EventArray_Someip, DisplaySpeed_Canoe_Someip/EventVector_Someip, DisplaySpeed_Canoe_Someip/EventStruct_serialize_Someip, DisplaySpeed_Canoe_Someip/EventByteOrder_Someip, DisplaySpeed_Canoe_Someip/EventLegthField_Someip, DisplaySpeed_Canoe_Someip/EventOrder_Someip, DisplaySpeed_Canoe_Someip/EventDynamicTrue_Someip, DisplaySpeed_Canoe_Someip/EventDynmaicFalse_Someip, DisplaySpeed_Canoe_Someip/EventLength_Someip, DisplaySpeed_Canoe_Someip/EventTLV_Someip, DisplaySpeed_Canoe_Someip/EventLength2MSBF_Someip, DisplaySpeed_Canoe_Someip/EventLength2MSBL_Someip, DisplaySpeed_Canoe_Someip/EventLength4MSBF_Someip, DisplaySpeed_Canoe_Someip/EventLength4MSBL_Someip, DisplaySpeed_Canoe_Someip/EventSomeipSeg_Someip, DisplaySpeed_Canoe_Someip/EventSameData_Someip]
    someip event group EventDataType_Canoe_SomeipField: event-group-id=401, event=[Condition_Someip/notifier, Identifier_Someip/notifier, Status_Someip/notifier, PowerStruct_Someip/notifier, Struct_order_Someip/notifier, ByteOrder_Someip/notifier, StructLength_Someip/notifier, DynamicTrue_Someip/notifier, DynamicFalse_Someip/notifier, DataLength_Someip/notifier, TLVDataLength_Someip/notifier, FieldSubscribe_Someip/notifier]
package /ServiceInstances
  provided someip service instance DisplaySpeed_qt_cm_instance2_ProvidedSomeipServiceInstance: service-interface-deployment=DisplaySpeed_Someip, sd-server-config=SomeipSdServerServiceInstance, service-instance-id=100
    someip provided event group providedEventGroups: event-group=EventDataType_Someip, multicast-threshold=1
    someip provided event group providedEventGroupsField: event-group=EventDataType_SomeipField, multicast-threshold=1
  required someip service instance DisplaySpeed_qt_cm_instance2_RequiredSomeipServiceInstance: service-interface-deployment=DisplaySpeed_Canoe_Someip, required-service-instance-id=200, sd-client-config=SomeipSdClientServiceInstance
    someip required event group requiredEventGroups: event-group=EventDataType_Canoe_Someip
    someip required event group requiredEventGroupsField: event-group=EventDataType_Canoe_SomeipField
package /ServiceInstanceToMachineMappings
  someip service instance to machine mapping DisplaySpeed_qt_cm_instance2_Provided_ServiceInstance_toMachine: communication-connector=EthernetCommunicationConnector, service-instance=DisplaySpeed_qt_cm_instance2_ProvidedSomeipServiceInstance, udp-port=3002
  someip service instance to machine mapping DisplaySpeed_qt_cm_instance2_Required_ServiceInstance_toMachine: communication-connector=EthernetCommunicationConnector, service-instance=DisplaySpeed_qt_cm_instance2_RequiredSomeipServiceInstance, udp-port=0
package /ServiceInstanceToPortPrototypeMappings
  service instance to port prototype mapping DisplaySpeed_qt_cm_instance2_ProvidedSomeipServiceInstance_PDisplaySpeed_toPort: port-prototype=rootSwComponentPrototype.PDisplaySpeed, process=qt_cm_instance2, service-instance=DisplaySpeed_qt_cm_instance2_ProvidedSomeipServiceInstance
  service instance to port prototype mapping DisplaySpeed_qt_cm_instance2_RequiredSomeipServiceInstance_RDisplaySpeed_toPort: port-prototype=rootSwComponentPrototype.RDisplaySpeed, process=qt_cm_instance2, service-instance=DisplaySpeed_qt_cm_instance2_RequiredSomeipServiceInstance
