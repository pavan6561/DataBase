AUTOSAR XML (schema 00048)
package /ServiceInstanceToPortMapping
  service instance to port prototype mapping CertificateToPortMapping: port-prototype=rootSwComponentPrototype.PPortCertificate, process=qt_crypto_instance1, service-instance=Certificate
