AUTOSAR XML (schema 00049)
package /ServiceInstances
  required someip service instance UpdateAdapterRequired: service-interface-deployment=UpdateAdapter_Someip, required-service-instance-id=1415, sd-client-config=SomeipSdClientServiceInstance
package /ServiceInstanceMachineMappings
  someip service instance to machine mapping UpdateAdapterToMachineMapping: communication-connector=EthernetCommunicationConnector, service-instance=UpdateAdapterRequired, tcp-port=7001
