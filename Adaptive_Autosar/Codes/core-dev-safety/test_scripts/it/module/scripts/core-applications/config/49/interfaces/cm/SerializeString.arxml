AUTOSAR XML (schema 00049)
package /ServiceInterface
  service interface SerializeString
    namespaces:
      symbol props ara
      symbol props com
      symbol props sample
    events:
      9 x data:
        Event_String2MSBF: type=String2MSBF
        Event_String2MSBL: type=String2MSBL
        Event_String4MSBF: type=String4MSBF
        Event_String4MSBL: type=String4MSBL
        Event_StringOne: type=StringOne
        Event_StringBothNoLength: type=StringBothNoLength
        Event_StringBothNoByteOrder: type=StringBothNoByteOrder
        Event_StringNoLength: type=StringNolength
        Event_StringNoByteOrder: type=StringNoByteOrder
package /SomeipDataPrototypeTransformationsProps
  7 x someip data prototype transformation props:
    StringlengthOne: data-prototypes=Event_StringOne, someip-transformation-props=StringLength1
    StringLength2MSBF: data-prototypes=Event_String2MSBF, someip-transformation-props=String2MSBF
    StringLength2MSBL: data-prototypes=Event_String2MSBL, someip-transformation-props=String2MSBL
    StringLength4MSBF: data-prototypes=Event_String4MSBF, someip-transformation-props=String4MSBF
    StringLength4MSBL: data-prototypes=Event_String4MSBL.Event_String4MSBL, someip-transformation-props=String4MSBL
    StringNoLength: data-prototypes=[Event_StringNoLength, Event_StringBothNoLength], someip-transformation-props=StringNoLength
    StringNoByteOrder: data-prototypes=[Event_StringNoByteOrder, Event_StringBothNoByteOrder], someip-transformation-props=StringNoByteOrder
package /TransformationPropsToServiceInterfaceElementMapping
  transformation props to service interface element mapping set StringTransformationPropsToServiceInterfaceElementMappingSet
    7 x transformation props to service interface element mapping:
      StringLength1: event=Event_StringOne, transformation-props=StringLength1
      String2MSBF: event=[Event_String2MSBF, Event_StringNoLength, Event_StringNoByteOrder], transformation-props=String2MSBF
      String2MSBL: event=Event_String2MSBL, transformation-props=String2MSBL
      String4MSBF: event=Event_String4MSBF, transformation-props=String4MSBF
      String4MSBL: event=Event_String4MSBL, transformation-props=String4MSBL
      StringNoLength: event=Event_StringBothNoLength, transformation-props=StringNoLength
      StringNoByteOrder: event=Event_StringBothNoByteOrder, transformation-props=StringNoByteOrder
package /TransformationPropsSet
  transformation props set StringTransformationPropsSet
    7 x ap someip transformation props:
      StringLength1: size-of-string-length-field=1, string-encoding=UTF-8
      String2MSBF: byte-order=big-endian, size-of-string-length-field=2, string-encoding=UTF-16
      String2MSBL: byte-order=little-endian, size-of-string-length-field=2, string-encoding=UTF-16
      String4MSBF: byte-order=big-endian, size-of-string-length-field=4
      String4MSBL: byte-order=little-endian, size-of-string-length-field=4
      StringNoLength
      StringNoByteOrder
