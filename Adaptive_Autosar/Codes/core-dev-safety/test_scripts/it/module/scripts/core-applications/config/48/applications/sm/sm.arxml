AUTOSAR XML (schema 00048)
package /AdaptiveApplicationSwComponentTypes
  adaptive application sw component type statemanager_ucm_stub: category=APPLICATION_LEVEL
    require port RPortPrototype_sm_ucm_stub: required-interface=UpdateRequest_Canoe
