AUTOSAR XML (schema 00048)
package /ServiceInstanceToPortMapping
  service instance to port prototype mapping RandomGeneratorCtxToPortMapping: port-prototype=rootSwComponentPrototype.PPortRandomGeneratorCtx, process=qt_crypto_instance1, service-instance=RandomGeneratorCtx
