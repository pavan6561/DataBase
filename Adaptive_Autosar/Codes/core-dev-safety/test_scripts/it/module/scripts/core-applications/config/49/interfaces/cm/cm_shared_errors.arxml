AUTOSAR XML (schema 00049)
package /ApplicationErrorDomains
  ap application error domain SpecificErrors: value=44
    namespaces:
      symbol props ara
      symbol props com
      symbol props sample
  ap application error domain GenericErrors: value=45
    namespaces:
      symbol props ara
      symbol props com
      symbol props sample
package /ApplicationErrors
  ap application error InvalidConfigString: error-code=5, error-domain=SpecificErrors
  ap application error InvalidParameter: error-code=6, error-domain=SpecificErrors
  ap application error GenericFailure: error-code=12, error-domain=GenericErrors
