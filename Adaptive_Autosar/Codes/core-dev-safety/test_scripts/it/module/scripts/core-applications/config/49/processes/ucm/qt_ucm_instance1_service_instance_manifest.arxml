AUTOSAR XML (schema 00049)
package /ServiceInstances
  provided someip service instance qt_ucm_instance1: service-interface-deployment=ApplicationPackageManagement_Someip, sd-server-config=SomeipSdServerServiceInstance, service-instance-id=1
package /ServiceInstanceMachineMapping
  someip service instance to machine mapping QtUCMInstance1ToMachineMapping: communication-connector=EthernetCommunicationConnector, service-instance=qt_ucm_instance1, udp-port=7002
