AUTOSAR XML (schema 00049)
package /ServiceInterface
  service interface SymmetricKeyWrapperCtx
    namespaces:
      4 x symbol props:
        qt
        crypto
        cryptoprovider_001
        kwrap
    methods:
      11 x operation:
        CalculateWrappedKeySize: possible-ap-error=UndefinedApplicationError
          arg kwrapId: type=uint8_t, direction=IN
          arg keyLength: type=uint16_t, direction=IN
          arg response: type=uint64_t, direction=OUT
        GetExtensionService: possible-ap-error=UndefinedApplicationError
          arg kwrapId: type=uint8_t, direction=IN
          arg response: type=uint64_t, direction=OUT
        GetMaxTargetKeyLength: possible-ap-error=UndefinedApplicationError
          arg kwrapId: type=uint8_t, direction=IN
          arg response: type=uint64_t, direction=OUT
        GetTargetKeyGranularity: possible-ap-error=UndefinedApplicationError
          arg kwrapId: type=uint8_t, direction=IN
          arg response: type=uint64_t, direction=OUT
        Reset: possible-ap-error=UndefinedApplicationError
          arg kwrapId: type=uint8_t, direction=IN
          arg response: type=uint64_t, direction=OUT
        SetKey: possible-ap-error=[IncompatibleObject, UsageViolation, UndefinedApplicationError]
          4 x arg:
            kwrapId: type=uint8_t, direction=IN
            key: type=uint16_t, direction=IN
            transform: type=uint64_t, direction=IN
            response: type=uint64_t, direction=OUT
        UnwrapConcreteKey: possible-ap-error=[InvalidInputSize, UninitializedContext, UndefinedApplicationError]
          5 x arg:
            kwrapId: type=uint8_t, direction=IN
            wrappedKey: type=ByteArray, direction=IN
            algId: type=uint64_t, direction=IN
            allowedUsage: type=uint32_t, direction=IN
            response: type=uint64_t, direction=OUT
        UnwrapKey: possible-ap-error=[InvalidInputSize, UninitializedContext, UndefinedApplicationError]
          6 x arg:
            kwrapId: type=uint8_t, direction=IN
            wrappedKey: type=ByteArray, direction=IN
            algId: type=uint64_t, direction=IN
            allowedUsage: type=uint32_t, direction=IN
            keyInstanceId: type=uint8_t, direction=IN
            response: type=uint64_t, direction=OUT
        UnwrapSeed: possible-ap-error=[InvalidInputSize, UninitializedContext, UndefinedApplicationError]
          6 x arg:
            kwrapId: type=uint8_t, direction=IN
            wrappedSeed: type=ByteArray, direction=IN
            targetAlgId: type=uint64_t, direction=IN
            allowedUsage: type=uint32_t, direction=IN
            seedInstanceId: type=uint8_t, direction=IN
            response: type=uint64_t, direction=OUT
        WrapKeyMaterial: possible-ap-error=[InsufficientCapacity, InvalidInputSize, UninitializedContext, UndefinedApplicationError]
          arg kwrapId: type=uint8_t, direction=IN
          arg key: type=uint16_t, direction=IN
          arg response: type=returnByteArray, direction=OUT
        isInitialized
          arg kwrapId: type=uint8_t, direction=IN
          arg response: type=returnBool, direction=OUT
