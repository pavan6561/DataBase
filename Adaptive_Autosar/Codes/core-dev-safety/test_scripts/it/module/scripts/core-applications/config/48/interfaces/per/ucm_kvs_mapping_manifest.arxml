AUTOSAR XML (schema 00048)
package /ara/apd/ucm/mapping
  persistency port prototype to key value storage mapping SwPackageTransferStatusStorageToPortMapping: port-prototype=rootSwComponentPrototype.SwPackageTransferStatusPRPort, process=package_manager, key-value-storage=SwPackageTransferStatusStorage
  persistency port prototype to key value storage mapping SwPackageCurrentStatuStorageToPortMapping: port-prototype=rootSwComponentPrototype.SwPackageCurrentStatusPRPort, process=package_manager, key-value-storage=SwPackageCurrentStatusDatabase
