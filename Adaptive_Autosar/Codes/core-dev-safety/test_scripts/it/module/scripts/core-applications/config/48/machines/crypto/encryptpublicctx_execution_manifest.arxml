AUTOSAR XML (schema 00048)
package /ServiceInstanceToPortMapping
  service instance to port prototype mapping EncryptPublicCtxToPortMapping: port-prototype=rootSwComponentPrototype.PPortEncryptPublicCtx, process=qt_crypto_instance1, service-instance=EncryptPublicCtx
