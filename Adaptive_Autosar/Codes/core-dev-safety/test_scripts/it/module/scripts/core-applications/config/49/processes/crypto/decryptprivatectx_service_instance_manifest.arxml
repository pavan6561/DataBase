AUTOSAR XML (schema 00049)
package /ServiceInterfaces
  provided someip service instance DecryptPrivateCtx: service-interface-deployment=DecryptPrivateCtx_Someip, sd-server-config=SomeipSdServerServiceInstance, service-instance-id=1
