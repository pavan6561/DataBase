AUTOSAR XML (schema 00049)
package /ServiceInstances
  provided someip service instance PrivateKey: service-interface-deployment=PrivateKey_Someip, sd-server-config=SomeipSdServerServiceInstance, service-instance-id=1
package /ServiceInstanceToMachineMappings
  someip service instance to machine mapping PrivateKeyToMachineMapping: communication-connector=EthernetCommunicationConnector, service-instance=PrivateKey, udp-port=4021
