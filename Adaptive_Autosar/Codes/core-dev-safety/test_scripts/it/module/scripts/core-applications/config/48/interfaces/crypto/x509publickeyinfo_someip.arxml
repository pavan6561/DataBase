AUTOSAR XML (schema 00048)
package /SomeIpServiceIntefaceDeployment
  someip service interface deployment X509PublicKeyInfo_Someip: service-interface=X509PublicKeyInfo, service-interface-id=40, service-interface-version={major-version=0, minor-version=0}
    7 x someip method deployment, all with transport-protocol=TCP:
      GetPublicKey: method=GetPublicKey, method-id=1
      GetRequiredHashAlgId: method=GetRequiredHashAlgId, method-id=2
      GetRequiredHashSize: method=GetRequiredHashSize, method-id=3
      GetSignatureSize: method=GetSignatureSize, method-id=4
      GetAlgorithmId: method=GetAlgorithmId, method-id=5
      IsSameKey: method=IsSameKey, method-id=6
      ExportPublicly: method=ExportPublicly, method-id=7
