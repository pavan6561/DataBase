AUTOSAR XML (schema 00049)
package /CppImplementationDataTypes
  8 x std cpp implementation data type, all with type-emitter=TYPE_EMITTER_ARA:
    CryptoObjectIdentifier: category=STRUCTURE
      cpp implementation data type element mCOType: type-reference=CryptoObjectTypeIPCqt
      cpp implementation data type element mCouid: category=VALUE, type-reference=CryptoObjectUidIPCqt
    CryptoObjectTypeIPCqt: compu {0x00=kUndefined, 0x01=kSymmetricKey, 0x02=kPrivateKey, 0x03=kPublicKey, 0x04=kSignature, 0x05=kSecretSeed}, type-reference=uint32_t
    CryptoObjectUidIPCqt: category=STRUCTURE
      cpp implementation data type element mGeneratorUid: category=VALUE, type-reference=UuidCryptoqt
      cpp implementation data type element mVersionStamp: category=VALUE, type-reference=uint64_t
    UuidCryptoqt: category=STRUCTURE
      cpp implementation data type element mQwordMs: category=VALUE, type-reference=uint64_t
      cpp implementation data type element mQwordLs: category=VALUE, type-reference=uint64_t
    returnString: category=STRUCTURE
      cpp implementation data type element string: type-reference=String
      cpp implementation data type element errorValue: type-reference=uint64_t
    VectorReadOnlyMem: category=VECTOR, cpp-template-argument=ByteArray
    VectorInstanceId: category=VECTOR, cpp-template-argument=uint8_t
    CryptoPrimitive: category=STRUCTURE
      cpp implementation data type element algId: type-reference=uint64_t
      cpp implementation data type element algName: type-reference=String
