AUTOSAR XML (schema 00049)
package /AdaptiveApplicationSwComponentTypes
  adaptive application sw component type qt_cm_instance1: category=APPLICATION_LEVEL
    provide port PRadar: provided-interface=Radar
package /Executables
  executable qt_cm_instance1
    root sw component prototype rootSwComponentPrototype: application-type=qt_cm_instance1
