AUTOSAR XML (schema 00049)
package /ProcessDesigns
  process design qt_cm_instance4: executable=qt_cm_instance4
package /Processes
  process qt_cm_instance4: design=qt_cm_instance4, executable=qt_cm_instance4, state-dependent-startup-config{function-group-state=ComApplicationStates.Com_Instance3, resource-group=ResourceGroups2, startup-config=qt_cm_instance4_startupconfig}
