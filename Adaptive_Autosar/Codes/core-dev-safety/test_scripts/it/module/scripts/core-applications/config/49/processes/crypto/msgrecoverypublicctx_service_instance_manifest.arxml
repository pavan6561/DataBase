AUTOSAR XML (schema 00049)
package /ServiceInstances
  provided someip service instance MsgRecoveryPublicCtx: service-interface-deployment=MsgRecoveryPublicCtx_Someip, sd-server-config=SomeipSdServerServiceInstance, service-instance-id=1
