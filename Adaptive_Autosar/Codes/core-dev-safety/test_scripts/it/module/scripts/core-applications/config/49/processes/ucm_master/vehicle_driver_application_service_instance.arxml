AUTOSAR XML (schema 00049)
package /ServiceInstances
  provided someip service instance ProvidedSomeIpApplicationVehicleDriverManagement: service-interface-deployment=ApplicationVehicleDriverManagement_Someip, sd-server-config=SomeipSdServerServiceInstance, service-instance-id=6
    4 x someip provided event group, all with multicast-threshold=1:
      providedEventGroupsDriver: event-group=ApprovalEvent
      providedEventGroupsSafetyPolicy: event-group=SafetyPolicy_eventgroup
      providedEventGroupsSafetyState: event-group=SafetyState_eventgroup
      providedEventGroupsCampaignState: event-group=CampaignStateEvent
  required someip service instance RequiredVehicleDriverManagement: service-interface-deployment=VehicleDriverApplicationSomeIp, required-service-instance-id=910, sd-client-config=SomeipSdClientServiceInstance
package /ServiceInstanceToPortMapping
  service instance to port prototype mapping ProvidedApplicationVehicleDriverManagementToPortPrototypeMapping: port-prototype=qt_driver_application_root.PPortApplicationVehicleDriverManagement, process-design=qt_driver_application, process=qt_driver_application, service-instance=ProvidedSomeIpApplicationVehicleDriverManagement
  service instance to port prototype mapping RequiredVehicleDriverManagementToPortPrototypeMapping: port-prototype=qt_driver_application_root.VehicleDriverApplicationRPort, process-design=qt_driver_application, process=qt_driver_application, service-instance=RequiredVehicleDriverManagement
