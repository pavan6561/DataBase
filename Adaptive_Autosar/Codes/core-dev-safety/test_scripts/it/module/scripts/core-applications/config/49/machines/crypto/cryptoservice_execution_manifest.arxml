AUTOSAR XML (schema 00049)
package /ServiceInstanceToPortMapping
  service instance to port prototype mapping CryptoServiceToPortPrototypeMapping: port-prototype=rootSwComponentPrototype.PPortCryptoService, process-design=qt_crypto_instance1, process=qt_crypto_instance1, service-instance=CryptoService
