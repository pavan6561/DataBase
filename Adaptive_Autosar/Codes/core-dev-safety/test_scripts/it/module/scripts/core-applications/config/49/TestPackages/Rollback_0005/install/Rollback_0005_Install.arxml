AUTOSAR XML (schema 00049)
package /arPackage
  software cluster design SwClusterDesign
  software cluster design SwClusterDesign_A
  software cluster design SwClusterDesign_B
  documentation InitialApplication
  documentation AVIN
  software cluster Swcl_Rollback_0005: category=SWCL, claimed-function-group=functionGroups1, conflicts-to=operator=LOGICAL-AND, depends-on=operator=LOGICAL-OR, design=SwClusterDesign, software-cluster-doip-diagnostic-address{address-semantics=FUNCTIONAL-ADDRESS, diagnostic-address=17473}, license=AVIN, release-notes=InitialApplication, type-approval=2018/858, vendor-id=1447315780, version=1.0.0.0
  mode declaration group UCMPackageManagerStates_Rollback_0005
    mode on
    mode off
    mode Verify
  function group set FunctionGroupSet_Rollback_0005
    function-groups:
      mode declaration group prototype functionGroups1: type=UCMPackageManagerStates_Rollback_0005
  software package sw_pkg_Rollback_0005: category=TestPackage, action-type=INSTALL, compressed-software-package-size=524288, maximum-supported-ucm-version=3.0.0.0, minimum-supported-ucm-version=1.0.0.0, packager-id=1347111236, software-cluster=Swcl_Rollback_0005, uncompressed-software-cluster-size=655360
