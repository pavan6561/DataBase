AUTOSAR XML (schema 00049)
package /ServiceInterface
  service interface X509PublicKeyInfo
    namespaces:
      4 x symbol props:
        qt
        crypto
        x509
        pki
    methods:
      7 x operation:
        GetPublicKey: possible-ap-error=UndefinedApplicationError
          arg pkiId: type=uint8_t, direction=IN
          arg toStorePubKey: type=uint8_t, direction=IN
          arg response: type=uint64_t, direction=OUT
        GetRequiredHashAlgId: possible-ap-error=UndefinedApplicationError
          arg pkiId: type=uint8_t, direction=IN
          arg response: type=uint64_t, direction=OUT
        GetRequiredHashSize: possible-ap-error=UndefinedApplicationError
          arg pkiId: type=uint8_t, direction=IN
          arg response: type=uint64_t, direction=OUT
        GetSignatureSize: possible-ap-error=UndefinedApplicationError
          arg pkiId: type=uint8_t, direction=IN
          arg response: type=uint64_t, direction=OUT
        GetAlgorithmId: possible-ap-error=UndefinedApplicationError
          arg pkiId: type=uint8_t, direction=IN
          arg response: type=CryptoPrimitive, direction=OUT
        IsSameKey: possible-ap-error=UndefinedApplicationError
          arg pkiId: type=uint8_t, direction=IN
          arg getPublicKey: type=uint8_t, direction=IN
          arg response: type=bool, direction=OUT
        ExportPublicly: possible-ap-error=[InsufficientCapacity, UnknownIdentifier, UnsupportedFormat, UndefinedApplicationError]
          arg objectId: type=uint8_t, direction=IN
          arg formatId: type=uint8_t, direction=IN
          arg response: type=returnByteArray, direction=OUT
