AUTOSAR XML (schema 00049)
package /ServiceInstances
  provided someip service instance SymmetricKeyWrapperCtx: service-interface-deployment=SymmetricKeyWrapperCtx_Someip, sd-server-config=SomeipSdServerServiceInstance, service-instance-id=1
