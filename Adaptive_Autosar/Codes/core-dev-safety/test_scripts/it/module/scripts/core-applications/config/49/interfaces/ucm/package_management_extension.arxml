AUTOSAR XML (schema 00049)
package /ServiceInterfaces
  service interface UpdateAdapter
    namespaces:
      symbol props ara
      symbol props ucm
      symbol props pkgmgr
    field UpdateStatus: type=UpdateStatusType, has-getter=true, has-notifier=true, has-setter=false
    methods:
      operation SetActivateStatus
        arg status: type=ActivateStatusType, direction=IN
      operation SetRollbackStatus
        arg status: type=RollbackStatusType, direction=IN
