AUTOSAR XML (schema 00048)
package /SomeIpServiceInterfaceDeployment
  someip service interface deployment SignatureService_Someip: service-interface=SignatureService, service-interface-id=83, service-interface-version={major-version=0, minor-version=0}
    someip method deployment GetRequiredHashAlgId: method=GetRequiredHashAlgId, method-id=1, transport-protocol=UDP
    someip method deployment GetRequiredHashSize: method=GetRequiredHashSize, method-id=2, transport-protocol=UDP
    someip method deployment GetSignatureSize: method=GetSignatureSize, method-id=3, transport-protocol=UDP
