AUTOSAR XML (schema 00049)
package /SomeIpServiceInterfaceDeployment
  someip service interface deployment CryptoPrimitiveId_Someip: service-interface=CryptoPrimitiveId, service-interface-id=85, service-interface-version={major-version=0, minor-version=0}
    someip method deployment GetPrimitiveId: method=GetPrimitiveId, method-id=1, transport-protocol=UDP
    someip method deployment GetPrimitiveName: method=GetPrimitiveName, method-id=2, transport-protocol=UDP
