AUTOSAR XML (schema 00048)
package /SomeIpServiceInterfaceDeployment
  someip service interface deployment SymmetricKeyWrapperCtx_Someip: service-interface=SymmetricKeyWrapperCtx, service-interface-id=34, service-interface-version={major-version=0, minor-version=0}
    11 x someip method deployment, all with transport-protocol=UDP:
      CalculateWrappedKeySize: method=CalculateWrappedKeySize, method-id=1
      GetExtensionService: method=GetExtensionService, method-id=2
      GetMaxTargetKeyLength: method=GetMaxTargetKeyLength, method-id=3
      GetTargetKeyGranularity: method=GetTargetKeyGranularity, method-id=4
      Reset: method=Reset, method-id=5
      SetKey: method=SetKey, method-id=6
      UnwrapConcreteKey: method=UnwrapConcreteKey, method-id=7
      UnwrapKey: method=UnwrapKey, method-id=8
      UnwrapSeed: method=UnwrapSeed, method-id=9
      WrapKeyMaterial: method=WrapKeyMaterial, method-id=10
      isInitialized: method=isInitialized, method-id=11
