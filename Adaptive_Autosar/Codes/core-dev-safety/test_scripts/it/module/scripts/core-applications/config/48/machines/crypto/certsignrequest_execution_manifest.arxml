AUTOSAR XML (schema 00048)
package /ServiceInstanceToPortMapping
  service instance to port prototype mapping CertSignRequestToPortMapping: port-prototype=rootSwComponentPrototype.PPortCertSignRequest, process=qt_crypto_instance1, service-instance=CertSignRequest
