AUTOSAR XML (schema 00049)
package /SomeIpServiceInterfaceDeployment
  someip service interface deployment BasicCertInfo_Someip: service-interface=BasicCertInfo, service-interface-id=42, service-interface-version={major-version=0, minor-version=0}
    5 x someip method deployment, all with transport-protocol=UDP:
      GetConstraints: method=GetConstraints, method-id=1
      GetPathLimit: method=GetPathLimit, method-id=2
      IsCa: method=IsCa, method-id=3
      SubjectDn: method=SubjectDn, method-id=4
      SubjectPubKey: method=SubjectPubKey, method-id=5
