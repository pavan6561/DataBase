AUTOSAR XML (schema 00049)
package /ServiceInterfaces
  service interface StateManager
    namespaces:
      symbol props ara
      symbol props com
    methods:
      operation ChangeApplicationState
        arg functionGroup: type=String, direction=IN
        arg functionGroupState: type=String, direction=IN
