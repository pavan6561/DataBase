AUTOSAR XML (schema 00048)
package /ServiceInstanceToPortMapping
  service instance to port prototype mapping PublicKeyToPortMapping: port-prototype=rootSwComponentPrototype.PPortPublicKey, process=qt_crypto_instance1, service-instance=PublicKey
