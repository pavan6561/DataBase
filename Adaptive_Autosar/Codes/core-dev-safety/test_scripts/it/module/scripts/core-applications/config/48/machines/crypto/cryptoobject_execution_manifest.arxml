AUTOSAR XML (schema 00048)
package /ServiceInstanceToPortMapping
  service instance to port prototype mapping CryptoObejctToPortPrototypeMapping: port-prototype=rootSwComponentPrototype.PPortCryptoObject, process=qt_crypto_instance1, service-instance=CryptoObject
