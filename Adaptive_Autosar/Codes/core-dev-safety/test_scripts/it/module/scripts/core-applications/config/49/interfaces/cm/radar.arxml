AUTOSAR XML (schema 00049)
package /ServiceInterfaces
  service interface Radar
    namespaces:
      symbol props ara
      symbol props com
      symbol props sample
    events:
      data BrakeEvent: type=uint32_t
    field UpdateRate: type=uint32_t, has-getter=true, has-notifier=true, has-setter=true
    methods:
      operation Adjust
        8 x arg:
          success: type=uint8_t, direction=OUT
          effective_position: type=uint16_t, direction=IN
          object_position: type=uint32_t, direction=IN
          success_effective: type=uint16_t, direction=OUT
          success_objective: type=uint32_t, direction=OUT
          position: type=uint8_t, direction=IN
          target_position: type=uint64_t, direction=IN
          success_target: type=uint64_t, direction=OUT
      operation Calibrate: possible-ap-error=InvalidConfigString
        8 x arg:
          configuration: type=int8_t, direction=IN
          variant: type=int16_t, direction=IN
          object_position: type=int32_t, direction=IN
          data: type=int64_t, direction=IN
          result_configurtaion: type=int8_t, direction=OUT
          result_variant: type=int16_t, direction=OUT
          result_object: type=int32_t, direction=OUT
          result_data: type=int64_t, direction=OUT
      operation Update
        6 x arg:
          data: type=float, direction=IN
          target: type=double, direction=IN
          result_data: type=float, direction=OUT
          result: type=uint8_t, direction=OUT
          variable: type=uint8_t, direction=IN
          result_target: type=double, direction=OUT
