AUTOSAR XML (schema 00048)
package /ServiceInterfaces
  service interface ApplicationPackageManagement
    namespaces:
      symbol props ara
      symbol props com
    methods:
      24 x operation:
        TransferPackage
          arg response: type=returnValues, direction=OUT
        ProcessSwPackage
          arg response: type=returnValues, direction=OUT
          arg id: type=TransferIdType_Canoe, direction=IN
        Activate
          arg response: type=returnValues, direction=OUT
        Finish
          arg response: type=returnValues, direction=OUT
        Cancel
          arg id: type=TransferIdType_Canoe, direction=IN
          arg response: type=returnValues, direction=OUT
        TransferStart
          4 x arg:
            size: type=uint64_t, direction=IN
            blocksize: type=uint32_t, direction=OUT
            transferId: type=TransferIdType_Canoe, direction=OUT
            response: type=returnValues, direction=OUT
        TransferData
          4 x arg:
            id: type=TransferIdType_Canoe, direction=IN
            packageSize: type=uint32_t, direction=IN
            blockCounter: type=uint64_t, direction=IN
            response: type=returnValues, direction=OUT
        TransferExit
          arg id: type=TransferIdType_Canoe, direction=IN
          arg response: type=returnValues, direction=OUT
        DeleteTransfer
          arg id: type=TransferIdType_Canoe, direction=IN
          arg response: type=returnValues, direction=OUT
        LoadBinaryPackage
          arg packagePath: type=String, direction=IN
          arg size: type=uint64_t, direction=OUT
        RollBack
          arg response: type=returnValues, direction=OUT
        RevertProcessedSwPackages
          arg response: type=returnValues, direction=OUT
        GetSwPackages
          arg response: type=returnValues, direction=OUT
        CurrentStatus
          arg response: type=returnValues, direction=OUT
        GetHistory
          arg response: type=returnValues, direction=OUT
          arg timestampGE: type=uint64_t, direction=IN
          arg timestampLT: type=uint64_t, direction=IN
        GetSwClusterInfo
          arg response: type=returnValues, direction=OUT
        GetSwProcessProgress
          arg id: type=TransferIdType_Canoe, direction=IN
          arg response: type=returnValues, direction=OUT
        IsProcessingSet
          arg isProcessingSet: type=returnValues, direction=OUT
        IsCleaningUpSet
          arg isCleaningupSet: type=returnValues, direction=OUT
        IsRollingBackSet
          arg isRollingBackSet: type=returnValues, direction=OUT
        IsActivatingSet
          arg isActivatingSet: type=returnValues, direction=OUT
        GetSwClusterChangeInfo
          arg response: type=returnValues, direction=OUT
        GetSwClusterDescription
          arg response: type=returnValues, direction=OUT
        GetId
          arg id: type=String, direction=OUT
          arg response: type=returnValues, direction=OUT
