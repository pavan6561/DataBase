AUTOSAR XML (schema 00048)
package /ServiceInterfaces
  service interface Odometry
    namespaces:
      symbol props ara
      symbol props com
      symbol props sample
    events:
      18 x data:
        Event_uint8: type=uint8_t
        Event_uint16: type=uint16_t
        Event_uint32: type=uint32_t
        Event_unit64: type=uint64_t
        Event_int8: type=int8_t
        Event_int16: type=int16_t
        Event_int32: type=int32_t
        Event_int64: type=int64_t
        Event_float: type=float
        Event_double: type=double
        Event_enum: type=Enum_response
        Event_scalelinear: type=SLT_response
        Event_string: type=String
        Event_supplyvoltage: type=int8_t
        Event_temperature: type=int16_t
        Event_reestablishing: type=int32_t
        Event_samplepointer: type=uint8_t
        Event_MarkerInterface: type=uint8_t
    14 x field, all with has-getter=true, has-notifier=true, has-setter=true:
      Speed: type=uint8_t
      Velocity: type=uint16_t
      Pose2D: type=uint32_t
      AdditionalVehicleMotionInformation: type=uint64_t
      WheelCorrection: type=int8_t
      Acceleration: type=int16_t
      AngularRate: type=int32_t
      Time: type=int64_t
      Distance: type=float
      Position: type=double
      Field_enum: type=Enum_response
      Field_scalelinear: type=SLT_response
      Field_string: type=String
      fields_temperaturediscard: type=uint16_t
    methods:
      8 x operation:
        DataElement_basicDT
          20 x arg:
            SpeedDetection_In: type=uint8_t, direction=IN
            VelocityDetection_In: type=uint16_t, direction=IN
            Pose2DDetection_In: type=uint32_t, direction=IN
            AdditionalVehicleMotionInformationDetection_In: type=uint64_t, direction=IN
            WheelCorrectionDetection_In: type=int8_t, direction=IN
            AccelerationDetection_In: type=int16_t, direction=IN
            AngularRateDetection_In: type=int32_t, direction=IN
            TimeDetection_In: type=int64_t, direction=IN
            DistanceDetection_In: type=float, direction=IN
            PositionDetection_In: type=double, direction=IN
            SpeedDetection_Out: type=uint8_t, direction=OUT
            VelocityDetection_Out: type=uint16_t, direction=OUT
            Pose2DDetection_Out: type=uint32_t, direction=OUT
            AdditionalVehicleMotionInformationDetection_Out: type=uint64_t, direction=OUT
            WheelCorrectionDetection_Out: type=int8_t, direction=OUT
            AccelerationDetection_Out: type=int16_t, direction=OUT
            AngularRateDetection_Out: type=int32_t, direction=OUT
            TimeDetection_Out: type=int64_t, direction=OUT
            DistanceDetection_Out: type=float, direction=OUT
            PositionDetection_Out: type=double, direction=OUT
        DataElement_enum
          arg Enum_In: type=Enum_response, direction=IN
          arg Enum_Out: type=Enum_response, direction=OUT
        DataElement_scalelinear
          arg Scalelinear_In: type=SLT_response, direction=IN
          arg Scalelinear_Out: type=SLT_response, direction=OUT
        DataElement_string
          arg String_In: type=String, direction=IN
          arg String_Out: type=String, direction=OUT
        SamplePointer
          arg SamplePointer_In: type=uint8_t, direction=IN
          arg SamplePointer_Out: type=uint8_t, direction=OUT
        IsReady
          arg IsReady_In: type=int8_t, direction=IN
          arg IsReady_Out: type=int8_t, direction=OUT
        DataElement_voltage
          arg DataElement_voltage_In: type=int8_t, direction=IN
          arg DataElement_voltage_Out: type=int8_t, direction=OUT
        BrakeLight
          arg BrakeLight_In: type=uint8_t, direction=IN
          arg BrakeLight_Out: type=uint8_t, direction=OUT
  service interface Odometry_Canoe
    namespaces:
      symbol props ara
      symbol props com
      symbol props sample
    events:
      18 x data:
        Event_uint8: type=uint8_t
        Event_uint16: type=uint16_t
        Event_uint32: type=uint32_t
        Event_unit64: type=uint64_t
        Event_int8: type=int8_t
        Event_int16: type=int16_t
        Event_int32: type=int32_t
        Event_int64: type=int64_t
        Event_float: type=float
        Event_double: type=double
        Event_enum: type=Enum_response
        Event_scalelinear: type=SLT_response
        Event_string: type=String
        Event_supplyvoltage: type=int8_t
        Event_temperature: type=int16_t
        Event_reestablishing: type=int32_t
        Event_samplepointer: type=uint8_t
        Event_MarkerInterface: type=uint8_t
    14 x field, all with has-getter=true, has-notifier=true, has-setter=true:
      Speed: type=uint8_t
      Velocity: type=uint16_t
      Pose2D: type=uint32_t
      AdditionalVehicleMotionInformation: type=uint64_t
      WheelCorrection: type=int8_t
      Acceleration: type=int16_t
      AngularRate: type=int32_t
      Time: type=int64_t
      Distance: type=float
      Position: type=double
      Field_enum: type=Enum_response
      Field_scalelinear: type=SLT_response
      Field_string: type=String
      fields_temperaturediscard: type=uint16_t
    methods:
      8 x operation:
        DataElement_basicDT
          20 x arg:
            SpeedDetection_In: type=uint8_t, direction=IN
            VelocityDetection_In: type=uint16_t, direction=IN
            Pose2DDetection_In: type=uint32_t, direction=IN
            AdditionalVehicleMotionInformationDetection_In: type=uint64_t, direction=IN
            WheelCorrectionDetection_In: type=int8_t, direction=IN
            AccelerationDetection_In: type=int16_t, direction=IN
            AngularRateDetection_In: type=int32_t, direction=IN
            TimeDetection_In: type=int64_t, direction=IN
            DistanceDetection_In: type=float, direction=IN
            PositionDetection_In: type=double, direction=IN
            SpeedDetection_Out: type=uint8_t, direction=OUT
            VelocityDetection_Out: type=uint16_t, direction=OUT
            Pose2DDetection_Out: type=uint32_t, direction=OUT
            AdditionalVehicleMotionInformationDetection_Out: type=uint64_t, direction=OUT
            WheelCorrectionDetection_Out: type=int8_t, direction=OUT
            AccelerationDetection_Out: type=int16_t, direction=OUT
            AngularRateDetection_Out: type=int32_t, direction=OUT
            TimeDetection_Out: type=int64_t, direction=OUT
            DistanceDetection_Out: type=float, direction=OUT
            PositionDetection_Out: type=double, direction=OUT
        DataElement_enum
          arg Enum_In: type=Enum_response, direction=IN
          arg Enum_Out: type=Enum_response, direction=OUT
        DataElement_scalelinear
          arg Scalelinear_In: type=SLT_response, direction=IN
          arg Scalelinear_Out: type=SLT_response, direction=OUT
        DataElement_string
          arg String_In: type=String, direction=IN
          arg String_Out: type=String, direction=OUT
        SamplePointer
          arg SamplePointer_In: type=uint8_t, direction=IN
          arg SamplePointer_Out: type=uint8_t, direction=OUT
        IsReady
          arg IsReady_In: type=int8_t, direction=IN
          arg IsReady_Out: type=int8_t, direction=OUT
        DataElement_voltage
          arg DataElement_voltage_In: type=int8_t, direction=IN
          arg DataElement_voltage_Out: type=int8_t, direction=OUT
        BrakeLight
          arg BrakeLight_In: type=uint8_t, direction=IN
          arg BrakeLight_Out: type=uint8_t, direction=OUT
