AUTOSAR XML (schema 00048)
package /ServiceInstanceToPortMapping
  service instance to port prototype mapping HashFunctionCtxToPortMapping: port-prototype=rootSwComponentPrototype.PPortHashFunctionCtx, process=qt_crypto_instance1, service-instance=HashFunctionCtx
