AUTOSAR XML (schema 00048)
package /SomeIpServiceInterfaceDeployment
  someip service interface deployment StreamCipherCtx_Someip: service-interface=StreamCipherCtx, service-interface-id=33, service-interface-version={major-version=0, minor-version=0}
    17 x someip method deployment, all with transport-protocol=UDP:
      CountBytesInCache: method=CountBytesInCache, method-id=1
      EstimateMaxInputSize: method=EstimateMaxInputSize, method-id=2
      EstimateRequiredCapacity: method=EstimateRequiredCapacity, method-id=3
      FinishBytes: method=FinishBytes, method-id=4
      GetBlockService: method=GetBlockService, method-id=5
      IsBytewiseMode: method=IsBytewiseMode, method-id=6
      GetTransformation: method=GetTransformation, method-id=7
      IsSeekableMode: method=IsSeekableMode, method-id=8
      ProcessBlocksReadOnlyMemRegion: method=ProcessBlocksReadOnlyMemRegion, method-id=9
      ProcessBlocksReadWriteMemRegion: method=ProcessBlocksReadWriteMemRegion, method-id=10
      ProcessBytesReadOnlyMemRegion: method=ProcessBytesReadOnlyMemRegion, method-id=11
      Reset: method=Reset, method-id=12
      Seek: method=Seek, method-id=13
      SetKey: method=SetKey, method-id=14
      StartReadOnlyMemRegion: method=StartReadOnlyMemRegion, method-id=15
      StartSecretSeed: method=StartSecretSeed, method-id=16
      isInitialized: method=isInitialized, method-id=17
