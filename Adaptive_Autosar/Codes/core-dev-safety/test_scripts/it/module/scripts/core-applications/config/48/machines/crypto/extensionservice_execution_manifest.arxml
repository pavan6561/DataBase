AUTOSAR XML (schema 00048)
package /ServiceInstanceToPortMapping
  service instance to port prototype mapping ExtensionServiceToPortPrototypeMapping: port-prototype=rootSwComponentPrototype.PPortExtensionService, process=ProcessDesignqt_crypto_instance1, service-instance=ExtensionService
