AUTOSAR XML (schema 00049)
package /ServiceInstanceToPortMapping
  service instance to port prototype mapping DigestServiceToPortPrototypeMapping: port-prototype=rootSwComponentPrototype.PPortDigestService, process-design=qt_crypto_instance1, process=qt_crypto_instance1, service-instance=DigestService
