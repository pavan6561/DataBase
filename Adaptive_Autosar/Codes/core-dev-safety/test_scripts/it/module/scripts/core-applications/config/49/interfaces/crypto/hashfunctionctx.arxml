AUTOSAR XML (schema 00049)
package /ServiceInterface
  service interface HashFunctionCtx
    namespaces:
      4 x symbol props:
        qt
        crypto
        cryptoprovider_001
        hash
    methods:
      9 x operation:
        Start: possible-ap-error=[InvalidInputSize, Unsupported, UndefinedApplicationError, MissingArgument]
          arg hashId: type=uint8_t, direction=IN
          arg iv: type=ByteArray, direction=IN
          arg response: type=uint64_t, direction=OUT
        Update: possible-ap-error=[ProcessingNotStarted, UndefinedApplicationError]
          arg hashId: type=uint8_t, direction=IN
          arg input: type=ByteArray, direction=IN
          arg response: type=uint64_t, direction=OUT
        Finish: possible-ap-error=[ProcessingNotStarted, InvalidUsageOrder, UndefinedApplicationError]
          arg hashId: type=uint8_t, direction=IN
          arg response: type=returnFinishResponse, direction=OUT
        GetDigest: possible-ap-error=[ProcessingNotFinished, UndefinedApplicationError]
          arg hashId: type=uint8_t, direction=IN
          arg offset: type=uint8_t, direction=IN
          arg response: type=returnGetDigestResponse, direction=OUT
        GetDigestService
          arg rngId: type=uint8_t, direction=IN
          arg response: type=uint64_t, direction=OUT
        StartNP: possible-ap-error=[MissingArgument, UndefinedApplicationError]
          arg hashId: type=uint8_t, direction=IN
          arg response: type=uint64_t, direction=OUT
        StartSecretSeed: possible-ap-error=[InvalidInputSize, Unsupported, UndefinedApplicationError]
          arg hashId: type=uint8_t, direction=IN
          arg iv: type=uint16_t, direction=IN
          arg response: type=uint64_t, direction=OUT
        UpdateUint8: possible-ap-error=[ProcessingNotStarted, UndefinedApplicationError]
          arg hashId: type=uint8_t, direction=IN
          arg input: type=uint8_t, direction=IN
          arg response: type=uint64_t, direction=OUT
        UpdateRestrictedUseObject: possible-ap-error=[ProcessingNotStarted, UndefinedApplicationError]
          arg hashId: type=uint8_t, direction=IN
          arg input: type=uint8_t, direction=IN
          arg response: type=uint64_t, direction=OUT
