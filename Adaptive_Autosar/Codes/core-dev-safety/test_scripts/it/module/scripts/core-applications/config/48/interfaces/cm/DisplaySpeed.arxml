AUTOSAR XML (schema 00048)
package /ServiceInterfaces
  service interface DisplaySpeed
    namespaces:
      symbol props ara
      symbol props com
      symbol props sample
    events:
      17 x data:
        Event_struct: type=RadarObjects
        Event_vector: type=VectorCppIdt
        Event_array: type=ArrayCppIdt
        Event_struct_serialize: type=Struct_Serialize
        EventByteOrder: type=Struct_ByteOrder
        EventLengthField: type=Struct_LengthField
        Event_Order: type=StructLengthOrder
        Event_DynamicTrue: type=Dynamic_true
        Event_DynamicFalse: type=Dynamic_false
        Event_Length: type=LengthTypeOne
        Event_TLV: type=TLVLength
        Event_Length2MSBF: type=Length2MSBF
        Event_Length2MSBL: type=Length2MSBL
        Event_Length4MSBF: type=Length4MSBF
        Event_Length4MSBL: type=Length4MSBL
        Event_SomeIpSeg: type=VectorSomeipSeg
        Event_SameData: type=EventSameData
    12 x field, all with has-getter=true, has-notifier=true, has-setter=true:
      Condition: type=Position
      Identifier: type=Vector_distance
      Status: type=Array_distance
      PowerStruct: type=Struct_position_serialize
      ByteOrder: type=Struct_Byte
      StructOrder: type=Struct_order
      StructLength: type=StructLengthData
      DynamicTrue: type=Dynamictrue_Data
      DynamicFalse: type=DynamicFalseData
      LengthOne: type=DataTypeLength
      TLVDataLength: type=TLVDataType
      FieldSubscribe: type=FieldSubscribe
    methods:
      8 x operation:
        InitMonitor: possible-ap-error=[InvalidConfigString, InvalidParameter, GenericFailure]
          6 x arg:
            FaultDetection: type=Distances, direction=IN
            HandleMessage: type=Vector_analysis, direction=IN
            EnableStatus: type=Array_analysis, direction=IN
            ExecuteReset: type=Distances, direction=OUT
            PrepareForReset: type=Vector_analysis, direction=OUT
            NetworkRequest: type=Array_analysis, direction=OUT
        DataElement_struct
          arg Struct_In: type=Duration, direction=IN
          arg Struct_Out: type=Duration, direction=OUT
        DataElement_vector
          arg Vector_In: type=Vector_control, direction=IN
          arg Vector_Out: type=Vector_control, direction=OUT
        DataElement_array: possible-ap-error=[InvalidConfigString, InvalidParameter, GenericFailure]
          arg Array_In: type=Array_control, direction=IN
          arg Array_Out: type=Array_control, direction=OUT
        Echo_array: fire-and-forget=true
          arg text_array: type=ArrayCppIdt, direction=IN
        SubscriptionState
          arg SubscriptionState_In: type=EventSubscriptionStates, direction=IN
          arg SubscriptionState_Out: type=EventSubscriptionStates, direction=OUT
        SampleCount
          arg Sample_In: type=int8_t, direction=IN
          arg Sample_out: type=int8_t, direction=OUT
        DataElement_TLV
          arg InTLV: type=DataTypeTLV, direction=IN
          arg OutTLV: type=DataTypeTLV, direction=OUT
  service interface DisplaySpeed_Canoe
    namespaces:
      symbol props ara
      symbol props com
      symbol props sample
    events:
      17 x data:
        Event_struct: type=RadarObjects
        Event_vector: type=VectorCppIdt
        Event_array: type=ArrayCppIdt
        Event_struct_serialize: type=Struct_Serialize
        EventByteOrder: type=Struct_ByteOrder
        EventLengthField: type=Struct_LengthField
        Event_Order: type=StructLengthOrder
        Event_DynamicTrue: type=Dynamic_true
        Event_DynamicFalse: type=Dynamic_false
        Event_Length: type=LengthTypeOne
        Event_TLV: type=TLVLength
        Event_Length2MSBF: type=Length2MSBF
        Event_Length2MSBL: type=Length2MSBL
        Event_Length4MSBF: type=Length4MSBF
        Event_Length4MSBL: type=Length4MSBL
        Event_SomeIpSeg: type=VectorSomeipSeg
        Event_SameData: type=EventSameData
    12 x field, all with has-getter=true, has-notifier=true, has-setter=true:
      Condition: type=Position
      Identifier: type=Vector_distance
      Status: type=Array_distance
      PowerStruct: type=Struct_position_serialize
      ByteOrder: type=Struct_Byte
      StructOrder: type=Struct_order
      StructLength: type=StructLengthData
      DynamicTrue: type=Dynamictrue_Data
      DynamicFalse: type=DynamicFalseData
      LengthOne: type=DataTypeLength
      TLVDataLength: type=TLVDataType
      FieldSubscribe: type=FieldSubscribe
    methods:
      8 x operation:
        InitMonitor: possible-ap-error=[InvalidConfigString, InvalidParameter, GenericFailure]
          6 x arg:
            FaultDetection: type=Distances, direction=IN
            HandleMessage: type=Vector_analysis, direction=IN
            EnableStatus: type=Array_analysis, direction=IN
            ExecuteReset: type=Distances, direction=OUT
            PrepareForReset: type=Vector_analysis, direction=OUT
            NetworkRequest: type=Array_analysis, direction=OUT
        DataElement_struct
          arg Struct_In: type=Duration, direction=IN
          arg Struct_Out: type=Duration, direction=OUT
        DataElement_vector
          arg Vector_In: type=Vector_control, direction=IN
          arg Vector_Out: type=Vector_control, direction=OUT
        DataElement_array: possible-ap-error=[InvalidConfigString, InvalidParameter, GenericFailure]
          arg Array_In: type=Array_control, direction=IN
          arg Array_Out: type=Array_control, direction=OUT
        Echo_array
          arg text_array: type=ArrayCppIdt, direction=IN
        SubscriptionState
          arg SubscriptionState_In: type=EventSubscriptionStates, direction=IN
          arg SubscriptionState_Out: type=EventSubscriptionStates, direction=OUT
        SampleCount
          arg Sample_In: type=int8_t, direction=IN
          arg Sample_Out: type=int8_t, direction=OUT
        DataElement_TLV
          arg InTLV: type=DataTypeTLV, direction=IN
          arg OutTLV: type=DataTypeTLV, direction=OUT
package /TransformationPropsSets
  transformation props set StructTransformationPropsSet
    12 x ap someip transformation props:
      StructLegth2MSBF: byte-order=big-endian, size-of-struct-length-field=2
      NoLengthApSomeipTransformationProps: byte-order=big-endian, size-of-struct-length-field=2
      ByteOrderApSomeipTransformationProps: byte-order=little-endian, size-of-struct-length-field=4
      NoByteOrderApSomeipTransformationProps: size-of-struct-length-field=2
      DymanicFalseApSomeipTransformationProps: byte-order=little-endian, is-dynamic-length-field-size=false, size-of-array-length-field=4, size-of-string-length-field=4, size-of-struct-length-field=4
      DynamicTrueApSomeipTransformationProps: byte-order=little-endian, is-dynamic-length-field-size=true, size-of-struct-length-field=4
      StructLength1ApSomeipTransformationProps: size-of-struct-length-field=1
      TLVApSomeipTransformationProps: byte-order=big-endian, size-of-struct-length-field=4
      OptionalApSomeipTransformationProps: byte-order=little-endian, size-of-struct-length-field=4
      StructLength2MSBL: byte-order=little-endian, size-of-struct-length-field=2
      StructLength4MSBF: byte-order=big-endian, size-of-struct-length-field=4
      StructLength4MSBL: byte-order=little-endian, size-of-struct-length-field=4
  transformation props set StructCanoeTransformationPropsSet
    12 x ap someip transformation props:
      StructLegth2MSBF: byte-order=big-endian, size-of-struct-length-field=2
      NoLengthApSomeipTransformationProps
      ByteOrderApSomeipTransformationProps: byte-order=little-endian, size-of-struct-length-field=4
      NoByteOrderApSomeipTransformationProps: size-of-struct-length-field=1
      DymanicFalseApSomeipTransformationProps: byte-order=little-endian, is-dynamic-length-field-size=false, size-of-array-length-field=4, size-of-string-length-field=4, size-of-struct-length-field=4
      DynamicTrueApSomeipTransformationProps: byte-order=little-endian, is-dynamic-length-field-size=true, size-of-struct-length-field=4
      StructLength1ApSomeipTransformationProps: size-of-struct-length-field=1
      TLVApSomeipTransformationProps: byte-order=big-endian, size-of-struct-length-field=4
      OptionalApSomeipTransformationProps: byte-order=little-endian, size-of-struct-length-field=4
      StructLength2MSBL: byte-order=little-endian, size-of-struct-length-field=2
      StructLength4MSBF: byte-order=big-endian, size-of-struct-length-field=4
      StructLength4MSBL: byte-order=little-endian, size-of-struct-length-field=4
package /TransformationPropsToServiceInterfaceMappingSets
  transformation props to service interface element mapping set StructTransformationPropsToServiceInterfaceElementMappingSet
    11 x transformation props to service interface element mapping:
      TLVStructmappings: event=DisplaySpeed/Event_TLV, field=DisplaySpeed/TLVDataLength, method=DisplaySpeed/DataElement_TLV, tlv-data-id-definition=DataIdTlvDataIdDefinitionSet, transformation-props=StructTransformationPropsSet/TLVApSomeipTransformationProps
      ByteOrdermappings: event=DisplaySpeed/EventLengthField, field=DisplaySpeed/ByteOrder, transformation-props=StructTransformationPropsSet/ByteOrderApSomeipTransformationProps
      NoByteOrdermappings: event=DisplaySpeed/Event_Order, field=DisplaySpeed/StructLength, transformation-props=StructTransformationPropsSet/NoByteOrderApSomeipTransformationProps
      DynamicFalsemappings: event=DisplaySpeed/Event_DynamicFalse, field=DisplaySpeed/DynamicFalse, tlv-data-id-definition=DynamicFalseTlvDataIdDefinitionSet, transformation-props=StructTransformationPropsSet/DymanicFalseApSomeipTransformationProps
      DynamicTruemappings: event=DisplaySpeed/Event_DynamicTrue, field=DisplaySpeed/DynamicTrue, tlv-data-id-definition=DynamicTrueTlvDataIdDefinitionSet, transformation-props=StructTransformationPropsSet/DynamicTrueApSomeipTransformationProps
      StructLength1mappings: event=DisplaySpeed/Event_Length, field=DisplaySpeed/LengthOne, transformation-props=StructTransformationPropsSet/StructLength1ApSomeipTransformationProps
      Optionalmappings: event=DisplaySpeed/EventByteOrder, tlv-data-id-definition=OptionalTlvDataIdDefinitionSet, transformation-props=StructTransformationPropsSet/OptionalApSomeipTransformationProps
      Length2MSBF: event=[DisplaySpeed/Event_Length2MSBF, DisplaySpeed/Event_struct_serialize], transformation-props=StructTransformationPropsSet/StructLegth2MSBF
      Length2MSBL: event=DisplaySpeed/Event_Length2MSBL, transformation-props=StructTransformationPropsSet/StructLength2MSBL
      Length4MSBF: event=DisplaySpeed/Event_Length4MSBF, transformation-props=StructTransformationPropsSet/StructLength4MSBF
      Length4MSBL: event=DisplaySpeed/Event_Length4MSBL, transformation-props=StructTransformationPropsSet/StructLength4MSBL
  transformation props to service interface element mapping set StructCanoeTransformationPropsToServiceInterfaceElementMappingSet
    11 x transformation props to service interface element mapping:
      TLVStructmappings: event=DisplaySpeed_Canoe/Event_TLV, field=DisplaySpeed_Canoe/TLVDataLength, method=DisplaySpeed_Canoe/DataElement_TLV, tlv-data-id-definition=CanoeDataIDTlvDataIdDefinitionSet, transformation-props=StructCanoeTransformationPropsSet/TLVApSomeipTransformationProps
      ByteOrdermappings: event=DisplaySpeed_Canoe/EventLengthField, field=DisplaySpeed_Canoe/ByteOrder, transformation-props=StructCanoeTransformationPropsSet/ByteOrderApSomeipTransformationProps
      NoByteOrdermappings: event=DisplaySpeed_Canoe/Event_Order, field=DisplaySpeed_Canoe/StructLength, transformation-props=StructCanoeTransformationPropsSet/NoByteOrderApSomeipTransformationProps
      DynamicFalsemappings: event=DisplaySpeed_Canoe/Event_DynamicFalse, field=DisplaySpeed_Canoe/DynamicFalse, tlv-data-id-definition=CanoeDynamicFalseTlvDataIdDefinitionSet, transformation-props=StructCanoeTransformationPropsSet/DymanicFalseApSomeipTransformationProps
      DynamicTruemappings: event=DisplaySpeed_Canoe/Event_DynamicTrue, field=DisplaySpeed_Canoe/DynamicTrue, tlv-data-id-definition=CanoeDynamicTrueTlvDataIdDefinitionSet, transformation-props=StructCanoeTransformationPropsSet/DynamicTrueApSomeipTransformationProps
      StructLength1mappings: event=DisplaySpeed_Canoe/Event_Length, field=DisplaySpeed_Canoe/LengthOne, transformation-props=StructCanoeTransformationPropsSet/StructLength1ApSomeipTransformationProps
      Optionalmappings: event=DisplaySpeed_Canoe/EventByteOrder, tlv-data-id-definition=CanoeOptionalTlvDataIdDefinitionSet, transformation-props=StructCanoeTransformationPropsSet/OptionalApSomeipTransformationProps
      Length2MSBF: event=[DisplaySpeed_Canoe/Event_Length2MSBF, DisplaySpeed_Canoe/Event_struct_serialize], transformation-props=StructCanoeTransformationPropsSet/StructLegth2MSBF
      Length2MSBL: event=DisplaySpeed_Canoe/Event_Length2MSBL, transformation-props=StructCanoeTransformationPropsSet/StructLength2MSBL
      Length4MSBF: event=DisplaySpeed_Canoe/Event_Length4MSBF, transformation-props=StructCanoeTransformationPropsSet/StructLength4MSBF
      Length4MSBL: event=DisplaySpeed_Canoe/Event_Length4MSBL, transformation-props=StructCanoeTransformationPropsSet/StructLength4MSBL
package /SomeipDataPrototypeTransformationProps
  18 x someip data prototype transformation props:
    StructLength2MSBF: data-prototypes=Event_Length2MSBF, someip-transformation-props=StructTransformationPropsSet/StructLegth2MSBF
    NoLengthSomeipDataPrototypeTransformationProps: data-prototypes=Event_struct_serialize, someip-transformation-props=StructTransformationPropsSet/NoLengthApSomeipTransformationProps
    ByteOrderSomeipDataPrototypeTransformationProps: data-prototypes=StructOrder, someip-transformation-props=StructTransformationPropsSet/ByteOrderApSomeipTransformationProps
    NoByteOrderSomeipDataPrototypeTransformationProps: data-prototypes=EventLengthField.ByteOrder, someip-transformation-props=StructTransformationPropsSet/NoByteOrderApSomeipTransformationProps
    NoByteOrder: data-prototypes=StructLength.Event_Order, someip-transformation-props=StructTransformationPropsSet/NoByteOrderApSomeipTransformationProps
    StructLength1SomeipDataPrototypeTransformationProps: data-prototypes=LengthOne.Event_Length, someip-transformation-props=StructTransformationPropsSet/StructLength1ApSomeipTransformationProps
    CanoeStructLength2MSBF: data-prototypes=Event_Length2MSBF, someip-transformation-props=StructCanoeTransformationPropsSet/StructLegth2MSBF
    CanoeNoLengthSomeipDataPrototypeTransformationProps: data-prototypes=Event_struct_serialize, someip-transformation-props=StructCanoeTransformationPropsSet/NoLengthApSomeipTransformationProps
    CanoeByteOrderSomeipDataPrototypeTransformationProps: data-prototypes=StructOrder, someip-transformation-props=StructCanoeTransformationPropsSet/ByteOrderApSomeipTransformationProps
    CanoeNoByteOrderSomeipDataPrototypeTransformationProps: data-prototypes=EventLengthField.ByteOrder, someip-transformation-props=StructCanoeTransformationPropsSet/NoByteOrderApSomeipTransformationProps
    CanoeNoByteOrder: data-prototypes=StructLength.Event_Order, someip-transformation-props=StructCanoeTransformationPropsSet/NoByteOrderApSomeipTransformationProps
    CanoeStructLength1SomeipDataPrototypeTransformationProps: data-prototypes=LengthOne.Event_Length, someip-transformation-props=StructCanoeTransformationPropsSet/StructLength1ApSomeipTransformationProps
    StructLength2MSBL: data-prototypes=Event_Length2MSBL, someip-transformation-props=StructTransformationPropsSet/StructLength2MSBL
    CanoeStructLength2MSBL: data-prototypes=Event_Length2MSBL, someip-transformation-props=StructCanoeTransformationPropsSet/StructLength2MSBL
    StructLength4MSBF: data-prototypes=Event_Length4MSBF, someip-transformation-props=StructTransformationPropsSet/StructLength4MSBF
    StructLength4MSBL: data-prototypes=Event_Length4MSBL, someip-transformation-props=StructTransformationPropsSet/StructLength4MSBL
    CanoeStructLength4MSBF: data-prototypes=Event_Length4MSBF, someip-transformation-props=StructCanoeTransformationPropsSet/StructLength4MSBF
    CanoeStructLength4MSBL: data-prototypes=Event_Length4MSBL, someip-transformation-props=StructCanoeTransformationPropsSet/StructLength4MSBL
package /TlvDataIdDefinitionSet
  8 x tlv data id definition set:
    DataIdTlvDataIdDefinitionSet
      tlv-data-id-definitions:
        id=1, tlv-sub-element=subElements1
        id=2, tlv-sub-element=subElements1
        id=3, tlv-sub-element=Type8
        id=4, tlv-sub-element=Type16
        id=5, tlv-sub-element=Type32
        id=6, tlv-argument=DataElement_TLV/InTLV, tlv-sub-element=Type64
        id=7, tlv-argument=DataElement_TLV/OutTLV, tlv-sub-element=structSubElement
        id=8, tlv-sub-element=subElements2
        id=9, tlv-sub-element=subElements2
    DynamicFalseTlvDataIdDefinitionSet: tlv-data-id-definitions=[{id=1, tlv-sub-element=subElements1}, {id=2, tlv-sub-element=subElements2}]
    CanoeDataIDTlvDataIdDefinitionSet
      tlv-data-id-definitions:
        id=2, tlv-sub-element=subElements1
        id=1, tlv-sub-element=subElements1
        id=3, tlv-sub-element=Type8
        id=4, tlv-sub-element=Type16
        id=5, tlv-sub-element=Type32
        id=6, tlv-argument=DataElement_TLV/InTLV, tlv-sub-element=Type64
        id=7, tlv-argument=DataElement_TLV/OutTLV, tlv-sub-element=structSubElement
        id=7, tlv-sub-element=subElements2
        id=8, tlv-sub-element=subElements2
    CanoeDynamicFalseTlvDataIdDefinitionSet: tlv-data-id-definitions=[{id=2, tlv-sub-element=subElements2}, {id=1, tlv-sub-element=subElements1}]
    OptionalTlvDataIdDefinitionSet: tlv-data-id-definitions=[{id=1, tlv-sub-element=subElements1}, {id=2, tlv-sub-element=subElements2}]
    DynamicTrueTlvDataIdDefinitionSet: tlv-data-id-definitions=[{id=1, tlv-sub-element=subElements1}, {id=2, tlv-sub-element=subElements2}]
    CanoeOptionalTlvDataIdDefinitionSet: tlv-data-id-definitions=[{id=1, tlv-sub-element=subElements1}, {id=2, tlv-sub-element=subElements2}]
    CanoeDynamicTrueTlvDataIdDefinitionSet: tlv-data-id-definitions=[{id=1, tlv-sub-element=subElements1}, {id=2, tlv-sub-element=subElements2}]
