AUTOSAR XML (schema 00049)
package /ServiceInterface
  service interface CertSignRequest
    namespaces:
      4 x symbol props:
        qt
        crypto
        x509
        csr
    methods:
      4 x operation:
        Verify: possible-ap-error=UndefinedApplicationError
          arg csrId: type=uint8_t, direction=IN
          arg response: type=returnBool, direction=OUT
        ExportASN1CertSignRequest: possible-ap-error=[InvalidUsageOrder, UndefinedApplicationError]
          arg csrId: type=uint8_t, direction=IN
          arg response: type=returnByteArray, direction=OUT
        GetSignature: possible-ap-error=UndefinedApplicationError
          arg csrId: type=uint8_t, direction=IN
          arg response: type=uint64_t, direction=OUT
        Version: possible-ap-error=UndefinedApplicationError
          arg csrId: type=uint8_t, direction=IN
          arg response: type=uint64_t, direction=OUT
