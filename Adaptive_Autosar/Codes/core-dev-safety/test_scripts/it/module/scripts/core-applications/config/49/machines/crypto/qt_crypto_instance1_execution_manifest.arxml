AUTOSAR XML (schema 00049)
package /ServiceInstanceToPortPrototypeMappings
  service instance to port prototype mapping CryptoProviderPortMapping: port-prototype=rootSwComponentPrototype.PPortCryptoProvider, process-design=qt_crypto_instance1, process=qt_crypto_instance1, service-instance=CryptoProvider
  crypto provider to port prototype mapping OpenSSLMappingToPortPrototypeMapping: crypto-provider=CryptoOpenSSLProvider, port-prototype=rootSwComponentPrototype.RPortCryptoProviderPrototype, process=qt_crypto_instance1
  crypto provider to port prototype mapping CryptoProviderUCMPortMapping: crypto-provider=CryptoOpenSSLProvider, port-prototype=rootSwComponentPrototype.RPortCryptoProviderUCMPrototype, process=package_manager
