AUTOSAR XML (schema 00048)
package /ServiceInterface
  service interface MsgRecoveryPublicCtx
    namespaces:
      4 x symbol props:
        qt
        crypto
        cryptoprovider_001
        msg
    methods:
      6 x operation:
        GetExtensionService: possible-ap-error=UndefinedApplicationError
          arg msgId: type=uint8_t, direction=IN
          arg response: type=uint64_t, direction=OUT
        GetMaxInputSize: possible-ap-error=UndefinedApplicationError
          arg msgId: type=uint8_t, direction=IN
          arg suppressPadding: type=bool, direction=IN
          arg response: type=uint64_t, direction=OUT
        GetMaxOutputSize: possible-ap-error=UndefinedApplicationError
          arg msgId: type=uint8_t, direction=IN
          arg suppressPadding: type=bool, direction=IN
          arg response: type=uint64_t, direction=OUT
        DecodeAndVerify: possible-ap-error=[InvalidInputSize, UninitializedContext, UndefinedApplicationError]
          arg msgId: type=uint8_t, direction=IN
          arg input: type=ByteArray, direction=IN
          arg response: type=returnByteArray, direction=OUT
        Reset: possible-ap-error=UndefinedApplicationError
          arg msgId: type=uint8_t, direction=IN
          arg response: type=uint64_t, direction=OUT
        SetKey: possible-ap-error=[IncompatibleObject, UsageViolation, UndefinedApplicationError]
          arg msgId: type=uint8_t, direction=IN
          arg key: type=uint8_t, direction=IN
          arg response: type=uint64_t, direction=OUT
