AUTOSAR XML (schema 00048)
package /ServiceInstanceToPortMapping
  service instance to port prototype mapping SecretSeedToPortPrototypeMapping: port-prototype=rootSwComponentPrototype.PPortSecretSeed, process=qt_crypto_instance1, service-instance=SecretSeed
