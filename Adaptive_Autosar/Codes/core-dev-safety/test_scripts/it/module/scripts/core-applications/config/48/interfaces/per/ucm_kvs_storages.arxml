AUTOSAR XML (schema 00048)
package /ara/apd/ucm/PersistencyKeyValueStorages
  persistency key value storage SwPackageTransferStatusStorage: uri=/opt/package_manager/var/swpackage_transfer_status_database.json
  persistency key value storage SwPackageCurrentStatusDatabase: uri=/opt/package_manager/var/swpackage_current_status_database.json
