AUTOSAR XML (schema 00049)
package /ApplicationErrorDomains
  ap application error domain Security: value=1
    namespaces:
      symbol props qt
      symbol props crypto
package /ApplicationErrors
  38 x ap application error, all with error-domain=Security:
    AboveBoundary: error-code=861641071
    AccessViolation: error-code=50528256
    AuthTagNotValid: error-code=33619976
    BadObjectReference: error-code=50331652
    BadObjectType: error-code=50397440
    BelowBoundary: error-code=33619974
    BruteForceRisk: error-code=50331650
    BusyResource: error-code=16777218
    ContentDuplication: error-code=50331654
    ContentRestrictions: error-code=50331651
    EmptyContainer: error-code=50397187
    ErrorClass: error-code=16777216
    ErrorSubClass: error-code=65536
    ErrorSubSubClass: error-code=256
    InOutBuffersIntersect: error-code=33619973
    IncompatibleArguments: error-code=33619972
    IncompatibleObject: error-code=50397185
    IncompleteArgState: error-code=50397186
    InsufficientCapacity: error-code=33619970
    InsufficientResource: error-code=16777219
    InvalidArgument: error-code=33619968
    InvalidInputSize: error-code=33619971
    InvalidUsageOrder: error-code=33685504
    LogicFault: error-code=33554432
    MissingArgument: error-code=50397188
    ModifiedResource: error-code=16777221
    ProcessingNotFinished: error-code=33685507
    ProcessingNotStarted: error-code=33685506
    ResourceFault: error-code=16777217
    RuntimeFault: error-code=50331648
    UnexpectedValue: error-code=50397184
    UninitializedContext: error-code=33685505
    UnknownIdentifier: error-code=33619969
    UnreservedResource: error-code=16777220
    Unsupported: error-code=33620224
    UnsupportedFormat: error-code=50331649
    UsageViolation: error-code=50462720
    UndefinedApplicationError: error-code=100
