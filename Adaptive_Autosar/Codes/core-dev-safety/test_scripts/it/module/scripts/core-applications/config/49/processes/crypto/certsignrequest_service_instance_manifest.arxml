AUTOSAR XML (schema 00049)
package /ServiceInstances
  provided someip service instance CertSignRequest: service-interface-deployment=CertSignRequest_Someip, sd-server-config=SomeipSdServerServiceInstance, service-instance-id=1
