AUTOSAR XML (schema 00049)
package /ServiceInstances
  provided someip service instance qt_phm_instance2: service-interface-deployment=PhmSupervisedEntity_Someip, sd-server-config=SomeipSdServerServiceInstance, service-instance-id=2
package /ServiceInstanceToMachineMappings
  someip service instance to machine mapping QtPHMInstance2SomeipServiceInstanceToMachineMapping: communication-connector=EthernetCommunicationConnector, service-instance=qt_phm_instance2, udp-port=5002
