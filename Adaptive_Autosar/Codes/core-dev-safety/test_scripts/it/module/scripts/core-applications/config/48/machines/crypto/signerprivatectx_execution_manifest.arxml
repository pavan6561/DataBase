AUTOSAR XML (schema 00048)
package /ServiceInstanceToPortMapping
  service instance to port prototype mapping SignerPrivateCtxToPortMapping: port-prototype=rootSwComponentPrototype.PPortSignerPrivateCtx, process=qt_crypto_instance1, service-instance=SignerPrivateCtx
