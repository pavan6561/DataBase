AUTOSAR XML (schema 00048)
package /ServiceInterface
  service interface SymmetricBlockCipherCtx
    namespaces:
      4 x symbol props:
        qt
        crypto
        cryptoprovider_001
        block
    methods:
      9 x operation:
        GetCryptoService: possible-ap-error=UndefinedApplicationError
          arg blockId: type=uint8_t, direction=IN
          arg response: type=uint64_t, direction=OUT
        GetTransformation: possible-ap-error=[UninitializedContext, UndefinedApplicationError]
          arg blockId: type=uint8_t, direction=IN
          arg response: type=returnCryptoTransform, direction=OUT
        IsMaxInputOnly: possible-ap-error=[UninitializedContext, UndefinedApplicationError]
          arg blockId: type=uint8_t, direction=IN
          arg response: type=returnBool, direction=OUT
        IsMaxOutputOnly: possible-ap-error=[UninitializedContext, UndefinedApplicationError]
          arg blockId: type=uint8_t, direction=IN
          arg response: type=returnBool, direction=OUT
        ProcessBlocksuppressPadding: possible-ap-error=[InsufficientCapacity, UninitializedContext, UndefinedApplicationError]
          4 x arg:
            blockId: type=uint8_t, direction=IN
            input: type=ByteArray, direction=IN
            suppressPadding: type=bool, direction=IN
            response: type=returnByteArray, direction=OUT
        ProcessBlocks: possible-ap-error=[InsufficientCapacity, UninitializedContext, UndefinedApplicationError]
          arg blockId: type=uint8_t, direction=IN
          arg input: type=ByteArray, direction=IN
          arg response: type=returnProcessBlocks, direction=OUT
        Reset: possible-ap-error=UndefinedApplicationError
          arg blockId: type=uint8_t, direction=IN
          arg response: type=uint64_t, direction=OUT
        SetKey: possible-ap-error=[IncompatibleObject, UsageViolation]
          4 x arg:
            blockId: type=uint8_t, direction=IN
            key: type=uint16_t, direction=IN
            transform: type=uint64_t, direction=IN
            response: type=uint64_t, direction=OUT
        isInitialized: possible-ap-error=UndefinedApplicationError
          arg blockId: type=uint8_t, direction=IN
          arg response: type=returnBool, direction=OUT
