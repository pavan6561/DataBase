AUTOSAR XML (schema 00049)
package /ServiceInterface
  service interface BlockService
    namespaces:
      4 x symbol props:
        qt
        crypto
        cryptoprovider_001
        blockservice
    methods:
      4 x operation, all with possible-ap-error=UndefinedApplicationError:
        GetActualIvBitLength
          arg ivUid: type=uint8_t, direction=IN
          arg response: type=uint32_t, direction=OUT
          arg blockId: type=uint8_t, direction=IN
        GetBlockSize
          arg response: type=uint32_t, direction=OUT
          arg blockId: type=uint8_t, direction=IN
        GetIvSize
          arg response: type=uint32_t, direction=OUT
          arg blockId: type=uint8_t, direction=IN
        IsValidIvSize
          arg response: type=returnBool, direction=OUT
          arg blockId: type=uint8_t, direction=IN
