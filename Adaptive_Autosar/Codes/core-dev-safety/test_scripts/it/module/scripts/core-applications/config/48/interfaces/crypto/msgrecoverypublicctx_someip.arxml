AUTOSAR XML (schema 00048)
package /SomeIpServiceInterfaceDeployment
  someip service interface deployment MsgRecoveryPublicCtx_Someip: service-interface=MsgRecoveryPublicCtx, service-interface-id=38, service-interface-version={major-version=0, minor-version=0}
    6 x someip method deployment, all with transport-protocol=UDP:
      GetExtensionService: method=GetExtensionService, method-id=1
      GetMaxInputSize: method=GetMaxInputSize, method-id=2
      GetMaxOutputSize: method=GetMaxOutputSize, method-id=3
      DecodeAndVerify: method=DecodeAndVerify, method-id=4
      Reset: method=Reset, method-id=5
      SetKey: method=SetKey, method-id=6
