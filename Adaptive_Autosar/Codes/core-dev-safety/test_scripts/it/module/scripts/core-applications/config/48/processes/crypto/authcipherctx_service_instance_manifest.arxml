AUTOSAR XML (schema 00048)
package /ServiceInstances
  provided someip service instance AuthCipherCtx: service-interface-deployment=AuthCipherCtx_Someip, sd-server-config=SomeipSdServerServiceInstance, service-instance-id=1
