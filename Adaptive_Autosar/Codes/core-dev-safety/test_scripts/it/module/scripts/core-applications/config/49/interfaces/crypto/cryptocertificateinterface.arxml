AUTOSAR XML (schema 00049)
package /CryptoInterfaces
  crypto certificate interface CryptoCertificateInterface: category=OPENSSL
