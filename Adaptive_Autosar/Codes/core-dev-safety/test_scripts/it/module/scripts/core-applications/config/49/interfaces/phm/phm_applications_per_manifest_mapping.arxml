AUTOSAR XML (schema 00049)
package /PersistanceToKeyValueStorageMappings
  persistency port prototype to key value storage mapping qt_phm_instance1_PersistencyPortPrototype: port-prototype=rootSwComponentPrototype, process=qt_phm_instance1, key-value-storage=qt_phm_instance1_persistance
  persistency port prototype to key value storage mapping qt_phm_instance3_PersistancyPortMapping: port-prototype=rootSwComponentPrototype, process=qt_phm_instance3, key-value-storage=qt_phm_instance3_persistance
