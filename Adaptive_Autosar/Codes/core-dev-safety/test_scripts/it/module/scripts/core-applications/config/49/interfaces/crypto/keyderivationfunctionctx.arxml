AUTOSAR XML (schema 00049)
package /ServiceInterface
  service interface KeyDerivationFunctionCtx
    namespaces:
      4 x symbol props:
        qt
        crypto
        cryptoprovider_001
        kdf
    methods:
      14 x operation:
        SetSourceKeyMaterial: possible-ap-error=[IncompatibleObject, UsageViolation, BruteForceRisk, UndefinedApplicationError]
          arg kdfId: type=uint8_t, direction=IN
          arg sourceKM: type=uint16_t, direction=IN
          arg response: type=uint64_t, direction=OUT
        AddSalt: possible-ap-error=[InvalidInputSize, UndefinedApplicationError]
          arg kdfId: type=uint8_t, direction=IN
          arg salt: type=ByteArray, direction=IN
          arg response: type=uint64_t, direction=OUT
        ConfigIterations: possible-ap-error=UndefinedApplicationError
          arg kdfId: type=uint8_t, direction=IN
          arg iterations: type=uint32_t, direction=IN
          arg count: type=uint32_t, direction=OUT
        DeriveKey: possible-ap-error=[UninitializedContext, UndefinedApplicationError]
          5 x arg:
            kdfId: type=uint8_t, direction=IN
            isSession: type=bool, direction=IN
            isExportable: type=bool, direction=IN
            keyId: type=uint8_t, direction=IN
            response: type=uint64_t, direction=OUT
        AddSecretSalt: possible-ap-error=UndefinedApplicationError
          arg kdfId: type=uint8_t, direction=IN
          arg salt: type=uint16_t, direction=IN
          arg response: type=uint64_t, direction=OUT
        DeriveSeed: possible-ap-error=[UninitializedContext, UndefinedApplicationError]
          5 x arg:
            kdfId: type=uint8_t, direction=IN
            isSession: type=bool, direction=IN
            isExportable: type=bool, direction=IN
            seedId: type=uint8_t, direction=IN
            response: type=uint64_t, direction=OUT
        Reset: possible-ap-error=UndefinedApplicationError
          arg kdfId: type=uint8_t, direction=IN
          arg response: type=uint64_t, direction=OUT
        GetExtensionService: possible-ap-error=UndefinedApplicationError
          arg kdfId: type=uint8_t, direction=IN
          arg uptr: type=uint64_t, direction=OUT
        GetKeyIdSize: possible-ap-error=UndefinedApplicationError
          arg kdfId: type=uint8_t, direction=IN
          arg size_t: type=uint64_t, direction=OUT
        GetTargetAlgId: possible-ap-error=UndefinedApplicationError
          arg kdfId: type=uint8_t, direction=IN
          arg AlgId: type=uint64_t, direction=OUT
        GetTargetAllowedUsage: possible-ap-error=UndefinedApplicationError
          arg kdfId: type=uint8_t, direction=IN
          arg AllowedUsageFlags: type=uint32_t, direction=OUT
        GetTargetKeyBitLength: possible-ap-error=UndefinedApplicationError
          arg kdfId: type=uint8_t, direction=IN
          arg size_t: type=uint64_t, direction=OUT
        Init: possible-ap-error=[IncompatibleArguments, UsageViolation, UndefinedApplicationError]
          6 x arg:
            kdfId: type=uint8_t, direction=IN
            targetKeyId: type=ByteArray, direction=IN
            targetAlgId: type=uint16_t, direction=IN
            allowedUsage: type=uint32_t, direction=IN
            ctxLabel: type=ByteArray, direction=IN
            response: type=uint64_t, direction=OUT
        isInitialized: possible-ap-error=UndefinedApplicationError
          arg kdfId: type=uint8_t, direction=IN
          arg response: type=returnBool, direction=OUT
