AUTOSAR XML (schema 00049)
package /ServiceInterfaceDeployments
  someip service interface deployment StateManager_Someip: service-interface=StateManager, service-interface-id=10, service-interface-version={major-version=0, minor-version=0}
    someip method deployment ChangeApplicationStateSomeip: method=ChangeApplicationState, method-id=5, transport-protocol=UDP
