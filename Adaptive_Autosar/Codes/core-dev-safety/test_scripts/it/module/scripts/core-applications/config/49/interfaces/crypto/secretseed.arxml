AUTOSAR XML (schema 00049)
package /ServiceInterface
  service interface SecretSeed
    namespaces:
      4 x symbol props:
        qt
        crypto
        cryptoprovider_001
        secretseed
    methods:
      6 x operation, all with possible-ap-error=UndefinedApplicationError:
        Jump
          arg seedId: type=uint8_t, direction=IN
          arg steps: type=int64_t, direction=IN
          arg response: type=uint64_t, direction=OUT
        Next
          arg seedId: type=uint8_t, direction=IN
          arg response: type=uint64_t, direction=OUT
        Clone
          5 x arg:
            seedId: type=uint8_t, direction=IN
            xorDelta: type=ByteArray, direction=IN
            response: type=uint64_t, direction=OUT
            nonConstSeedId: type=uint8_t, direction=IN
            whichSeed: type=uint8_t, direction=IN
        JumpFrom
          4 x arg:
            seedId: type=uint8_t, direction=IN
            toCallSeed: type=uint8_t, direction=IN
            steps: type=int64_t, direction=IN
            response: type=uint64_t, direction=OUT
        XorWithSeedObject
          4 x arg:
            nonConstObjectId: type=uint8_t, direction=IN
            seedObjectId: type=uint8_t, direction=IN
            whichSeed: type=bool, direction=IN
            response: type=uint8_t, direction=OUT
        XorWithByteArray
          arg nonConstObjectId: type=uint8_t, direction=IN
          arg inArray: type=ByteArray, direction=IN
          arg response: type=uint8_t, direction=OUT
