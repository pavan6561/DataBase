AUTOSAR XML (schema 00049)
package /ServiceInstances
  provided someip service instance MessageAuthCodeCtx: service-interface-deployment=MessageAuthCodeCtx_Someip, sd-server-config=SomeipSdServerServiceInstance, service-instance-id=1
