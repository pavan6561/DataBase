AUTOSAR XML (schema 00048)
package /Machines
  machine QtMachine: machine-design=QtMachine
    time sync module instantiation TimeSyncModuleInstantiation
