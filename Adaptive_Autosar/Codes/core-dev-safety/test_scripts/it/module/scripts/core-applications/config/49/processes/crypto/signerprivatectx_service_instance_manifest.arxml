AUTOSAR XML (schema 00049)
package /ServiceInstances
  provided someip service instance SignerPrivateCtx: service-interface-deployment=SignerPrivateCtx_Someip, sd-server-config=SomeipSdServerServiceInstance, service-instance-id=1
