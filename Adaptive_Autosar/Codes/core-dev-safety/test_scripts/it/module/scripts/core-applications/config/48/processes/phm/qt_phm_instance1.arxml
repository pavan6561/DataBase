AUTOSAR XML (schema 00048)
package /Processes
  process qt_phm_instance1: design=qt_phm_instance1, executable=qt_phm_instance1, state-dependent-startup-config{function-group-state=PHMApplicationStates.PHM_Instance1, resource-group=ResourceGroup, startup-config=qt_phm_instance1_startupconfig}
