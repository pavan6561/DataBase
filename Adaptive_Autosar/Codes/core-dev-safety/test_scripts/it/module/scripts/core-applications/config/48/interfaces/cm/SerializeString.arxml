AUTOSAR XML (schema 00048)
package /ServiceInterface
  service interface SerializeString
    namespaces:
      symbol props ara
      symbol props com
      symbol props sample
    events:
      9 x data:
        Event_String2MSBF: type=String2MSBF
        Event_String2MSBL: type=String2MSBL
        Event_String4MSBF: type=String4MSBF
        Event_String4MSBL: type=String4MSBL
        Event_StringOne: type=StringOne
        Event_StringBothNoLength: type=StringBothNoLength
        Event_StringBothNoByteOrder: type=StringBothNoByteOrder
        Event_StringNoLength: type=StringNolength
        Event_StringNoByteOrder: type=StringNoByteOrder
  service interface SerializeString_Canoe
    namespaces:
      symbol props ara
      symbol props com
      symbol props sample
    events:
      9 x data:
        Event_String2MSBF: type=String2MSBF
        Event_String2MSBL: type=String2MSBL
        Event_String4MSBF: type=String4MSBF
        Event_String4MSBL: type=String4MSBL
        Event_StringOne: type=StringOne
        Event_StringBothNoLength: type=StringBothNoLength
        Event_StringBothNoByteOrder: type=StringBothNoByteOrder
        Event_StringNoLength: type=StringNolength
        Event_StringNoByteOrder: type=StringNoByteOrder
package /TransformationPropsSet
  transformation props set StringTransformationPropsSet
    7 x ap someip transformation props:
      StringLength1: size-of-string-length-field=1, string-encoding=UTF-8
      String2MSBF: byte-order=big-endian, size-of-string-length-field=2, string-encoding=UTF-16
      String2MSBL: byte-order=little-endian, size-of-string-length-field=2, string-encoding=UTF-16
      String4MSBF: byte-order=big-endian, size-of-string-length-field=4
      String4MSBL: byte-order=little-endian, size-of-string-length-field=4
      StringNoLength
      StringNoByteOrder
  transformation props set StringCanoeTransformationPropsSet
    7 x ap someip transformation props:
      StringLength1: size-of-string-length-field=1, string-encoding=UTF-8
      String2MSBF: byte-order=big-endian, size-of-string-length-field=2, string-encoding=UTF-16
      String2MSBL: byte-order=little-endian, size-of-string-length-field=2, string-encoding=UTF-16
      String4MSBF: byte-order=big-endian, size-of-string-length-field=4
      String4MSBL: byte-order=little-endian, size-of-string-length-field=4
      StringNoLength
      StringNoByteOrder
package /TransformationPropsToServiceInterfaceElementMappings
  transformation props to service interface element mapping set StringTransformationPropsToServiceInterfaceElementMappingSet
    7 x transformation props to service interface element mapping:
      StringLength1: event=SerializeString/Event_StringOne, transformation-props=StringTransformationPropsSet/StringLength1
      String2MSBF: event=[SerializeString/Event_String2MSBF, SerializeString/Event_StringNoLength, SerializeString/Event_StringNoByteOrder], transformation-props=StringTransformationPropsSet/String2MSBF
      String2MSBL: event=SerializeString/Event_String2MSBL, transformation-props=StringTransformationPropsSet/String2MSBL
      String4MSBF: event=SerializeString/Event_String4MSBF, transformation-props=StringTransformationPropsSet/String4MSBF
      String4MSBL: event=SerializeString/Event_String4MSBL, transformation-props=StringTransformationPropsSet/String4MSBL
      StringNoLength: event=SerializeString/Event_StringBothNoLength, transformation-props=StringTransformationPropsSet/StringNoLength
      StringNoByteOrder: event=SerializeString/Event_StringBothNoByteOrder, transformation-props=StringTransformationPropsSet/StringNoByteOrder
  transformation props to service interface element mapping set StringCanoeTransformationPropsToServiceInterfaceElementMappingSet
    7 x transformation props to service interface element mapping:
      StringLength1: event=SerializeString_Canoe/Event_StringOne, transformation-props=StringCanoeTransformationPropsSet/StringLength1
      String2MSBF: event=[SerializeString_Canoe/Event_StringNoLength, SerializeString_Canoe/Event_StringNoByteOrder, SerializeString_Canoe/Event_String2MSBF], transformation-props=StringCanoeTransformationPropsSet/String2MSBF
      String2MSBL: event=SerializeString_Canoe/Event_String2MSBL, transformation-props=StringCanoeTransformationPropsSet/String2MSBL
      String4MSBF: event=SerializeString_Canoe/Event_String4MSBF, transformation-props=StringCanoeTransformationPropsSet/String4MSBF
      String4MSBL: event=SerializeString_Canoe/Event_String4MSBL, transformation-props=StringCanoeTransformationPropsSet/String4MSBL
      StringNoLength: event=SerializeString_Canoe/Event_StringBothNoLength, transformation-props=StringCanoeTransformationPropsSet/StringNoLength
      StringNoByteOrder: event=SerializeString_Canoe/Event_StringBothNoByteOrder, transformation-props=StringCanoeTransformationPropsSet/StringNoByteOrder
package /SomeipDataPrototypeTransformationProps
  14 x someip data prototype transformation props:
    StringlengthOne: data-prototypes=Event_StringOne, someip-transformation-props=StringTransformationPropsSet/StringLength1
    StringLength2MSBF: data-prototypes=Event_String2MSBF, someip-transformation-props=StringTransformationPropsSet/String2MSBF
    StringLength2MSBL: data-prototypes=Event_String2MSBL, someip-transformation-props=StringTransformationPropsSet/String2MSBL
    StringLength4MSBF: data-prototypes=Event_String4MSBF, someip-transformation-props=StringTransformationPropsSet/String4MSBF
    StringLength4MSBL: data-prototypes=Event_String4MSBL, someip-transformation-props=StringTransformationPropsSet/String4MSBL
    StringNoLength: data-prototypes=[Event_StringNoLength, Event_StringBothNoLength], someip-transformation-props=StringTransformationPropsSet/StringNoLength
    StringNoByteOrder: data-prototypes=[Event_StringNoByteOrder, Event_StringBothNoByteOrder], someip-transformation-props=StringTransformationPropsSet/StringNoByteOrder
    CanoeStringlengthOne: data-prototypes=Event_StringOne, someip-transformation-props=StringCanoeTransformationPropsSet/StringLength1
    CanoeStringLength2MSBF: data-prototypes=Event_String2MSBF, someip-transformation-props=StringCanoeTransformationPropsSet/String2MSBF
    CanoeStringLength2MSBL: data-prototypes=Event_String2MSBL, someip-transformation-props=StringCanoeTransformationPropsSet/String2MSBL
    CanoeStringLength4MSBF: data-prototypes=Event_String4MSBF, someip-transformation-props=StringCanoeTransformationPropsSet/String2MSBL
    CanoeStringLength4MSBL: data-prototypes=Event_String4MSBL, someip-transformation-props=StringCanoeTransformationPropsSet/String4MSBL
    CanoeStringNoLength: data-prototypes=[Event_StringNoLength, Event_StringBothNoLength], someip-transformation-props=StringCanoeTransformationPropsSet/StringNoLength
    CanoeStringNoByteOrder: data-prototypes=[Event_StringNoByteOrder, Event_StringBothNoByteOrder], someip-transformation-props=StringCanoeTransformationPropsSet/StringNoByteOrder
