AUTOSAR XML (schema 00049)
package /ServiceInterfaces
  provided someip service instance BasicCertInfo: service-interface-deployment=BasicCertInfo_Someip, sd-server-config=SomeipSdServerServiceInstance, service-instance-id=1
