AUTOSAR XML (schema 00049)
package /SomeIpServiceInterfaceDeployment
  someip service interface deployment PrivateKey_Someip: service-interface=PrivateKey, service-interface-id=77, service-interface-version={major-version=0, minor-version=0}
    someip method deployment GetPublicKey: method=GetPublicKey, method-id=1, transport-protocol=UDP
