AUTOSAR XML (schema 00049)
package /ServiceInterfaceDeployments
  user defined service interface deployment UpdateRequestSomeIp: service-interface=UpdateRequest
    6 x user defined method deployment:
      PrepareRollback: method=PrepareRollback
      PrepareUpdate: method=PrepareUpdate
      ResetMachine: method=ResetMachine
      StartUpdateSession: method=StartUpdateSession
      StopUpdateSession: method=StopUpdateSession
      VerfiyUpdate: method=VerifyUpdate
