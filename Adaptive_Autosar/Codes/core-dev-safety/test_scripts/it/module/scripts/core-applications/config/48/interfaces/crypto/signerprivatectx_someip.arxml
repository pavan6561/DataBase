AUTOSAR XML (schema 00048)
package /SomeIpServiceInterfaceDeployment
  someip service interface deployment SignerPrivateCtx_Someip: service-interface=SignerPrivateCtx, service-interface-id=36, service-interface-version={major-version=0, minor-version=0}
    7 x someip method deployment, all with transport-protocol=UDP:
      GetSignatureService: method=GetSignatureService, method-id=1
      Reset: method=Reset, method-id=2
      SetKey: method=SetKey, method-id=3
      SignPreHashed: method=SignPreHashed, method-id=4
      SignPreHashedConst: method=SignPreHashedConst, method-id=5
      Sign: method=Sign, method-id=6
      IsInitialized: method=IsInitialized, method-id=7
