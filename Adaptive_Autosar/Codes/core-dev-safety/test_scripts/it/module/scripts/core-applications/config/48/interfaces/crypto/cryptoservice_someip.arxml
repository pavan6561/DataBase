AUTOSAR XML (schema 00048)
package /SomeIpServiceInterfaceDeployment
  someip service interface deployment CryptoService_Someip: service-interface=CryptoService, service-interface-id=74, service-interface-version={major-version=0, minor-version=0}
    someip method deployment GetBlockSize: method=GetBlockSize, method-id=1, transport-protocol=UDP
    someip method deployment GetMaxInputSize: method=GetMaxInputSize, method-id=2, transport-protocol=UDP
    someip method deployment GetMaxOutputSize: method=GetMaxOutputSize, method-id=3, transport-protocol=UDP
