AUTOSAR XML (schema 00048)
package /ServiceInterfaces
  service interface ApplicationVehiclePackageManagement
    namespaces:
      symbol props ara
      symbol props com
    field TransferStateField: type=TransferStateType, has-getter=true, has-notifier=true, has-setter=false
    methods:
      14 x operation:
        TransferStart
          4 x arg:
            SoftwarePackageName: type=String, direction=IN
            transferid: type=TransferIdType_Canoe, direction=OUT
            blockSize: type=uint32_t, direction=OUT
            response: type=returnValues, direction=OUT
        TransferVehiclePackage
          4 x arg:
            size: type=uint64_t, direction=IN
            transferid: type=TransferIdType_Canoe, direction=OUT
            blockSize: type=uint32_t, direction=OUT
            response: type=returnValues, direction=OUT
        TransferData
          4 x arg:
            id: type=TransferIdType_Canoe, direction=IN
            packageSize: type=uint32_t, direction=IN
            blockCounter: type=uint64_t, direction=IN
            response: type=returnValues, direction=OUT
        TransferExit
          arg id: type=TransferIdType_Canoe, direction=IN
          arg response: type=returnValues, direction=OUT
        LoadBinaryPackage
          arg packagePath: type=String, direction=IN
          arg size: type=uint64_t, direction=OUT
        TransferState
          arg response: type=returnValues, direction=OUT
        RequestedPackage
          arg packageName: type=String, direction=OUT
        GetSwClusterInfo
          arg info: type=returnStringStructure, direction=OUT
        SwPackageInventory
          arg response: type=returnStringStructure, direction=OUT
          arg name: type=String, direction=IN
          arg version: type=String, direction=IN
        DeleteTransfer
          arg id: type=TransferIdType_Canoe, direction=IN
          arg response: type=returnValues, direction=OUT
        GetSwPackages
          arg response: type=returnValues, direction=OUT
        CancelCampaign
          arg DisableCampaign: type=bool, direction=IN
          arg response: type=returnValues, direction=OUT
        AllowCampaign
        GetCampaignHistory
          arg CampaignHistory: type=CampaignHistoryType, direction=OUT
