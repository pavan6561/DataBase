AUTOSAR XML (schema 00049)
package /SomeIpServiceInterfaceDeployment
  someip service interface deployment KeyDerivationFunctionCtx_Someip: service-interface=KeyDerivationFunctionCtx, service-interface-id=31, service-interface-version={major-version=0, minor-version=0}
    14 x someip method deployment, all with transport-protocol=UDP:
      SetSourceKeyMaterial: method=SetSourceKeyMaterial, method-id=1
      AddSalt: method=AddSalt, method-id=2
      ConfigIterations: method=ConfigIterations, method-id=3
      DeriveKey: method=DeriveKey, method-id=4
      AddSecretSalt: method=AddSecretSalt, method-id=5
      DeriveSeed: method=DeriveSeed, method-id=6
      Reset: method=Reset, method-id=7
      GetExtensionService: method=GetExtensionService, method-id=8
      GetKeyIdSize: method=GetKeyIdSize, method-id=9
      GetTargetAlgId: method=GetTargetAlgId, method-id=10
      GetTargetAllowedUsage: method=GetTargetAllowedUsage, method-id=11
      GetTargetKeyBitLength: method=GetTargetKeyBitLength, method-id=12
      Init: method=Init, method-id=13
      isInitialized: method=isInitialized, method-id=14
