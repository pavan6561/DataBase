AUTOSAR XML (schema 00048)
package /ServiceInstances
  provided someip service instance Certificate: service-interface-deployment=Certificate_Someip, sd-server-config=SomeipSdServerServiceInstance, service-instance-id=1
