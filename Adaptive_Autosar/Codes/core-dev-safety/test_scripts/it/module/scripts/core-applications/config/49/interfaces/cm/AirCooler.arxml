AUTOSAR XML (schema 00049)
package /ServiceInterfaces
  service interface AirCooler
    namespaces:
      symbol props ara
      symbol props com
      symbol props sample
    methods:
      operation AirCooler_Temperature: possible-ap-error=GenericFailure
        arg AirCooler_Temperature_In: type=uint8_t, direction=IN
        arg AirCooler_Temperature_Out: type=uint8_t, direction=OUT
