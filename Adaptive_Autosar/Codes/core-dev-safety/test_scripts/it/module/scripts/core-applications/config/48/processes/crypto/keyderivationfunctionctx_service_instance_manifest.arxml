AUTOSAR XML (schema 00048)
package /ServiceInstances
  provided someip service instance KeyDerivationFunctionCtx: service-interface-deployment=KeyDerivationFunctionCtx_Someip, sd-server-config=SomeipSdServerServiceInstance, service-instance-id=1
