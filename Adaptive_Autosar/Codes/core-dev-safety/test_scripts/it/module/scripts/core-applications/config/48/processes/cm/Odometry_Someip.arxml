AUTOSAR XML (schema 00048)
package /ServiceInterfaceDeployments
  someip service interface deployment Odometry_Someip: service-interface=Odometry, service-interface-id=101, service-interface-version={major-version=0, minor-version=0}
    18 x someip event deployment, all with transport-protocol=UDP:
      EventUint8_Someip: event=Event_uint8, event-id=20
      EventEnum_Someip: event=Event_enum, event-id=30
      EventScaleLinear_Someip: event=Event_scalelinear, event-id=31
      EventString_Someip: event=Event_string, event-id=32
      EventInt64_Someip: event=Event_int64, event-id=26
      EventInt8_Someip: event=Event_int8, event-id=27
      EventFloat_Someip: event=Event_float, event-id=28
      EventDouble_Someip: event=Event_double, event-id=29
      EventInt32_Someip: event=Event_int32, event-id=25
      EventUint16_Someip: event=Event_uint16, event-id=21
      EventUint32_Someip: event=Event_uint32, event-id=22
      EventUint64_Someip: event=Event_unit64, event-id=23
      EventInt16_Someip: event=Event_int16, event-id=24
      EventSupplyVoltage_Someip: event=Event_supplyvoltage, event-id=33
      EventTemperature_Someip: event=Event_temperature, event-id=34
      Event_reestablishing_Someip: event=Event_reestablishing, event-id=36
      Event_samplepointer_Someip: event=Event_samplepointer, event-id=37
      Event_MarkerInterface_Someip: event=Event_MarkerInterface, event-id=38
    14 x someip field deployment:
      Speed_Someip: field=Speed
        get get: method-id=100, transport-protocol=UDP
        notifier notifier: event-id=50, transport-protocol=UDP
        set set: method-id=200, transport-protocol=UDP
      Enum_Someip: field=Field_enum
        get get: method-id=101, transport-protocol=UDP
        notifier notifier: event-id=51, transport-protocol=UDP
        set set: method-id=201, transport-protocol=UDP
      ScaleLinear_Someip: field=Field_scalelinear
        get get: method-id=102, transport-protocol=UDP
        notifier notifier: event-id=52, transport-protocol=UDP
        set set: method-id=202, transport-protocol=UDP
      String_Someip: field=Field_string
        get get: method-id=103, transport-protocol=UDP
        notifier notifier: event-id=53, transport-protocol=UDP
        set set: method-id=203, transport-protocol=UDP
      Distance_Someip: field=Distance
        get get: method-id=104, transport-protocol=UDP
        notifier notifier: event-id=54, transport-protocol=UDP
        set set: method-id=204, transport-protocol=UDP
      Position_Someip: field=Position
        get get: method-id=105, transport-protocol=UDP
        notifier notifier: event-id=55, transport-protocol=UDP
        set set: method-id=205, transport-protocol=UDP
      AngularRate_Someip: field=AngularRate
        get get: method-id=106, transport-protocol=UDP
        notifier notifier: event-id=56, transport-protocol=UDP
        set set: method-id=206, transport-protocol=UDP
      Time_Someip: field=Time
        get get: method-id=107, transport-protocol=UDP
        notifier notifier: event-id=57, transport-protocol=UDP
        set set: method-id=207, transport-protocol=UDP
      Velocity_Someip: field=Velocity
        get get: method-id=108, transport-protocol=UDP
        notifier notifier: event-id=58, transport-protocol=UDP
        set set: method-id=208, transport-protocol=UDP
      WheelCorrection_Someip: field=WheelCorrection
        get get: method-id=109, transport-protocol=UDP
        notifier notifier: event-id=59, transport-protocol=UDP
        set set: method-id=209, transport-protocol=UDP
      Acceleration_Someip: field=Acceleration
        get get: method-id=110, transport-protocol=UDP
        notifier notifier: event-id=60, transport-protocol=UDP
        set set: method-id=210, transport-protocol=UDP
      Pose2D_Someip: field=Pose2D
        get get: method-id=111, transport-protocol=UDP
        notifier notifier: event-id=61, transport-protocol=UDP
        set set: method-id=211, transport-protocol=UDP
      AdditionalVehicleMotionInformation_Someip: field=AdditionalVehicleMotionInformation
        get get: method-id=112, transport-protocol=UDP
        notifier notifier: event-id=62, transport-protocol=UDP
        set set: method-id=212, transport-protocol=UDP
      TemperatureDiscard_Someip: field=fields_temperaturediscard
        get get: method-id=113, transport-protocol=UDP
        notifier notifier: event-id=63, transport-protocol=UDP
        set set: method-id=213, transport-protocol=UDP
    8 x someip method deployment, all with transport-protocol=UDP:
      DataElement_basicDT_Someip: method=DataElement_basicDT, method-id=301
      DataElement_enum_Someip: method=DataElement_enum, method-id=302
      DataElement_scalelinear_Someip: method=DataElement_scalelinear, method-id=303
      DataElement_string_Someip: method=DataElement_string, method-id=304
      SamplePointer_Someip: method=SamplePointer, method-id=305
      IsReady_Someip: method=IsReady, method-id=307
      DataElement_voltage_Someip: method=DataElement_voltage, method-id=308
      BrakeLight_Someip: method=BrakeLight, method-id=309
    someip event group EventDataType_Someip: event-group-id=110, event=[Odometry_Someip/EventUint8_Someip, Odometry_Someip/EventEnum_Someip, Odometry_Someip/EventScaleLinear_Someip, Odometry_Someip/EventString_Someip, Odometry_Someip/EventInt64_Someip, Odometry_Someip/EventInt8_Someip, Odometry_Someip/EventFloat_Someip, Odometry_Someip/EventDouble_Someip, Odometry_Someip/EventInt32_Someip, Odometry_Someip/EventUint16_Someip, Odometry_Someip/EventUint32_Someip, Odometry_Someip/EventUint64_Someip, Odometry_Someip/EventInt16_Someip, Odometry_Someip/EventSupplyVoltage_Someip, Odometry_Someip/EventTemperature_Someip, Odometry_Someip/Event_reestablishing_Someip, Odometry_Someip/Event_samplepointer_Someip, Odometry_Someip/Event_MarkerInterface_Someip]
    someip event group EventDataType_SomeipField: event-group-id=401, event=[Speed_Someip/notifier, Enum_Someip/notifier, ScaleLinear_Someip/notifier, String_Someip/notifier, Distance_Someip/notifier, Position_Someip/notifier, AngularRate_Someip/notifier, Time_Someip/notifier, Velocity_Someip/notifier, WheelCorrection_Someip/notifier, Acceleration_Someip/notifier, Pose2D_Someip/notifier, AdditionalVehicleMotionInformation_Someip/notifier, TemperatureDiscard_Someip/notifier]
  someip service interface deployment Odometry_Canoe_Someip: service-interface=Odometry_Canoe, service-interface-id=101, service-interface-version={major-version=0, minor-version=0}
    18 x someip event deployment, all with transport-protocol=UDP:
      EventUint8_Someip: event=Event_uint8, event-id=20
      EventEnum_Someip: event=Event_enum, event-id=30
      EventScaleLinear_Someip: event=Event_scalelinear, event-id=31
      EventString_Someip: event=Event_string, event-id=32
      EventInt64_Someip: event=Event_int64, event-id=26
      EventInt8_Someip: event=Event_int8, event-id=27
      EventFloat_Someip: event=Event_float, event-id=28
      EventDouble_Someip: event=Event_double, event-id=29
      EventInt32_Someip: event=Event_int32, event-id=25
      EventUint16_Someip: event=Event_uint16, event-id=21
      EventUint32_Someip: event=Event_uint32, event-id=22
      EventUint64_Someip: event=Event_unit64, event-id=23
      EventInt16_Someip: event=Event_int16, event-id=24
      EventSupplyVoltage_Someip: event=Event_supplyvoltage, event-id=33
      EventTemperature_Someip: event=Event_temperature, event-id=34
      Event_reestablishing_Someip: event=Event_reestablishing, event-id=36
      Event_samplepointer_Someip: event=Event_samplepointer, event-id=37
      Event_MarkerInterface_Someip: event=Event_MarkerInterface, event-id=38
    14 x someip field deployment:
      Speed_Someip: field=Speed
        get get: method-id=100, transport-protocol=UDP
        notifier notifier: event-id=50, transport-protocol=UDP
        set set: method-id=200, transport-protocol=UDP
      Enum_Someip: field=Field_enum
        get get: method-id=101, transport-protocol=UDP
        notifier notifier: event-id=51, transport-protocol=UDP
        set set: method-id=201, transport-protocol=UDP
      ScaleLinear_Someip: field=Field_scalelinear
        get get: method-id=102, transport-protocol=UDP
        notifier notifier: event-id=52, transport-protocol=UDP
        set set: method-id=202, transport-protocol=UDP
      String_Someip: field=Field_string
        get get: method-id=103, transport-protocol=UDP
        notifier notifier: event-id=53, transport-protocol=UDP
        set set: method-id=203, transport-protocol=UDP
      Distance_Someip: field=Distance
        get get: method-id=104, transport-protocol=UDP
        notifier notifier: event-id=54, transport-protocol=UDP
        set set: method-id=204, transport-protocol=UDP
      Position_Someip: field=Position
        get get: method-id=105, transport-protocol=UDP
        notifier notifier: event-id=55, transport-protocol=UDP
        set set: method-id=205, transport-protocol=UDP
      AngularRate_Someip: field=AngularRate
        get get: method-id=106, transport-protocol=UDP
        notifier notifier: event-id=56, transport-protocol=UDP
        set set: method-id=206, transport-protocol=UDP
      Time_Someip: field=Time
        get get: method-id=107, transport-protocol=UDP
        notifier notifier: event-id=57, transport-protocol=UDP
        set set: method-id=207, transport-protocol=UDP
      Velocity_Someip: field=Velocity
        get get: method-id=108, transport-protocol=UDP
        notifier notifier: event-id=58, transport-protocol=UDP
        set set: method-id=208, transport-protocol=UDP
      WheelCorrection_Someip: field=WheelCorrection
        get get: method-id=109, transport-protocol=UDP
        notifier notifier: event-id=59, transport-protocol=UDP
        set set: method-id=209, transport-protocol=UDP
      Acceleration_Someip: field=Acceleration
        get get: method-id=110, transport-protocol=UDP
        notifier notifier: event-id=60, transport-protocol=UDP
        set set: method-id=210, transport-protocol=UDP
      Pose2D_Someip: field=Pose2D
        get get: method-id=111, transport-protocol=UDP
        notifier notifier: event-id=61, transport-protocol=UDP
        set set: method-id=211, transport-protocol=UDP
      AdditionalVehicleMotionInformation_Someip: field=AdditionalVehicleMotionInformation
        get get: method-id=112, transport-protocol=UDP
        notifier notifier: event-id=62, transport-protocol=UDP
        set set: method-id=212, transport-protocol=UDP
      TemperatureDiscard_Someip: field=fields_temperaturediscard
        get get: method-id=113, transport-protocol=UDP
        notifier notifier: event-id=63, transport-protocol=UDP
        set set: method-id=213, transport-protocol=UDP
    8 x someip method deployment, all with transport-protocol=UDP:
      DataElement_basicDT_Someip: method=DataElement_basicDT, method-id=301
      DataElement_enum_Someip: method=DataElement_enum, method-id=302
      DataElement_scalelinear_Someip: method=DataElement_scalelinear, method-id=303
      DataElement_string_Someip: method=DataElement_string, method-id=304
      SamplePointer_Someip: method=SamplePointer, method-id=305
      IsReady_Someip: method=IsReady, method-id=307
      DataElement_voltage_Someip: method=DataElement_voltage, method-id=308
      BrakeLight_Someip: method=BrakeLight, method-id=309
    someip event group EventDataType_Canoe_Someip: event-group-id=110, event=[Odometry_Canoe_Someip/EventUint8_Someip, Odometry_Canoe_Someip/EventEnum_Someip, Odometry_Canoe_Someip/EventScaleLinear_Someip, Odometry_Canoe_Someip/EventString_Someip, Odometry_Canoe_Someip/EventInt64_Someip, Odometry_Canoe_Someip/EventInt8_Someip, Odometry_Canoe_Someip/EventFloat_Someip, Odometry_Canoe_Someip/EventDouble_Someip, Odometry_Canoe_Someip/EventInt32_Someip, Odometry_Canoe_Someip/EventUint16_Someip, Odometry_Canoe_Someip/EventUint32_Someip, Odometry_Canoe_Someip/EventUint64_Someip, Odometry_Canoe_Someip/EventInt16_Someip, Odometry_Canoe_Someip/EventSupplyVoltage_Someip, Odometry_Canoe_Someip/EventTemperature_Someip, Odometry_Canoe_Someip/Event_reestablishing_Someip, Odometry_Canoe_Someip/Event_samplepointer_Someip, Odometry_Canoe_Someip/Event_MarkerInterface_Someip]
    someip event group EventDataType_Canoe_SomeipField: event-group-id=401, event=[Speed_Someip/notifier, Enum_Someip/notifier, ScaleLinear_Someip/notifier, String_Someip/notifier, Distance_Someip/notifier, Position_Someip/notifier, AngularRate_Someip/notifier, Time_Someip/notifier, Velocity_Someip/notifier, WheelCorrection_Someip/notifier, Acceleration_Someip/notifier, Pose2D_Someip/notifier, AdditionalVehicleMotionInformation_Someip/notifier, TemperatureDiscard_Someip/notifier]
package /ServiceInstances
  provided someip service instance odometry_qt_cm_instance3_ProvidedSomeipServiceInstance: service-interface-deployment=Odometry_Someip, sd-server-config=SomeipSdServerServiceInstance, service-instance-id=102
    someip provided event group providedEventGroups: event-group=EventDataType_Someip, multicast-threshold=1
    someip provided event group providedEventGroupsField: event-group=EventDataType_SomeipField, multicast-threshold=1
  required someip service instance qt_cm_instance3_RequiredSomeipServiceInstance: service-interface-deployment=Odometry_Canoe_Someip, required-service-instance-id=103, sd-client-config=SomeipSdClientServiceInstance
    someip required event group requiredEventGroups: event-group=EventDataType_Canoe_Someip
    someip required event group requiredEventGroupsField: event-group=EventDataType_Canoe_SomeipField
package /ServiceInstanceToMachineMappings
  someip service instance to machine mapping odometry_qt_cm_instance3_Provided_ServiceInstance_toMachine: communication-connector=EthernetCommunicationConnector, service-instance=odometry_qt_cm_instance3_ProvidedSomeipServiceInstance, udp-port=3004
  someip service instance to machine mapping odometry_qt_cm_instance3_Required_ServiceInstance_toMachine: communication-connector=EthernetCommunicationConnector, service-instance=qt_cm_instance3_RequiredSomeipServiceInstance, udp-port=0
package /ServiceInstanceToPortPrototypeMappings
  service instance to port prototype mapping odometry_qt_cm_instance3_ProvidedSomeipInstance_POdometry_toPort: port-prototype=rootSwComponentPrototype.POdometry, process=qt_cm_instance3, service-instance=odometry_qt_cm_instance3_ProvidedSomeipServiceInstance
  service instance to port prototype mapping odometry_qt_cm_instance3_RequiredSomeipInstance_ROdometry_toPort: port-prototype=rootSwComponentPrototype.ROdometry, process=qt_cm_instance3, service-instance=qt_cm_instance3_RequiredSomeipServiceInstance
