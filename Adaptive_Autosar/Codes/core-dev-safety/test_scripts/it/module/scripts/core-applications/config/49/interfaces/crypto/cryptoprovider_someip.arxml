AUTOSAR XML (schema 00049)
package /ServiceInterfaceDeployments
  someip service interface deployment CryptoProvider_Someip: service-interface=CryptoProvider, service-interface-id=15, service-interface-version={major-version=0, minor-version=0}
    21 x someip method deployment, all with transport-protocol=UDP:
      CreateAuthCipherCtx: method=CreateAuthCipherCtx, method-id=6
      CreateHashFunctionCtx: method=CreateHashFunctionCtx, method-id=4
      CreateKeyDerivationFunctionCtxSomeip: method=CreateKeyDerivationFunctionCtx, method-id=7
      CreateMessageAuthCodeCtxSomeip: method=CreateMessageAuthCodeCtx, method-id=8
      CreateRandomGeneratorCtxSomeip: method=CreateRandomGeneratorCtx, method-id=3
      CreateStreamCipherCtxSomeip: method=CreateStreamCipherCtx, method-id=5
      CreateSymmetricBlockCipherCtx: method=CreateSymmetricBlockCipherCtx, method-id=2
      CreateSymmetricKeyWrapperCtxSomeip: method=CreateSymmetricKeyWrapperCtx, method-id=9
      LoadCryptoProviderSomeip: method=LoadCryptoProvider, method-id=1
      ConvertToAlgId: method=ConvertToAlgId, method-id=10
      CreateSignature: method=CreateSignature, method-id=11
      GenerateSymmetricKey: method=GenerateSymmetricKey, method-id=12
      GenerateSeed: method=GenerateSeed, method-id=13
      CreateEncryptorPublicCtx: method=CreateEncryptorPublicCtx, method-id=45
      CreateDecryptorPrivateCtx: method=CreateDecryptorPrivateCtx, method-id=35
      GeneratePrivateKey: method=GeneratePrivateKey, method-id=90
      CreateVerifierPublicCtx: method=CreateVerifierPublicCtx, method-id=14
      CreateSignerPrivateCtx: method=CreateSignerPrivateCtx, method-id=15
      CreateSigEncodePrivateCtx: method=CreateSigEncodePrivateCtx, method-id=16
      MsgRecoveryPublicCtx: method=CreateMsgRecoveryPublicCtx, method-id=17
      ConvertToAlgName: method=ConvertToAlgName, method-id=21
