AUTOSAR XML (schema 00048)
package /ServiceInterfaceDeployments
  someip service interface deployment Speedometer_Someip: service-interface=Speedometer, service-interface-id=104, service-interface-version={major-version=0, minor-version=0}
    18 x someip event deployment, all with transport-protocol=UDP:
      Event_ArrayLengthOne_Someip: event=Event_ArrayLengthOne, event-id=301
      Event_ArrayLength2MSBFirst_Someip: event=Event_ArrayLength2MSBFirst, event-id=302
      Event_ArrayLength2MSBLast_Someip: event=Event_ArrayLength2MSBLast, event-id=305
      Event_ArrayLength4MSBFirst_Someip: event=Event_ArrayLength4MSBFirst, event-id=303
      Event_ArrayNoByteOrder_Someip: event=Event_ArrayNoByteOrder, event-id=308
      Event_Array_NoLengthField_Someip: event=Event_Array_NoLengthField, event-id=307
      Event_VectorLength2MSBFirst_Someip: event=Event_VectorLength2MSBFirst, event-id=311
      Event_Array2D_Someip: event=Event_Array2D, event-id=309
      Event_VectorLength2MSBLast_Someip: event=Event_VectorLength2MSBLast, event-id=314
      Event_ArrayByteOrderMSBF_Someip: event=Event_ArrayByteOrderMSBF, event-id=304
      Event_ArrayLength4MSBLast_Someip: event=Event_ArrayLength4MSBLast, event-id=306
      Event_VectorByteOrderMSBF_Someip: event=Event_VectorByteOrderMSBF, event-id=313
      Event_VectorLength4MSBLast_Someip: event=Event_VectorLength4MSBLast, event-id=315
      Event_VectorLengthOne_Someip: event=Event_VectorLengthOne, event-id=310
      Event_VectorLength4MSBFirst_Someip: event=Event_VectorLength4MSBFirst, event-id=312
      Event_Vector_NoLengthField_Someip: event=Event_Vector_NoLengthField, event-id=316
      Event_VectorNoByteOrder_Someip: event=Event_VectorNoByteOrder, event-id=317
      Event_ArrayLengthZero_Someip: event=Event_ArrayLengthZero, event-id=318
    someip event group EventDataType_Someip: event-group-id=120, event=[Speedometer_Someip/Event_ArrayLengthOne_Someip, Speedometer_Someip/Event_ArrayLength2MSBFirst_Someip, Speedometer_Someip/Event_ArrayLength2MSBLast_Someip, Speedometer_Someip/Event_ArrayLength4MSBFirst_Someip, Speedometer_Someip/Event_ArrayNoByteOrder_Someip, Speedometer_Someip/Event_Array_NoLengthField_Someip, Speedometer_Someip/Event_Array2D_Someip, Speedometer_Someip/Event_ArrayByteOrderMSBF_Someip, Speedometer_Someip/Event_ArrayLength4MSBLast_Someip, Speedometer_Someip/Event_VectorLength2MSBFirst_Someip, Speedometer_Someip/Event_VectorLength2MSBLast_Someip, Speedometer_Someip/Event_VectorByteOrderMSBF_Someip, Speedometer_Someip/Event_VectorLength4MSBLast_Someip, Speedometer_Someip/Event_VectorLengthOne_Someip, Speedometer_Someip/Event_VectorLength4MSBFirst_Someip, Speedometer_Someip/Event_Vector_NoLengthField_Someip, Speedometer_Someip/Event_VectorNoByteOrder_Someip, Speedometer_Someip/Event_ArrayLengthZero_Someip]
  someip service interface deployment Speedometer_Canoe_Someip: service-interface=Speedometer_Canoe, service-interface-id=104, service-interface-version={major-version=0, minor-version=0}
    18 x someip event deployment, all with transport-protocol=UDP:
      Event_ArrayLengthOne_Someip: event=Event_ArrayLengthOne, event-id=301
      Event_ArrayLength2MSBFirst_Someip: event=Event_ArrayLength2MSBFirst, event-id=302
      Event_ArrayLength2MSBLast_Someip: event=Event_ArrayLength2MSBLast, event-id=305
      Event_ArrayLength4MSBFirst_Someip: event=Event_ArrayLength4MSBFirst, event-id=303
      Event_ArrayNoByteOrder_Someip: event=Event_ArrayNoByteOrder, event-id=308
      Event_Array_NoLengthField_Someip: event=Event_Array_NoLengthField, event-id=307
      Event_VectorLength2MSBFirst_Someip: event=Event_VectorLength2MSBFirst, event-id=311
      Event_Array2D_Someip: event=Event_Array2D, event-id=309
      Event_VectorLength2MSBLast_Someip: event=Event_VectorLength2MSBLast, event-id=314
      Event_ArrayByteOrderMSBF_Someip: event=Event_ArrayByteOrderMSBF, event-id=304
      Event_ArrayLength4MSBLast_Someip: event=Event_ArrayLength4MSBLast, event-id=306
      Event_VectorByteOrderMSBF_Someip: event=Event_VectorByteOrderMSBF, event-id=313
      Event_VectorLength4MSBLast_Someip: event=Event_VectorLength4MSBLast, event-id=315
      Event_VectorLengthOne_Someip: event=Event_VectorLengthOne, event-id=310
      Event_VectorLength4MSBFirst_Someip: event=Event_VectorLength4MSBFirst, event-id=312
      Event_Vector_NoLengthField_Someip: event=Event_Vector_NoLengthField, event-id=316
      Event_VectorNoByteOrder_Someip: event=Event_VectorNoByteOrder, event-id=317
      Event_ArrayLengthZero_Someip: event=Event_ArrayLengthZero, event-id=318
    someip event group EventDataType_Someip: event-group-id=120, event=[Speedometer_Canoe_Someip/Event_ArrayLengthOne_Someip, Speedometer_Canoe_Someip/Event_ArrayLength2MSBFirst_Someip, Speedometer_Canoe_Someip/Event_ArrayLength2MSBLast_Someip, Speedometer_Canoe_Someip/Event_ArrayLength4MSBFirst_Someip, Speedometer_Canoe_Someip/Event_ArrayNoByteOrder_Someip, Speedometer_Canoe_Someip/Event_Array_NoLengthField_Someip, Speedometer_Canoe_Someip/Event_Array2D_Someip, Speedometer_Canoe_Someip/Event_ArrayByteOrderMSBF_Someip, Speedometer_Canoe_Someip/Event_ArrayLength4MSBLast_Someip, Speedometer_Canoe_Someip/Event_VectorLength2MSBFirst_Someip, Speedometer_Canoe_Someip/Event_VectorLength2MSBLast_Someip, Speedometer_Canoe_Someip/Event_VectorByteOrderMSBF_Someip, Speedometer_Canoe_Someip/Event_VectorLength4MSBLast_Someip, Speedometer_Canoe_Someip/Event_VectorLengthOne_Someip, Speedometer_Canoe_Someip/Event_VectorLength4MSBFirst_Someip, Speedometer_Canoe_Someip/Event_Vector_NoLengthField_Someip, Speedometer_Canoe_Someip/Event_VectorNoByteOrder_Someip, Speedometer_Canoe_Someip/Event_ArrayLengthZero_Someip]
package /ServiceInstances
  provided someip service instance Speedometer_qt_cm_instance3_ProvidedSomeipServiceInstance: service-interface-deployment=Speedometer_Someip, sd-server-config=SomeipSdServerServiceInstance, service-instance-id=104
    someip provided event group providedEventGroups: event-group=Speedometer_Someip/EventDataType_Someip, multicast-threshold=1
    someip provided event group providedEventGroupsField: multicast-threshold=1
  required someip service instance Speedometer_qt_cm_instance3_RequiredSomeipServiceInstance: service-interface-deployment=Speedometer_Canoe_Someip, required-service-instance-id=106, sd-client-config=SomeipSdClientServiceInstance
    someip required event group requiredEventGroups: event-group=Speedometer_Canoe_Someip/EventDataType_Someip, sd-client-event-group-timing-config=SomeipSdClientEventGroupTimingConfig
    someip required event group requiredEventGroupsField
package /ServiceInstanceToMachineMappings
  someip service instance to machine mapping Speedometer_qt_cm_instance3_Provided_ServiceInstance_toMachine: communication-connector=EthernetCommunicationConnector, service-instance=Speedometer_qt_cm_instance3_ProvidedSomeipServiceInstance, udp-port=3004
  someip service instance to machine mapping Speedometer_qt_cm_instance3_Required_ServiceInstance_toMachine: communication-connector=EthernetCommunicationConnector, service-instance=Speedometer_qt_cm_instance3_RequiredSomeipServiceInstance, udp-port=0
package /ServiceInstanceToPortPrototypeMappings
  service instance to port prototype mapping Speedometer_qt_cm_instance3_ProvidedSomeipInstance_PSpeedometer_toPort: port-prototype=rootSwComponentPrototype.PSpeedometer, process=qt_cm_instance3, service-instance=Speedometer_qt_cm_instance3_ProvidedSomeipServiceInstance
  service instance to port prototype mapping Speedometer_qt_cm_instance3_RequiredSomeipInstance_RSpeedometer_toPort: port-prototype=rootSwComponentPrototype.RSpeedometer, process=qt_cm_instance3, service-instance=Speedometer_qt_cm_instance3_RequiredSomeipServiceInstance
package /SomeipSdTimingConfigs
  someip sd client event group timing config SomeipSdClientEventGroupTimingConfig: request-response-delay={max-value=1.0, min-value=0.0}, time-to-live=10
