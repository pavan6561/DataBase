AUTOSAR XML (schema 00049)
package /ServiceInterface
  service interface CryptoPrimitiveId
    namespaces:
      4 x symbol props:
        qt
        crypto
        cryptoprovider_001
        cryptoprimitiveid
    methods:
      operation GetPrimitiveId: possible-ap-error=UndefinedApplicationError
        arg cryptoPrimitiveObject: type=uint8_t, direction=IN
        arg response: type=uint64_t, direction=OUT
      operation GetPrimitiveName: possible-ap-error=UndefinedApplicationError
        arg cryptoPrimitiveObject: type=uint8_t, direction=IN
        arg response: type=returnString, direction=OUT
