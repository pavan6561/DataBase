AUTOSAR XML (schema 00048)
package /ServiceInterfaceDeployments
  someip service interface deployment ApplicationPackageManagement_Someip: service-interface=ApplicationPackageManagement, service-interface-id=20, service-interface-version={major-version=0, minor-version=0}
    24 x someip method deployment, all with transport-protocol=UDP:
      TransferPackages: method=TransferPackage, method-id=1
      ProcessSwPackage: method=ProcessSwPackage, method-id=2
      Activate: method=Activate, method-id=3
      Finish: method=Finish, method-id=4
      Cancel: method=Cancel, method-id=5
      TransferStart: method=TransferStart, method-id=6
      TransferData: method=TransferData, method-id=7
      TransferExit: method=TransferExit, method-id=8
      DeleteTransfer: method=DeleteTransfer, method-id=9
      LoadBinaryPackage: method=LoadBinaryPackage, method-id=10
      RollBack: method=RollBack, method-id=11
      RevertRollbackSwPackages: method=RevertProcessedSwPackages, method-id=12
      GetSwPackages: method=GetSwPackages, method-id=13
      CurrentStatus: method=CurrentStatus, method-id=14
      GetHistory: method=GetHistory, method-id=15
      GetSwClusterInfo: method=GetSwClusterInfo, method-id=16
      GetSwProcessProgress: method=GetSwProcessProgress, method-id=17
      IsProcessingSet: method=IsProcessingSet, method-id=18
      IsCleaningUpSet: method=IsCleaningUpSet, method-id=19
      IsRollingBackSet: method=IsRollingBackSet, method-id=20
      IsActivatingSet: method=IsActivatingSet, method-id=21
      GetSwClusterChangeInfo: method=GetSwClusterChangeInfo, method-id=22
      GetSwClusterDescription: method=GetSwClusterDescription, method-id=23
      GetId: method=GetId, method-id=24
