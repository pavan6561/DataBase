AUTOSAR XML (schema 00049)
package /Processes
  process qt_statemanager: design=qt_statemanager, executable=qt_statemanager, state-dependent-startup-config{execution-dependency=AraSomeipRoutingDaemonStateMachine.Running, function-group-state=MachineFG.Startup, resource-group=ResourceGroup, startup-config=qt_stateManager_startupconfig}
package /ServiceInstanceToPortPrototypeMappings
  service instance to port prototype mapping StateManagerPortMapping: port-prototype=rootSwComponentPrototype.PStateManager, process-design=qt_statemanager, process=qt_statemanager, service-instance=StateManager
