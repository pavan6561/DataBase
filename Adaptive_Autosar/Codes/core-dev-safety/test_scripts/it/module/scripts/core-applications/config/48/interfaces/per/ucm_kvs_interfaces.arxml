AUTOSAR XML (schema 00048)
package /ara/apd/ucm/PersistencyKeyValueStorageInterfaces
  persistency key value storage interface SwPackageTransferStatus: redundancy=NONE, update-strategy=KEEP-EXISTING
  persistency key value storage interface SwPackageCurrentStatus: redundancy=NONE, update-strategy=KEEP-EXISTING
