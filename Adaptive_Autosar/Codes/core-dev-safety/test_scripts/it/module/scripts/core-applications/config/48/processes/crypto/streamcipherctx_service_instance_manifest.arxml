AUTOSAR XML (schema 00048)
package /ServiceInstances
  provided someip service instance StreamCipherCtx: service-interface-deployment=StreamCipherCtx_Someip, sd-server-config=SomeipSdServerServiceInstance, service-instance-id=1
