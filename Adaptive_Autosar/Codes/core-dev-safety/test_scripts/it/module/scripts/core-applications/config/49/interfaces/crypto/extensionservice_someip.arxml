AUTOSAR XML (schema 00049)
package /SomeIpServiceInterfaceDeployment
  someip service interface deployment ExtensionService_Someip: service-interface=ExtensionService, service-interface-id=82, service-interface-version={major-version=0, minor-version=0}
    7 x someip method deployment, all with transport-protocol=UDP:
      GetActualKeyBitLength: method=GetActualKeyBitLength, method-id=1
      GetActualKeyCOUID: method=GetActualKeyCOUID, method-id=2
      GetAllowedUsage: method=GetAllowedUsage, method-id=3
      GetMaxKeyBitLength: method=GetMaxKeyBitLength, method-id=4
      GetMinKeyBitLength: method=GetMinKeyBitLength, method-id=5
      IsKeyBitLengthSupported: method=IsKeyBitLengthSupported, method-id=6
      IsKeyAvailable: method=IsKeyAvailable, method-id=7
