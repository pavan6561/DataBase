AUTOSAR XML (schema 00049)
package /ProcessDesigns
  process design qt_cm_instance2: executable=qt_cm_instance2
package /Processes
  process qt_cm_instance2: design=qt_cm_instance2, executable=qt_cm_instance2, state-dependent-startup-config{function-group-state=ComApplicationStates.Com_Instance2, resource-group=ResourceGroups2, startup-config=qt_cm_instance2_startupconfig}
