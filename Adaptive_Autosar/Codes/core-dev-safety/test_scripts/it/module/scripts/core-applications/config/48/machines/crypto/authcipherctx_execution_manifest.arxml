AUTOSAR XML (schema 00048)
package /ServiceInstanceToPortMapping
  service instance to port prototype mapping AuthCipherCtxToPortMapping: port-prototype=rootSwComponentPrototype.PPortAuthCipherCtx, process=qt_crypto_instance1, service-instance=AuthCipherCtx
