AUTOSAR XML (schema 00048)
package /PersistencyInterface
  persistency key value database qt_phm_instance1_persistance: update-strategy=KEEP-EXISTING, uri=/opt/qt_phm_instance1/var/restartaction.json
  persistency key value database qt_phm_instance3_persistance: update-strategy=KEEP-EXISTING, uri=/opt/qt_phm_instance3/var/restartaction.json
