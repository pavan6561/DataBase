AUTOSAR XML (schema 00049)
package /TSyncInterface
  synchronized time base consumer interface utc_consumer_interface
    namespaces:
      symbol props ara
      symbol props tsync
      symbol props app
  synchronized time base consumer interface gps_consumer_interface
    namespaces:
      symbol props ara
      symbol props tsync
      symbol props app
  synchronized time base consumer interface ist_ofs_consumer_interface
    namespaces:
      symbol props ara
      symbol props tsync
      symbol props app
  4 x synchronized time base provider interface:
    kst_provider_interface: time-base-kind=SYNCHRONIZED
      namespaces:
        symbol props ara
        symbol props tsync
        symbol props app
    est_provider_interface: time-base-kind=SYNCHRONIZED
      namespaces:
        symbol props ara
        symbol props tsync
        symbol props app
    cet_ofs_provider_interface: time-base-kind=OFFSET
      namespaces:
        symbol props ara
        symbol props tsync
        symbol props app
    pst_ofs_provider_interface: time-base-kind=OFFSET
      namespaces:
        symbol props ara
        symbol props tsync
        symbol props app
  synchronized time base consumer interface jst_consumer_interface
    namespaces:
      symbol props ara
      symbol props tsync
      symbol props app
  synchronized time base consumer interface mit_ofs_consumer_interface
    namespaces:
      symbol props ara
      symbol props tsync
      symbol props app
package /ServiceInterface
  service interface TimeBaseApp: major-version=0, minor-version=0
    namespaces:
      symbol props ara
      symbol props com
    methods:
      16 x operation:
        GetTimeWithStatusApp
          arg timeStatusOutput: type=ReturnTimeWithStatus, direction=OUT
          arg instanceSpecifier: type=String, direction=IN
        GetCurrentTimeApp
          arg currentTimeOutput: type=int64_t, direction=OUT
          arg instanceSpecifier: type=String, direction=IN
        ChangeNotifierApp
          arg StatusNotifierOutput: type=bool, direction=OUT
          arg instanceSpecifier: type=String, direction=IN
          arg notifierData: type=uint8_t, direction=IN
        StatusChangeDataApp
          arg instanceSpecifier: type=String, direction=IN
          arg StatusDataOutput: type=ReturnTimeWithStatus, direction=OUT
          arg notifierData: type=uint8_t, direction=IN
        GetRateDeviationApp
          arg rateDeviationOutput: type=double, direction=OUT
          arg instanceSpecifier: type=String, direction=IN
        StateChangeDataApp
          arg instanceSpecifier: type=String, direction=IN
          arg StateChangeOutput: type=uint32_t, direction=OUT
          arg notifierData: type=uint8_t, direction=IN
        SetTimeApp
          4 x arg:
            instanceSpecifier: type=String, direction=IN
            timeStamp: type=int64_t, direction=IN
            userData: type=ByteArray, direction=IN
            returnValue: type=bool, direction=OUT
        UpdateTimeApp
          4 x arg:
            instanceSpecifier: type=String, direction=IN
            timeStamp: type=int64_t, direction=IN
            userData: type=ByteArray, direction=IN
            returnValue: type=bool, direction=OUT
        SetRateCorrectionApp
          arg instanceSpecifier: type=String, direction=IN
          arg rateDeviation: type=double, direction=IN
          arg returnValue: type=bool, direction=OUT
        SetUserDataApp
          arg instanceSpecifier: type=String, direction=IN
          arg userData: type=ByteArray, direction=IN
          arg returnValue: type=bool, direction=OUT
        GetUserDataApp
          arg instanceSpecifier: type=String, direction=IN
          arg userDataOutput: type=ByteArray, direction=OUT
        GetSlaveTimingDataApp
          arg instanceSpecifier: type=String, direction=IN
          arg SlaveTimingData: type=ReturnTimeSlaveMeasurementType, direction=OUT
        GetPdelayInitiatorDataApp
          arg instanceSpecifier: type=String, direction=IN
          arg PdelayInitiatorData: type=ReturnPdelayInitiatorMeasurementType, direction=OUT
        GetMasterTimingDataApp
          arg instanceSpecifier: type=String, direction=IN
          arg MasterTimingData: type=ReturnTimeMasterMeasurementType, direction=OUT
        GetPdelayResponderDataApp
          arg instanceSpecifier: type=String, direction=IN
          arg PdelayResponderData: type=ReturnPdelayResponderMeasurementType, direction=OUT
        GetPrecisionDataApp
          arg instanceSpecifier: type=String, direction=IN
          arg PreciseTimeOutput: type=ReturnTimePrecisionMeasurementType, direction=OUT
          arg notifierData: type=uint8_t, direction=IN
