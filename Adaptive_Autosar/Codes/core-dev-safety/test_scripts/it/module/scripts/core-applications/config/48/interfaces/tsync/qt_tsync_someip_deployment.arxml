AUTOSAR XML (schema 00048)
package /SomeipServiceInterfaceDeployment
  someip service interface deployment TimeBase_Someip: service-interface=TimeBaseApp, service-interface-id=7, service-interface-version={major-version=0, minor-version=0}
    16 x someip method deployment, all with transport-protocol=UDP:
      GetTimeWithStatusSomeip: method=GetTimeWithStatusApp, method-id=10
      GetCurrentSomeip: method=GetCurrentTimeApp, method-id=60
      ChangeNotifierAppSomeipMethodDeployment: method=ChangeNotifierApp, method-id=70
      StatusChangeDataSomeipMethodDeployment: method=StatusChangeDataApp, method-id=101
      GetRateDeviationSomeipMethodDeployment: method=GetRateDeviationApp, method-id=102
      StateChangeDataSomeipMethodDeployment: method=StateChangeDataApp, method-id=103
      SetTimeSomeipMethodDeployment: method=SetTimeApp, method-id=31
      UpdateTimeSomeipMethodDeployment: method=UpdateTimeApp, method-id=32
      SetRateCorrectionSomeipMethodDeployment: method=SetRateCorrectionApp, method-id=33
      SetUserDataSomeipMethodDeployment: method=SetUserDataApp, method-id=34
      GetUserDataSomeipMethodDeployment: method=GetUserDataApp, method-id=35
      GetSlaveTimingDataSomeipMethodDeployment: method=GetSlaveTimingDataApp, method-id=36
      GetPdelayInitiatorDataSomeipMethodDeployment: method=GetPdelayInitiatorDataApp, method-id=37
      GetMasterTimingDataSomeipMethodDeployment: method=GetMasterTimingDataApp, method-id=38
      GetPdelayResponderDataSomeipMethodDeployment: method=GetPdelayResponderDataApp, method-id=39
      GetPrecisionDataSomeipMethodDeployment: method=GetPrecisionDataApp, method-id=40
