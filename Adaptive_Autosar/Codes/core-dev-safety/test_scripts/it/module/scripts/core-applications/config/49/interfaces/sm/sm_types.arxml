AUTOSAR XML (schema 00049)
package /ara/sm
  ap application error domain StateManagementErrors: value=0
  4 x ap application error, all with error-domain=StateManagementErrors:
    PrepareFailed: error-code=7  # Preparation step of update failed
    Rejected: error-code=5  # Requested operation was rejected due to State Managements
    RollbackFailed: error-code=8  # Rollback step of update failed
    VerifyFailed: error-code=6  # Verification step of update failed
package /ara/sm/datatypes/ImplementationDataTypes
  std cpp implementation data type FGNameType: category=STRING, type-emitter=TYPE_EMITTER_ARA  # full qualified FunctionGroup shortName
    namespaces:
      symbol props ara
      symbol props sm
  std cpp implementation data type FunctionGroupListType: category=VECTOR, cpp-template-argument=FGNameType, type-emitter=TYPE_EMITTER_ARA, type-reference=FGNameType  # A list of FunctionGroups
    namespaces:
      symbol props ara
      symbol props sm
