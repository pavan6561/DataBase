AUTOSAR XML (schema 00049)
package /CryptoInterfaces
  crypto provider interface CryptoProviderInterface: category=OPENSSL
