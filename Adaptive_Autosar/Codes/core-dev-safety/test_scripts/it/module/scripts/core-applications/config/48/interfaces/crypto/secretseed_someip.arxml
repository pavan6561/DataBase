AUTOSAR XML (schema 00048)
package /SomeIpServiceInterfaceDeployment
  someip service interface deployment SecretSeed_Someip: service-interface=SecretSeed, service-interface-id=78, service-interface-version={major-version=0, minor-version=0}
    6 x someip method deployment, all with transport-protocol=UDP:
      Jump: method=Jump, method-id=1
      Next: method=Next, method-id=2
      Clone: method=Clone, method-id=3
      JumpFrom: method=JumpFrom, method-id=4
      XorWithSeedObject: method=XorWithSeedObject, method-id=5
      XorWithByteArray: method=XorWithByteArray, method-id=6
