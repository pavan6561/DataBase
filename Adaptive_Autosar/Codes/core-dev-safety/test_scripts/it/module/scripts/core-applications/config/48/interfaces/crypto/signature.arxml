AUTOSAR XML (schema 00048)
package /ServiceInterface
  service interface Signature
    namespaces:
      4 x symbol props:
        qt
        crypto
        cryptoprovider_001
        signature
    methods:
      operation GetHashAlgId: possible-ap-error=UndefinedApplicationError
        arg signatureId: type=uint8_t, direction=IN
        arg response: type=uint64_t, direction=OUT
      operation GetRequiredHashSize: possible-ap-error=UndefinedApplicationError
        arg signatureId: type=uint8_t, direction=IN
        arg response: type=uint64_t, direction=OUT
