AUTOSAR XML (schema 00049)
package /CppImplementationDataTypes
  19 x std cpp implementation data type, all with type-emitter=TYPE_EMITTER_ARA:
    ArrayLengthOne: category=ARRAY, array-size=3, cpp-template-argument=uint8_t
    ArrayLength2MSBFirst: category=ARRAY, array-size=3, cpp-template-argument=uint8_t
    ArrayLength4MSBFirst: category=ARRAY, array-size=3, cpp-template-argument=uint8_t
    ArrayByteOrderMSBF: category=ARRAY, array-size=3, cpp-template-argument=uint8_t
    ArrayLength2MSBLast: category=ARRAY, array-size=3, cpp-template-argument=uint8_t
    ArrayLength4MSBLast: category=ARRAY, array-size=3, cpp-template-argument=uint8_t
    ArrayNoLengthField: category=ARRAY, array-size=3, cpp-template-argument=uint8_t
    ArrayNoByteOrder: category=ARRAY, array-size=3, cpp-template-argument=uint8_t
    Array2D: category=ARRAY, array-size=2, cpp-template-argument=Array_Inner1D
    Array_Inner1D: category=ARRAY, array-size=3, cpp-template-argument=uint8_t
    VectorLengthOne: category=VECTOR, array-size=3, cpp-template-argument=uint8_t
    VectorLength2MSBFirst: category=VECTOR, array-size=3, cpp-template-argument=uint8_t
    VectorLength4MSBFirst: category=VECTOR, array-size=3, cpp-template-argument=uint8_t
    VectorByteOrderMSBF: category=VECTOR, array-size=3, cpp-template-argument=uint8_t
    VectorLength2MSBLast: category=VECTOR, array-size=3, cpp-template-argument=uint8_t
    VectorLength4MSBLast: category=VECTOR, array-size=3, cpp-template-argument=uint8_t
    VectorNoLengthField: category=VECTOR, array-size=3, cpp-template-argument=uint8_t
    VectorNoByteOrder: category=VECTOR, array-size=3, cpp-template-argument=uint8_t
    ArrayLengthZero: category=ARRAY, array-size=33, cpp-template-argument=uint8_t
