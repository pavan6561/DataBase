AUTOSAR XML (schema 00049)
package /PersistencyKeyValueStorageInterface
  persistency key value storage interface VehiclePackageTransferStatus: redundancy=NONE, update-strategy=KEEP-EXISTING
