AUTOSAR XML (schema 00049)
package /Executables
  executable statemanager
    root sw component prototype rootSwComponentPrototype_ucm_sm_stub: application-type=statemanager_ucm_stub
package /ProcessDesign
  process design statemanager: executable=statemanager
package /Processes
  process statemanager: design=statemanager, executable=statemanager, state-dependent-startup-config{execution-dependency=AraSomeipRoutingDaemonStateMachine.Running, function-group-state=MachineFG.Startup, resource-group=ResourceGroup, startup-config=statemanager}
