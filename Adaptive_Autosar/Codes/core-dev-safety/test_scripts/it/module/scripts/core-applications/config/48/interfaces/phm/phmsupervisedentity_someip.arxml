AUTOSAR XML (schema 00048)
package /ServiceInterfaceDeployments
  someip service interface deployment PhmSupervisedEntity_Someip: service-interface=PhmSupervisedEntity, service-interface-id=5, service-interface-version={major-version=0, minor-version=0}
    13 x someip method deployment, all with transport-protocol=UDP:
      SupervisedEntitySomeip: method=SupervisedEntity, method-id=1
      ReportCheckpointSomeip: method=ReportCheckpoint, method-id=2
      GetLocalSupervisionSomeip: method=GetLocalSupervision, method-id=3
      GetGlobalSupervisionSomeip: method=GetGlobalSupervision, method-id=4
      HealthChannel: method=HealthChannel, method-id=5
      ReportHealthStatus: method=ReportHealthStatus, method-id=6
      ApplicationRecoveryAction: method=ApplicationRecoveryAction, method-id=7
      RestartAction: method=RestartAction, method-id=8
      ResetAction: method=ResetAction, method-id=9
      Offer: method=Offer, method-id=10
      StopOffer: method=StopOffer, method-id=11
      StopWatchdog: method=StopWatchdog, method-id=12
      WrongTriggerWatchdog: method=WrongTriggerWatchdog, method-id=13
