AUTOSAR XML (schema 00049)
package /ServiceInterface
  service interface RandomGeneratorCtx
    namespaces:
      4 x symbol props:
        qt
        crypto
        cryptoprovider_001
        rng
    methods:
      6 x operation:
        AddEntropy
          arg rngId: type=uint8_t, direction=IN
          arg entropy: type=ByteArray, direction=IN
          arg response: type=uint8_t, direction=OUT
        Generate: possible-ap-error=[UninitializedContext, BusyResource, UndefinedApplicationError]
          arg rngId: type=uint8_t, direction=IN
          arg count: type=uint32_t, direction=IN
          arg responseData: type=returnGenerateResponse, direction=OUT
        Seed
          arg rngId: type=uint8_t, direction=IN
          arg seed: type=ByteArray, direction=IN
          arg response: type=uint8_t, direction=OUT
        SeedSecret
          arg rngId: type=uint8_t, direction=IN
          arg seed: type=uint16_t, direction=IN
          arg response: type=uint64_t, direction=OUT
        SetKey
          arg rngId: type=uint8_t, direction=IN
          arg key: type=uint16_t, direction=IN
          arg response: type=uint64_t, direction=OUT
        GetExtensionService
          arg rngId: type=uint8_t, direction=IN
          arg response: type=uint64_t, direction=OUT
