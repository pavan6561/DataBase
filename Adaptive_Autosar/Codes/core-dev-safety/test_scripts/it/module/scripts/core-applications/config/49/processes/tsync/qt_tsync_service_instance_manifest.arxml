AUTOSAR XML (schema 00049)
package /ServiceInstances
  provided someip service instance qt_tsync_instance1: service-interface-deployment=TimeBase_Someip, sd-server-config=SomeipSdServerServiceInstance, service-instance-id=6
package /SomeipServiceInstanceToMachineMapping
  someip service instance to machine mapping TSync_Instance1_SomeipServiceInstanceToMachineMapping: communication-connector=EthernetCommunicationConnector, service-instance=qt_tsync_instance1, udp-port=3318
package /ServiceInstanceToPortPrototypeMapping
  service instance to port prototype mapping qt_TSync_ServiceInstanceToPortPrototypeMapping: port-prototype=tsync_instance_1_rootSwComponentPrototype.PPort_TimeBaseConsumer, process-design=qt_tsync_instance1, process=qt_tsync_instance1, service-instance=qt_tsync_instance1
