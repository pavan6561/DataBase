AUTOSAR XML (schema 00049)
package /ServiceInterface
  service interface CryptoService
    namespaces:
      4 x symbol props:
        qt
        crypto
        cryptoprovider_001
        cryptoservice
    methods:
      operation GetBlockSize: possible-ap-error=UndefinedApplicationError
        arg response: type=uint32_t, direction=OUT
        arg cryptoServiceId: type=uint8_t, direction=IN
      operation GetMaxInputSize: possible-ap-error=UndefinedApplicationError
        arg suppressPadding: type=bool, direction=IN
        arg response: type=uint32_t, direction=OUT
        arg cryptoServiceId: type=uint8_t, direction=IN
      operation GetMaxOutputSize: possible-ap-error=UndefinedApplicationError
        arg suppressPadding: type=bool, direction=IN
        arg response: type=uint32_t, direction=OUT
        arg cryptoServiceId: type=uint8_t, direction=IN
