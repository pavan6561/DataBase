AUTOSAR XML (schema 00048)
package /ServiceInstanceToPortMapping
  service instance to port prototype mapping DigestServiceToPortPrototypeMapping: port-prototype=rootSwComponentPrototype.PPortDigestService, process=qt_crypto_instance1, service-instance=DigestService
