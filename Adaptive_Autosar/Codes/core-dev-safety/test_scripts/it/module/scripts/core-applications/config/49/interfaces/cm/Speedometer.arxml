AUTOSAR XML (schema 00049)
package /ServiceInterfaces
  service interface Speedometer
    namespaces:
      symbol props ara
      symbol props com
      symbol props sample
    events:
      18 x data:
        Event_ArrayLengthOne: type=ArrayLengthOne
        Event_ArrayLength2MSBFirst: type=ArrayLength2MSBFirst
        Event_ArrayLength4MSBFirst: type=ArrayLength4MSBFirst
        Event_ArrayByteOrderMSBF: type=ArrayByteOrderMSBF
        Event_ArrayLength2MSBLast: type=ArrayLength2MSBLast
        Event_ArrayLength4MSBLast: type=ArrayLength4MSBLast
        Event_Array_NoLengthField: type=ArrayNoLengthField
        Event_ArrayNoByteOrder: type=ArrayNoByteOrder
        Event_Array2D: type=Array2D
        Event_VectorLengthOne: type=VectorLengthOne
        Event_VectorLength2MSBFirst: type=VectorLength2MSBFirst
        Event_VectorLength4MSBFirst: type=VectorLength4MSBFirst
        Event_VectorByteOrderMSBF: type=VectorByteOrderMSBF
        Event_VectorLength2MSBLast: type=VectorLength2MSBLast
        Event_VectorLength4MSBLast: type=VectorLength4MSBLast
        Event_Vector_NoLengthField: type=VectorNoLengthField
        Event_VectorNoByteOrder: type=VectorNoByteOrder
        Event_ArrayLengthZero: type=ArrayLengthZero
package /TransformationPropsSets
  transformation props set ArrayVectorTransformationPropsSet
    18 x ap someip transformation props:
      Array_NoLengthField
      Array_OneLengthField: size-of-array-length-field=1
      Array_ByteOrderMSBF: byte-order=big-endian, size-of-array-length-field=2
      Array_NoByteOrder: size-of-array-length-field=2
      ArrayLength2MSBFirst: byte-order=big-endian, size-of-array-length-field=2
      ArrayLength4MSBFirst: byte-order=big-endian, size-of-array-length-field=4
      ArrayLength2MSBLast: byte-order=little-endian, size-of-array-length-field=2
      ArrayLength4MSBLast: byte-order=little-endian, size-of-array-length-field=4
      Array_2DLengthFieldMSBFMapping: byte-order=big-endian, size-of-array-length-field=4
      Vector_NoLengthField
      Vector_OneLengthField: size-of-array-length-field=1
      Vector_ByteOrderMSBF: byte-order=big-endian, size-of-array-length-field=2
      Vector_NoByteOrder: size-of-array-length-field=2
      VectorLength2MSBFirst: byte-order=big-endian, size-of-array-length-field=2
      VectorLength4MSBFirst: byte-order=big-endian, size-of-array-length-field=4
      VectorLength2MSBLast: byte-order=little-endian, size-of-array-length-field=2
      VectorLength4MSBLast: byte-order=little-endian, size-of-array-length-field=4
      Array_ZeroLengthField: size-of-array-length-field=0
package /TransformationPropsToServiceInterfaceMappingSets
  transformation props to service interface element mapping set ArrayVectorTransformationPropsToServiceInterfaceElementMappingSet
    18 x transformation props to service interface element mapping:
      Array_NoLengthFieldMapping: event=Event_Array_NoLengthField, transformation-props=Array_NoLengthField
      Array_OneLengthFieldMapping: event=[Event_ArrayLengthOne, Event_Array_NoLengthField], transformation-props=Array_OneLengthField
      Array_ByteOrderMapping: event=[Event_ArrayNoByteOrder, Event_ArrayByteOrderMSBF], transformation-props=Array_ByteOrderMSBF
      Array_NoByteOrderMapping: event=Event_ArrayNoByteOrder, transformation-props=Array_NoByteOrder
      Array_Length2MSBFirstMapping: event=Event_ArrayLength2MSBFirst, transformation-props=ArrayLength2MSBFirst
      Array_Length4MSBFirstMapping: event=Event_ArrayLength4MSBFirst, transformation-props=ArrayLength4MSBFirst
      Array_Length2MSBLastMapping: event=Event_ArrayLength2MSBLast, transformation-props=ArrayLength2MSBLast
      Array_Length4MSBLastMapping: event=Event_ArrayLength4MSBLast, transformation-props=ArrayLength4MSBLast
      Vector_NoLengthFieldMapping: event=Event_Vector_NoLengthField, transformation-props=Vector_NoLengthField
      Vector_OneLengthFieldMapping: event=[Event_VectorLengthOne, Event_Vector_NoLengthField], transformation-props=Vector_OneLengthField
      Vector_ByteOrderMapping: event=[Event_VectorNoByteOrder, Event_VectorByteOrderMSBF], transformation-props=Vector_ByteOrderMSBF
      Vector_NoByteOrderMapping: event=Event_VectorNoByteOrder, transformation-props=Vector_NoByteOrder
      Vector_Length2MSBFirstMapping: event=Event_VectorLength2MSBFirst, transformation-props=VectorLength2MSBFirst
      Vector_Length4MSBFirstMapping: event=Event_VectorLength4MSBFirst, transformation-props=VectorLength4MSBFirst
      Vector_Length2MSBLastMapping: event=Event_VectorLength2MSBLast, transformation-props=VectorLength2MSBLast
      Vector_Length4MSBLastMapping: event=Event_VectorLength4MSBLast, transformation-props=VectorLength4MSBLast
      Array_ZeroLengthFieldMapping: event=Event_ArrayLengthZero, transformation-props=Array_ZeroLengthField
      Array_2DMapping: event=Event_Array2D, transformation-props=Array_2DLengthFieldMSBFMapping
package /SomeipDataPrototypeTransformationProps
  18 x someip data prototype transformation props:
    Array_NoLengthField: data-prototypes=Event_Array_NoLengthField, someip-transformation-props=Array_NoLengthField
    Array_LengthOne: data-prototypes=Event_ArrayLengthOne, someip-transformation-props=Array_OneLengthField
    Array_ByteOrderMSBF: data-prototypes=Event_ArrayByteOrderMSBF, someip-transformation-props=Array_ByteOrderMSBF
    Array_NoByteOrder: data-prototypes=Event_ArrayNoByteOrder, someip-transformation-props=Array_NoByteOrder
    Array_Length2MSBFirst: data-prototypes=Event_ArrayLength2MSBFirst, someip-transformation-props=ArrayLength2MSBFirst
    Array_Length4MSBFirst: data-prototypes=Event_ArrayLength4MSBFirst, someip-transformation-props=ArrayLength4MSBFirst
    Array_Length2MSBLast: data-prototypes=Event_ArrayLength2MSBLast, someip-transformation-props=ArrayLength2MSBLast
    Array_Length4MSBLast: data-prototypes=Event_ArrayLength4MSBLast, someip-transformation-props=ArrayLength4MSBLast
    Array2D_MSBFirst: data-prototypes=Event_Array2D, someip-transformation-props=Array_2DLengthFieldMSBFMapping
    Vector_NoLengthField: data-prototypes=Event_Vector_NoLengthField, someip-transformation-props=Vector_NoLengthField
    Vector_LengthOne: data-prototypes=Event_VectorLengthOne, someip-transformation-props=Vector_OneLengthField
    Vector_ByteOrderMSBF: data-prototypes=Event_VectorByteOrderMSBF, someip-transformation-props=Vector_ByteOrderMSBF
    Vector_NoByteOrder: data-prototypes=Event_VectorNoByteOrder, someip-transformation-props=Vector_NoByteOrder
    Vector_Length2MSBFirst: data-prototypes=Event_VectorLength2MSBFirst, someip-transformation-props=VectorLength2MSBFirst
    Vector_Length4MSBFirst: data-prototypes=Event_VectorLength4MSBFirst, someip-transformation-props=VectorLength4MSBFirst
    Vector_Length2MSBLast: data-prototypes=Event_VectorLength2MSBLast, someip-transformation-props=VectorLength2MSBLast
    Vector_Length4MSBLast: data-prototypes=Event_VectorLength4MSBLast, someip-transformation-props=VectorLength4MSBLast
    Array_LengthZero: data-prototypes=Event_ArrayLengthZero, someip-transformation-props=Array_ZeroLengthField
