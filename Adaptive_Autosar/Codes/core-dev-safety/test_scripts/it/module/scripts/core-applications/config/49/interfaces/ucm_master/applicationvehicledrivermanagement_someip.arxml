AUTOSAR XML (schema 00049)
package /ServiceInterfaceDeployement
  someip service interface deployment ApplicationVehicleDriverManagement_Someip: service-interface=ApplicationVehicleDriverManagement, service-interface-id=999, service-interface-version={major-version=1, minor-version=0}
    4 x someip field deployment:
      ApprovalRequired: field=ApprovalRequired
        get get: method-id=111, transport-protocol=UDP
        notifier notifier: event-id=222, transport-protocol=UDP
        set set: method-id=333, transport-protocol=UDP
      SafetyPolicy: field=SafetyPolicy
        get SafetyPolicy_getter: method-id=1, transport-protocol=UDP
        notifier SafetyPolicy_notifier: event-id=2, transport-protocol=UDP
      SafetyState: field=SafetyState
        get SafetyState_getter: method-id=11, transport-protocol=UDP
        notifier SafetyState_notifier: event-id=22, transport-protocol=UDP
      CampaignStateField: field=CampaignStateField
        get get: method-id=100, transport-protocol=UDP
        notifier notifier: event-id=200, transport-protocol=UDP
    9 x someip method deployment, all with transport-protocol=UDP:
      CampaignState: method=CampaignState, method-id=200
      IsSyncingSet: method=IsSyncingSet, method-id=201
      IsProcessingSet: method=IsProcessingSet, method-id=202
      IsActivatingSet: method=IsActivatingSet, method-id=203
      IsVechicleCheckingSet: method=IsVehicleCheckingSet, method-id=204
      GetSwPackageDescription: method=GetSwPackageDescription, method-id=205
      GetSwProcessProgress: method=GetSwProcessProgress, method-id=206
      GetSwTransferProgress: method=GetSwTransferProgress, method-id=207
      DriverApproval: method=DriverApproval, method-id=209
    4 x someip event group:
      ApprovalEvent: event-group-id=101, event=ApprovalRequired/notifier
      SafetyPolicy_eventgroup: event-group-id=202, event=SafetyPolicy_notifier
      SafetyState_eventgroup: event-group-id=303, event=SafetyState_notifier
      CampaignStateEvent: event-group-id=404, event=CampaignStateField/notifier
