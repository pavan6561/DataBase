AUTOSAR XML (schema 00048)
package /ServiceInterface
  service interface SignatureService
    namespaces:
      4 x symbol props:
        qt
        crypto
        cryptoprovider_001
        signatureservice
    methods:
      operation GetRequiredHashAlgId: possible-ap-error=UndefinedApplicationError
        arg sigServiceId: type=uint8_t, direction=IN
        arg response: type=uint64_t, direction=OUT
      operation GetRequiredHashSize: possible-ap-error=UndefinedApplicationError
        arg sigServiceId: type=uint8_t, direction=IN
        arg response: type=uint64_t, direction=OUT
      operation GetSignatureSize: possible-ap-error=UndefinedApplicationError
        arg sigServiceId: type=uint8_t, direction=IN
        arg response: type=uint64_t, direction=OUT
