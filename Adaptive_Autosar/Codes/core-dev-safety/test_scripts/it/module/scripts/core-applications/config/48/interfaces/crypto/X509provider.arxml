AUTOSAR XML (schema 00048)
package /ServiceInterfaces
  service interface X509Provider
    namespaces:
      symbol props qt
      symbol props crypto
      symbol props x509
    methods:
      18 x operation:
        LoadX509Provider: possible-ap-error=[RuntimeFault, UndefinedApplicationError]
          arg instanceSpecifier: type=String, direction=IN
          arg response: type=uint8_t, direction=OUT
        BuildDn: possible-ap-error=[InvalidArgument, InvalidInputSize, UndefinedApplicationError]
          arg dn: type=String, direction=IN
          arg response: type=uint64_t, direction=OUT
        CreateCertSignRequest: possible-ap-error=[UnexpectedValue, UndefinedApplicationError]
          6 x arg:
            csrId: type=uint8_t, direction=IN
            signerCtx: type=uint8_t, direction=IN
            derSubjectDN: type=ByteArray, direction=IN
            x509Extensions: type=ByteArray, direction=IN
            version: type=uint64_t, direction=IN
            response: type=uint64_t, direction=OUT
        CountCertsInChain: possible-ap-error=[InvalidArgument, UnknownIdentifier, UndefinedApplicationError]
          4 x arg:
            instanceSpecifier: type=String, direction=IN
            certChain: type=String, direction=IN
            formatId: type=uint32_t, direction=IN
            response: type=uint64_t, direction=OUT
        CreateEmptyDn: possible-ap-error=UndefinedApplicationError
          arg capacity: type=uint64_t, direction=IN
          arg response: type=uint64_t, direction=OUT
        DecodeDn: possible-ap-error=[InvalidArgument, UnknownIdentifier, UndefinedApplicationError]
          arg dn: type=ByteArray, direction=IN
          arg formatId: type=uint32_t, direction=IN
          arg response: type=uint64_t, direction=OUT
        FindCertByDn: possible-ap-error=UndefinedApplicationError
          5 x arg:
            subjectDn: type=uint8_t, direction=IN
            issuerDn: type=uint8_t, direction=IN
            validityTimePoint: type=uint64_t, direction=IN
            certIndex: type=uint64_t, direction=INOUT
            response: type=uint64_t, direction=OUT
        FindCertByKeyIds: possible-ap-error=UndefinedApplicationError
          arg subjectKeyId: type=ByteArray, direction=IN
          arg authorityKeyId: type=ByteArray, direction=IN
          arg response: type=uint64_t, direction=OUT
        FindCertBySn: possible-ap-error=UndefinedApplicationError
          arg sn: type=ByteArray, direction=IN
          arg issuerDn: type=uint8_t, direction=IN
          arg response: type=uint64_t, direction=OUT
        ParseCertSignRequest: possible-ap-error=[Unsupported, UndefinedApplicationError]
          arg csr: type=ByteArray, direction=IN
          arg withMetaData: type=bool, direction=IN
          arg response: type=uint64_t, direction=OUT
        Import: possible-ap-error=[InvalidArgument, IncompatibleObject, ContentDuplication, AccessViolation, UndefinedApplicationError]
          4 x arg:
            instanceSpecifier: type=String, direction=IN
            cert: type=uint32_t, direction=IN
            iSpecify: type=String, direction=IN
            response: type=uint64_t, direction=OUT
        LoadCertificate: possible-ap-error=[UnreservedResource, UndefinedApplicationError]
          arg InstanceSpecifier: type=String, direction=IN
          arg response: type=uint64_t, direction=OUT
        ParseCertChain: possible-ap-error=[InsufficientCapacity, InvalidArgument, UnknownIdentifier, UndefinedApplicationError]
          7 x arg:
            instanceSpecifier: type=String, direction=IN
            rootId: type=uint8_t, direction=IN
            interCertId: type=uint8_t, direction=IN
            certCaId: type=uint8_t, direction=IN
            certChain: type=String, direction=IN
            formatId: type=uint32_t, direction=IN
            response: type=uint64_t, direction=OUT
        ParseCert: possible-ap-error=[InsufficientCapacity, InvalidArgument, UnknownIdentifier, UndefinedApplicationError]
          5 x arg:
            instanceSpecifier: type=String, direction=IN
            cert: type=String, direction=IN
            formatId: type=uint32_t, direction=IN
            storeCertId: type=uint8_t, direction=IN
            response: type=uint64_t, direction=OUT
        Remove: possible-ap-error=UndefinedApplicationError
          arg instanceSpecifier: type=String, direction=IN
          arg cert: type=uint8_t, direction=IN
          arg response: type=bool, direction=OUT
        VerifyCert: possible-ap-error=UndefinedApplicationError
          4 x arg:
            instanceSpecifier: type=String, direction=IN
            cert: type=uint8_t, direction=IN
            myRoot: type=uint8_t, direction=IN
            Status: type=uint64_t, direction=OUT
        VerifyCertChain: possible-ap-error=UndefinedApplicationError
          5 x arg:
            instanceSpecifier: type=String, direction=IN
            certId: type=uint8_t, direction=IN
            interCert: type=uint8_t, direction=IN
            myRoot: type=uint8_t, direction=IN
            Status: type=uint64_t, direction=OUT
        ParseCertChainVector: possible-ap-error=[InsufficientCapacity, UndefinedApplicationError, InvalidArgument, UnknownIdentifier]
          9 x arg:
            instanceSpecifier: type=String, direction=IN
            certId: type=uint8_t, direction=IN
            rootCertId: type=uint8_t, direction=IN
            interCertId: type=uint8_t, direction=IN
            cert: type=String, direction=IN
            interCert: type=String, direction=IN
            rootCert: type=String, direction=IN
            formatId: type=uint32_t, direction=IN
            response: type=uint64_t, direction=OUT
