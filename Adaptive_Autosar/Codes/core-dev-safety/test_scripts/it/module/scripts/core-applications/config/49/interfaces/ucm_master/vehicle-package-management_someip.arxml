AUTOSAR XML (schema 00049)
package /ara/apd/ucm_master/deployment
  someip service interface deployment VehicleDriverApplicationSomeIp: service-interface=VehicleDriverApplication, service-interface-id=740, service-interface-version={major-version=1, minor-version=0}
    4 x someip field deployment:
      ApprovalRequired: field=ApprovalRequired
        get ApprovalRequired_getter: method-id=32101, transport-protocol=UDP
        notifier ApprovalRequired_notifier: event-id=9534, transport-protocol=UDP
      CampaignState: field=CampaignState
        get CampaignState_getter: method-id=32102, transport-protocol=UDP
        notifier CampaignState_notifier: event-id=9535, transport-protocol=UDP
      SafetyPolicy: field=SafetyPolicy
        get SafetyPolicy_getter: method-id=32103, transport-protocol=UDP
        notifier SafetyPolicy_notifier: event-id=9536, transport-protocol=UDP
      SafetyState: field=SafetyState
        get SafetyState_getter: method-id=31104, transport-protocol=UDP
        notifier SafetyState_notifier: event-id=9537, transport-protocol=UDP
    8 x someip method deployment, all with transport-protocol=UDP:
      AllowCampaign: method=AllowCampaign, method-id=32001
      CancelCampaign: method=CancelCampaign, method-id=32002
      DriverApproval: method=DriverApproval, method-id=32003
      GetCampaignHistory: method=GetCampaignHistory, method-id=32004
      GetSwClusterDescription: method=GetSwClusterDescription, method-id=32005
      GetSwPackageDescription: method=GetSwPackageDescription, method-id=32006
      GetSwProcessProgress: method=GetSwProcessProgress, method-id=32007
      GetSwTransferProgress: method=GetSwTransferProgress, method-id=32008
    4 x someip event group:
      ApprovalRequired_eventgroup: event-group-id=55001, event=ApprovalRequired_notifier
      CampaignState_eventgroup: event-group-id=55002, event=CampaignState_notifier
      SafetyPolicy_eventgroup: event-group-id=55003, event=SafetyPolicy/SafetyPolicy_notifier
      SafetyState_eventgroup: event-group-id=55004, event=SafetyState/SafetyState_notifier
  someip service interface deployment VehiclePackageManagementSomeIp: service-interface=VehiclePackageManagement, service-interface-id=730, service-interface-version={major-version=1, minor-version=0}
    someip field deployment RequestedPackage: field=RequestedPackage
      get RequestedPackage_getter: method-id=31006, transport-protocol=UDP
      notifier RequestedPackage_notifier: event-id=9433, transport-protocol=UDP
    someip field deployment SafetyState: field=SafetyState
      get SafetyState_getter: method-id=31007, transport-protocol=UDP
      notifier SafetyState_notifier: event-id=9434, transport-protocol=UDP
    someip field deployment TransferState: field=TransferState
      get TransferState_getter: method-id=31005, transport-protocol=UDP
      notifier TransferState_notifier: event-id=9432, transport-protocol=UDP
    11 x someip method deployment, all with transport-protocol=UDP:
      AllowCampaign: method=AllowCampaign, method-id=31100
      CancelCampaign: method=CancelCampaign, method-id=31109
      DeleteTransfer: method=DeleteTransfer, method-id=31111
      GetCampaignHistory: method=GetCampaignHistory, method-id=31110
      GetSwClusterInfo: method=GetSwClusterInfo, method-id=31102
      GetSwPackages: method=GetSwPackages, method-id=31112
      SwPackageInventory: method=SwPackageInventory, method-id=31101
      TransferData: method=TransferData, method-id=31105
      TransferExit: method=TransferExit, method-id=31106
      TransferStart: method=TransferStart, method-id=31103
      TransferVehiclePackage: method=TransferVehiclePackage, method-id=31104
    someip event group RequestedPackage_eventgroup: event-group-id=45401, event=RequestedPackage_notifier
    someip event group SafetyState_eventgroup: event-group-id=45402, event=SafetyState/SafetyState_notifier
    someip event group TransferState_eventgroup: event-group-id=45403, event=TransferState_notifier
  someip service interface deployment VehicleStateManagersomeip: service-interface=VehicleStateManager, service-interface-id=760, service-interface-version={major-version=1, minor-version=0}
    someip field deployment SafetyPolicy: field=SafetyPolicy
      get SafetyPolicy_getter: method-id=34001, transport-protocol=UDP
      notifier SafetyPolicy_notifier: event-id=9635, transport-protocol=UDP
    someip method deployment SafetyState: method=SafetyState, method-id=31000, transport-protocol=UDP
    someip event group SafetyPolicy_eventgroup: event-group-id=56001, event=SafetyPolicy/SafetyPolicy_notifier
