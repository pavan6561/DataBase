AUTOSAR XML (schema 00048)
package /ServiceInterface
  service interface EncryptorPublicCtx
    namespaces:
      4 x symbol props:
        qt
        crypto
        cryptoprovider_001
        epc
    methods:
      operation SetKey: possible-ap-error=[IncompatibleObject, UsageViolation]
        arg encryptPublicCtxId: type=uint8_t, direction=IN
        arg keyId: type=uint8_t, direction=IN
        arg response: type=uint64_t, direction=OUT
      operation Reset
        arg encryptPublicCtxId: type=uint8_t, direction=IN
        arg response: type=uint64_t, direction=OUT
      operation ProcessBlock: possible-ap-error=[InvalidInputSize, UninitializedContext]
        4 x arg:
          encryptPublicCtxId: type=uint8_t, direction=IN
          input: type=ByteArray, direction=IN
          suppressPadding: type=bool, direction=IN
          response: type=returnByteArray, direction=OUT
