AUTOSAR XML (schema 00049)
package /ServiceInstances
  provided someip service instance RandomGeneratorCtx: service-interface-deployment=RandomGeneratorCtx_Someip, sd-server-config=SomeipSdServerServiceInstance, service-instance-id=1
