AUTOSAR XML (schema 00049)
package /ServiceInstanceToPortMappings
  service instance to port prototype mapping RequiredSomeIpUpdateRequestInstanceToPortPrototypeMapping: port-prototype=rootSwComponentPrototype.RUpdateRequest, process-design=package_manager, process=package_manager, service-instance=RequiredSomeIpUpdateRequestInstance
