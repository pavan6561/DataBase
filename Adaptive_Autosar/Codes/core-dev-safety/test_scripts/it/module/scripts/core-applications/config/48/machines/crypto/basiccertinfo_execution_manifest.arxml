AUTOSAR XML (schema 00048)
package /ServiceInstanceToPortMapping
  service instance to port prototype mapping BasicCertInfoToPortMapping: port-prototype=rootSwComponentPrototype.PPortBasicCertInfo, process=qt_crypto_instance1, service-instance=BasicCertInfo
