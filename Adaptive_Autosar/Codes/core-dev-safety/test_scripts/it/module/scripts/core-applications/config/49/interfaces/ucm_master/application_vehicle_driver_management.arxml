AUTOSAR XML (schema 00049)
package /ServiceInterfaces
  service interface ApplicationVehicleDriverManagement
    namespaces:
      symbol props ara
      symbol props com
    4 x field, all with has-getter=true, has-notifier=true:
      ApprovalRequired: type=bool, has-setter=true
      SafetyPolicy: type=String, has-setter=false
      SafetyState: type=bool, has-setter=false
      CampaignStateField: type=CampaignStateType, has-setter=false
    methods:
      9 x operation:
        CampaignState
          arg response: type=returnValues, direction=OUT
        IsSyncingSet
          arg response: type=returnValues, direction=OUT
        IsProcessingSet
          arg response: type=returnValues, direction=OUT
        IsActivatingSet
          arg response: type=returnValues, direction=OUT
        IsVehicleCheckingSet
          arg response: type=returnValues, direction=OUT
        GetSwPackageDescription
          arg packageName: type=String, direction=OUT
        GetSwProcessProgress
          arg response: type=returnValues, direction=OUT
        GetSwTransferProgress
          arg response: type=returnValues, direction=OUT
        DriverApproval
          arg approval: type=bool, direction=IN
          arg safetystate: type=uint8_t, direction=IN
