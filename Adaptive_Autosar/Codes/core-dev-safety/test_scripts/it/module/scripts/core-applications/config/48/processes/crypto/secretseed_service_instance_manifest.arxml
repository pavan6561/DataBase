AUTOSAR XML (schema 00048)
package /ServiceInstances
  provided someip service instance SecretSeed: service-interface-deployment=SecretSeed_Someip, sd-server-config=SomeipSdServerServiceInstance, service-instance-id=1
package /ServiceInstanceToMachineMappings
  someip service instance to machine mapping SecretSeedToMachineMapping: communication-connector=EthernetCommunicationConnector, service-instance=SecretSeed, udp-port=4022
