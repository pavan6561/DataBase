AUTOSAR XML (schema 00048)
package /ServiceInstanceToPortMapping
  service instance to port prototype mapping SignatureServiceToPortPrototypeMapping: port-prototype=rootSwComponentPrototype.PPortSignatureService, process=qt_crypto_instance1, service-instance=SignatureService_required
