AUTOSAR XML (schema 00048)
package /ServiceInstanceToPortMapping
  service instance to port prototype mapping StreamCipherCtxToPortMapping: port-prototype=rootSwComponentPrototype.PPortStreamCipherCtx, process=qt_crypto_instance1, service-instance=StreamCipherCtx
