AUTOSAR XML (schema 00048)
package /CppImplementationDataTypes
  39 x std cpp implementation data type, all with type-emitter=TYPE_EMITTER_ARA:
    Struct_Serialize: category=STRUCTURE
      namespaces:
        symbol props ara
        symbol props com
        symbol props sample
      cpp implementation data type element subElements1: type-reference=uint32_t
      cpp implementation data type element subElements2: type-reference=uint64_t
    Struct_position_serialize: category=STRUCTURE
      namespaces:
        symbol props ara
        symbol props com
        symbol props sample
      cpp implementation data type element subElements1: type-reference=uint32_t
      cpp implementation data type element subElements2: type-reference=uint64_t
    Struct_Byte: category=STRUCTURE
      namespaces:
        symbol props ara
        symbol props com
        symbol props sample
      cpp implementation data type element subElements1: type-reference=int16_t
      cpp implementation data type element subElements2: type-reference=int32_t
    Struct_order: category=STRUCTURE
      namespaces:
        symbol props ara
        symbol props com
        symbol props sample
      cpp implementation data type element subElements1: type-reference=int32_t
      cpp implementation data type element subElements2: type-reference=int64_t
    Struct_LengthField: category=STRUCTURE
      namespaces:
        symbol props ara
        symbol props com
        symbol props sample
      cpp implementation data type element subElements1: type-reference=int64_t
      cpp implementation data type element subElements2: type-reference=int64_t
    Struct_ByteOrder: category=STRUCTURE
      namespaces:
        symbol props ara
        symbol props com
        symbol props sample
      cpp implementation data type element subElements1: is-optional=true, type-reference=uint32_t
      cpp implementation data type element subElements2: is-optional=true, type-reference=uint32_t
    StructLengthData: category=STRUCTURE
      namespaces:
        symbol props ara
        symbol props com
        symbol props sample
      cpp implementation data type element subElements1: type-reference=uint16_t
      cpp implementation data type element subElements2: type-reference=uint64_t
    StructLengthOrder: category=STRUCTURE
      namespaces:
        symbol props ara
        symbol props com
        symbol props sample
      cpp implementation data type element subElements1: type-reference=InnerArray
    Dynamic_false: category=STRUCTURE
      namespaces:
        symbol props ara
        symbol props com
        symbol props sample
      cpp implementation data type element subElements1: type-reference=uint32_t
      cpp implementation data type element subElements2: type-reference=int32_t
    DynamicFalseData: category=STRUCTURE
      namespaces:
        symbol props ara
        symbol props com
        symbol props sample
      cpp implementation data type element subElements1: type-reference=Vector_distance
      cpp implementation data type element subElements2: type-reference=uint64_t
    Dynamic_true: category=STRUCTURE
      namespaces:
        symbol props ara
        symbol props com
        symbol props sample
      cpp implementation data type element subElements1: type-reference=uint8_t
      cpp implementation data type element subElements2: type-reference=uint16_t
    Dynamictrue_Data: category=STRUCTURE
      namespaces:
        symbol props ara
        symbol props com
        symbol props sample
      cpp implementation data type element subElements1: type-reference=Vector_distance
      cpp implementation data type element subElements2: type-reference=int64_t
    LengthTypeOne: category=STRUCTURE
      namespaces:
        symbol props ara
        symbol props com
        symbol props sample
      cpp implementation data type element subElements1: type-reference=uint32_t
      cpp implementation data type element subElements2: type-reference=uint16_t
    DataTypeLength: category=STRUCTURE
      namespaces:
        symbol props ara
        symbol props com
        symbol props sample
      cpp implementation data type element subElements1: type-reference=uint64_t
      cpp implementation data type element subElements2: type-reference=uint32_t
    TLVDataType: category=STRUCTURE
      namespaces:
        symbol props ara
        symbol props com
        symbol props sample
      cpp implementation data type element subElements1: type-reference=int64_t
      cpp implementation data type element subElements2: type-reference=int16_t
    TLVLength: category=STRUCTURE
      namespaces:
        symbol props ara
        symbol props com
        symbol props sample
      cpp implementation data type element subElements1: type-reference=int16_t
      cpp implementation data type element subElements2: type-reference=int16_t
    DataTypeTLV: category=STRUCTURE
      namespaces:
        symbol props ara
        symbol props com
        symbol props sample
      5 x cpp implementation data type element:
        Type8: type-reference=int8_t
        Type16: type-reference=int16_t
        Type32: type-reference=int32_t
        Type64: type-reference=int64_t
        structSubElement: type-reference=InnerStructTLV
    InnerStructTLV: category=STRUCTURE
      namespaces:
        symbol props ara
        symbol props com
        symbol props sample
      cpp implementation data type element subElements1: type-reference=Vector_distance
    InnerArray: category=ARRAY, array-size=5, cpp-template-argument=uint8_t
    Length2MSBF: category=STRUCTURE
      namespaces:
        symbol props ara
        symbol props com
        symbol props sample
      cpp implementation data type element subElements1: type-reference=InnerArray2MSBF
    Length2MSBL: category=STRUCTURE
      namespaces:
        symbol props ara
        symbol props com
        symbol props sample
      cpp implementation data type element subElements1: type-reference=InnerArray2MSBL
    Length4MSBF: category=STRUCTURE
      namespaces:
        symbol props ara
        symbol props com
        symbol props sample
      cpp implementation data type element subElements1: type-reference=InnerArray4MSBF
    Length4MSBL: category=STRUCTURE
      namespaces:
        symbol props ara
        symbol props com
        symbol props sample
      cpp implementation data type element subElements1: type-reference=InnerArray4MSBL
    String2MSBF: category=STRING
      namespaces:
        symbol props ara
        symbol props core
        symbol props string
    String2MSBL: category=STRING
      namespaces:
        symbol props ara
        symbol props core
        symbol props string
    String4MSBF: category=STRING
      namespaces:
        symbol props ara
        symbol props core
        symbol props string
    String4MSBL: category=STRING
      namespaces:
        symbol props ara
        symbol props core
        symbol props string
    StringOne: category=STRING
      namespaces:
        symbol props ara
        symbol props core
        symbol props string
    VectorSomeipSeg: category=VECTOR, cpp-template-argument=TypeRefCppIdt
    StringBothNoLength: category=STRING
      namespaces:
        symbol props ara
        symbol props core
        symbol props string
    StringBothNoByteOrder: category=STRING
      namespaces:
        symbol props ara
        symbol props core
        symbol props string
    StringNolength: category=STRING
      namespaces:
        symbol props ara
        symbol props core
        symbol props string
    StringNoByteOrder: category=STRING
      namespaces:
        symbol props ara
        symbol props core
        symbol props string
    InnerArray4MSBL: category=ARRAY, array-size=5, cpp-template-argument=uint8_t
    InnerArray4MSBF: category=ARRAY, array-size=5, cpp-template-argument=uint8_t
    InnerArray2MSBL: category=ARRAY, array-size=5, cpp-template-argument=uint8_t
    InnerArray2MSBF: category=ARRAY, array-size=5, cpp-template-argument=uint8_t
    FieldSubscribe: type-reference=uint64_t
    EventSameData: type-reference=uint32_t
