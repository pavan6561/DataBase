AUTOSAR XML (schema 00049)
package /ServiceInstances
  provided someip service instance Signature: service-interface-deployment=Signature_Someip, sd-server-config=SomeipSdServerServiceInstance, service-instance-id=1
package /ServiceInstanceToMachineMappings
  someip service instance to machine mapping SignatureToMachineMapping: communication-connector=EthernetCommunicationConnector, service-instance=Signature, udp-port=4023
