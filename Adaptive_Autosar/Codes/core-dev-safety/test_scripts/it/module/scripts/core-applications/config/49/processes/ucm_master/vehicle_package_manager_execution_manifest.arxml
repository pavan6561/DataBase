AUTOSAR XML (schema 00049)
package /Processes
  process vehicle_package_manager: design=vehicle_package_manager, executable=vehicle_package_manager, state-dependent-startup-config{execution-dependencys=[AraDltDaemon.Running, AraSomeipRoutingDaemonStateMachine.Running], function-group-state=MachineFG.Startup, resource-group=ResourceGroup, startup-config=vehicle_package_manager}
    process state machine vehicle_package_manager: type=MachineState
package /ServiceInstanceToPortMapping
  4 x service instance to port prototype mapping, all with process-design=vehicle_package_manager, process=vehicle_package_manager:
    ProvidedVehiclePackageManagementInstanceToPortMapping: port-prototype=vehicle_package_manager_root.VehiclePackageManagementPPort, service-instance=ProvidedSomeIpVehiclePackageManagementInstance
    ProvidedVehicleDriverApplicationInstanceToPortMapping: port-prototype=vehicle_package_manager_root.VehicleDriverApplicationPPort, service-instance=ProvidedSomeIpVehicleDriverApplicationInstance
    ProvidedVehicleStateManagerInstanceToPortMapping: port-prototype=vehicle_package_manager_root.VehicleStateManagerPPort, service-instance=ProvidedSomeipVehicleStateManager
    RequiredPackageManagementToPortMapping: port-prototype=vehicle_package_manager_root.PackageManagementRPort, service-instance=PackageManagementRequired
