AUTOSAR XML (schema 00048)
package /Processes
  process qt_phm_instance3: design=qt_phm_instance3, executable=qt_phm_instance3, state-dependent-startup-config{function-group-state=PHMApplicationStates.PHM_Instance3, resource-group=ResourceGroup, startup-config=qt_phm_instance3_startupconfig}
