AUTOSAR XML (schema 00048)
package /ServiceInstanceToPortMapping
  service instance to port prototype mapping SymmetricBlockCipherCtxToPortMapping: port-prototype=rootSwComponentPrototype.PPortSymmetricBlockCipherCtx, process=qt_crypto_instance1, service-instance=SymmetricBlockCipherCtx
