AUTOSAR XML (schema 00049)
package /ServiceInterfaceDeployments
  user defined service interface deployment PackageManagement: service-interface=PackageManagement
    user defined field deployment CurrentStatus: field=CurrentStatus
      get getCurrentStatus
      notifier onCurrentStatus
    17 x user defined method deployment:
      GetSwClusterInfo: method=GetSwClusterInfo
      GetSwClusterChangeInfo: method=GetSwClusterChangeInfo
      GetSwPackages: method=GetSwPackages
      TransferStart: method=TransferStart
      TransferData: method=TransferData
      TransferExit: method=TransferExit
      DeleteTransfer: method=DeleteTransfer
      ProcessSwPackage: method=ProcessSwPackage
      RevertProcessedSwPackages: method=RevertProcessedSwPackages
      GetSwProcessProgress: method=GetSwProcessProgress
      Cancel: method=Cancel
      Rollback: method=Rollback
      Activate: method=Activate
      Finish: method=Finish
      GetHistory: method=GetHistory
      GetId: method=GetId
      GetSwClusterDescription: method=GetSwClusterDescription
