AUTOSAR XML (schema 00049)
package /avin/stdtypes
  11 x base type, all with category=FIXED_LENGTH, base-type-encoding=NONE, byte-order=little-endian:
    cpp_bool: base-type-size=8, native-declaration=bool
    cpp_double: base-type-size=64, native-declaration=double
    cpp_float: base-type-size=32, native-declaration=float
    std_int16_t: base-type-size=16, native-declaration=std::int16_t
    std_int32_t: base-type-size=32, native-declaration=std::int32_t
    std_int8_t: base-type-size=8, native-declaration=std::int8_t
    std_uint16_t: base-type-size=16, native-declaration=std::uint16_t
    std_uint32_t: base-type-size=32, native-declaration=std::uint32_t
    std_uint8_t: base-type-size=8, native-declaration=std::uint8_t
    std_uint64_t: base-type-size=64, native-declaration=std::uint64_t
    std_int64_t: base-type-size=64, native-declaration=std::int64_t
