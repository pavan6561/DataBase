AUTOSAR XML (schema 00049)
package /SomeIpServiceInterfaceDeployment
  someip service interface deployment UpdateRequest_Canoe_Someip: service-interface=UpdateRequest_Canoe, service-interface-id=200, service-interface-version={major-version=0, minor-version=0}
    6 x someip method deployment, all with transport-protocol=UDP:
      ResetMachine_Canoe_Someip: method=ResetMachine_Canoe, method-id=3
      StartUpdateSession_Canoe_Someip: method=StartUpdateSession_Canoe, method-id=1
      PrepareUpdate_Canoe_Someip: method=PrepareUpdate_Canoe, method-id=2
      VerifyUpate_Canoe_Someip: method=VerifyUpdate_Canoe, method-id=4
      PrepareRollback_Canoe_Someip: method=PrepareRollback_Canoe, method-id=5
      StopUpdateSession_Canoe_Someip: method=StopUpdateSession_Canoe, method-id=6
