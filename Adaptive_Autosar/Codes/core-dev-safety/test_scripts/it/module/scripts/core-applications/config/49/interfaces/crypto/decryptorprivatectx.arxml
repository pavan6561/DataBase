AUTOSAR XML (schema 00049)
package /ServiceInterface
  service interface DecryptorPrivateCtx
    namespaces:
      4 x symbol props:
        qt
        crypto
        cryptoprovider_001
        dpc
    methods:
      operation SetKey: possible-ap-error=[IncompatibleObject, UsageViolation]
        arg decryptPrivateCtxId: type=uint8_t, direction=IN
        arg privateKey: type=uint8_t, direction=IN
        arg response: type=uint64_t, direction=OUT
      operation Reset
        arg decryptPrivateCtxId: type=uint8_t, direction=IN
        arg response: type=uint64_t, direction=OUT
      operation ProcessBlock: possible-ap-error=[InvalidInputSize, UninitializedContext, InsufficientCapacity]
        4 x arg:
          decryptPrivateCtxId: type=uint8_t, direction=IN
          input: type=ByteArray, direction=IN
          suppressPadding: type=bool, direction=IN
          response: type=returnByteArray, direction=OUT
