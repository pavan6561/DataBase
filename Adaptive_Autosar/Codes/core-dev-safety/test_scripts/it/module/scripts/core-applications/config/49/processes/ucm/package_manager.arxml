AUTOSAR XML (schema 00049)
package /ProcessDesings
  process design package_manager: executable=package_manager
