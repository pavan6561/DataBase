AUTOSAR XML (schema 00049)
package /ApplicationErrorDomains
  ap application error BlockInconsistent: error-code=25
package /ApplicationErrors
  29 x ap application error:
    AuthenticationFailed: error-code=8  # Software Package authentication failed.
    BlockInconsistent: error-code=25
    CancelFailed: error-code=16  # Cancel failed.
    ErrorDuringActivation: error-code=19  # Activate failed.
    ErrorNoValidProcessing: error-code=20  # Activate cannot be performed because previous processing is invalid.
    GeneralMemoryError: error-code=11  # A general memory error occured.
    GeneralReject: error-code=10  # General reject.
    IncompatiblePackageVersion: error-code=24  # The processed Software Package Version is Incompatible.
    IncorrectBlock: error-code=2  # The block counter value is not as expected.
    IncorrectSize: error-code=3  # The size of the Software Package exceeds the provided size in TransferStart.
    InsufficientData: error-code=6  # TransferExit has been called but total transferred data size does not match expected data size provided with TransferStart call.
    InsufficientMemory: error-code=1  # Insufficient memory to perform operation.
    InvalidManifest: error-code=13  # Package manifest could not be read.
    InvalidTransferId: error-code=4  # The Transfer ID is invalid.
    IncorrectBlockSize: error-code=30  # The size of the block exceeds the provided block size from TransferStart.
    MissingDependencies: error-code=21  # Activate cannot be performed because of missing dependencies.
    NotAbleToRevertPackages: error-code=15  # RevertProcessedSwPackages failed.
    NotAbleToRollback: error-code=18  # Rollback failed.
    NothingToRevert: error-code=14  # RevertProcessedSwPackages has been called without prior processing of a Software Package.
    NothingToRollback: error-code=17  # Rollback cannot be performed due to no rollback data available.
    OldVersion: error-code=9  # Software Package version is too old.
    OperationNotPermitted: error-code=5  # The operation is not supported in the current context.
    PackageInconsistent: error-code=7  # Package integrity check failed.
    PreActivationFailed: error-code=19
    ProcessSwPackageCancelled: error-code=22  # The processing operation has been interrupted by a Cancel() call.
    ProcessedSoftwarePackageInconsistent: error-code=23  # The processed Software Package integrity check has failed.
    ServiceBusy: error-code=12  # Another processing is already ongoing and therefore the current processing request has to be rejected.
    TransferInterrupted: error-code=26
    VerificationFailed: error-code=27
