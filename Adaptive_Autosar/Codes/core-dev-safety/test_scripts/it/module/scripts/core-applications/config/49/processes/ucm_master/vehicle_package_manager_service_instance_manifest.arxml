AUTOSAR XML (schema 00049)
package /ProvidedSomeIp
  provided someip service instance ProvidedSomeIpVehiclePackageManagementInstance: service-interface-deployment=VehiclePackageManagementSomeIp, sd-server-config=SomeipSdServerServiceInstance, service-instance-id=909
    someip provided event group RequestedPackage_provided_eventgroup: event-group=RequestedPackage_eventgroup, multicast-threshold=0
    someip provided event group SafetyState_provided_eventgroup: event-group=SafetyState_eventgroup, multicast-threshold=0
    someip provided event group TransferState_provided_eventgroup: event-group=TransferState_eventgroup, multicast-threshold=0
  provided someip service instance ProvidedSomeIpVehicleDriverApplicationInstance: service-interface-deployment=VehicleDriverApplicationSomeIp, sd-server-config=SomeipSdServerServiceInstance, service-instance-id=910
    4 x someip provided event group, all with multicast-threshold=0:
      ApprovalRequired_provided_eventgroup: event-group=ApprovalRequired_eventgroup
      CampaignState_provided_eventgroup: event-group=CampaignState_eventgroup
      SafetyPolicy_provided_eventgroup: event-group=SafetyPolicy_eventgroup
      SafetyState_provided_eventgroup: event-group=SafetyState_eventgroup
  provided someip service instance ProvidedSomeipVehicleStateManager: service-interface-deployment=VehicleStateManagersomeip, sd-server-config=SomeipSdServerServiceInstance, service-instance-id=920
    someip provided event group RequestedPackage_provided_eventgroup: event-group=RequestedPackage_eventgroup, multicast-threshold=0
    someip provided event group SafetyState_provided_eventgroup: event-group=SafetyState_eventgroup, multicast-threshold=0
    someip provided event group TransferState_provided_eventgroup: event-group=TransferState_eventgroup, multicast-threshold=0
package /ServiceInstanceToMachineMapping
  someip service instance to machine mapping VehiclePackageManagerInstancesToMachineMapping: communication-connector=EthernetCommunicationConnector, service-instance=[PackageManagementRequired, ProvidedSomeipVehicleStateManager, ProvidedSomeIpVehicleDriverApplicationInstance, ProvidedSomeIpVehiclePackageManagementInstance], udp-port=5000
