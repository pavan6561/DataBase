AUTOSAR XML (schema 00048)
package /ProcessDesings
  process design package_manager: executable=package_manager
