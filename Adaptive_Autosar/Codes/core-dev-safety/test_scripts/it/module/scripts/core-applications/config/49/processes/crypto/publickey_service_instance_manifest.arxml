AUTOSAR XML (schema 00049)
package /ServiceInstances
  provided someip service instance PublicKey: service-interface-deployment=PublicKey_Someip, sd-server-config=SomeipSdServerServiceInstance, service-instance-id=1
package /ServiceInstanceToMachineMappings
  someip service instance to machine mapping PublicKeyToMachineMapping: communication-connector=EthernetCommunicationConnector, service-instance=PublicKey, udp-port=4020
