AUTOSAR XML (schema 00049)
package /ServiceInstanceToPortMapping
  service instance to port prototype mapping CryptoObejctToPortPrototypeMapping: port-prototype=rootSwComponentPrototype.PPortCryptoObject, process-design=qt_crypto_instance1, process=qt_crypto_instance1, service-instance=CryptoObject
