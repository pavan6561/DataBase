AUTOSAR XML (schema 00049)
package /ServiceInstances
  provided someip service instance qt_cm_instance1: service-interface-deployment=Radar_Someip, sd-server-config=SomeipSdServerServiceInstance, service-instance-id=19
    someip provided event group providedEventGroups: event-group=SomeipEventGroup, multicast-threshold=1
    someip provided event group providedEventGroupsField: event-group=SomeipEventGroupField, multicast-threshold=1
  service instance to port prototype mapping QtCMInstance1PortPrototypeMapping: port-prototype=rootSwComponentPrototype.PRadar, process-design=qt_cm_instance1, process=qt_cm_instance1, service-instance=qt_cm_instance1
package /ServiceInstanceToMachineMappings
  someip service instance to machine mapping QtCMInstance1ToMachineMapping: communication-connector=EthernetCommunicationConnector, service-instance=qt_cm_instance1, udp-port=3001
