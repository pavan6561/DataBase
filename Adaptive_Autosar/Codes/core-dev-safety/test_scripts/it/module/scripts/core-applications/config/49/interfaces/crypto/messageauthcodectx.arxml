AUTOSAR XML (schema 00049)
package /ServiceInterface
  service interface MessageAuthCodeCtx
    namespaces:
      4 x symbol props:
        qt
        crypto
        cryptoprovider_001
        mac
    methods:
      14 x operation:
        Check: possible-ap-error=[ProcessingNotFinished, IncompatibleObject, UndefinedApplicationError]
          arg macId: type=uint8_t, direction=IN
          arg signatureInstanceId: type=uint16_t, direction=IN
          arg response: type=uint64_t, direction=OUT
        Finish: possible-ap-error=[ProcessingNotStarted, UsageViolation, UndefinedApplicationError]
          4 x arg:
            macId: type=uint8_t, direction=IN
            makeSignatureObject: type=bool, direction=IN
            signatureId: type=uint16_t, direction=IN
            response: type=uint64_t, direction=OUT
        GetDigestService: possible-ap-error=UndefinedApplicationError
          arg macId: type=uint8_t, direction=IN
          arg response: type=uint16_t, direction=OUT
        GetDigest: possible-ap-error=[ProcessingNotFinished, UsageViolation, UndefinedApplicationError]
          arg macId: type=uint8_t, direction=IN
          arg offset: type=uint32_t, direction=IN
          arg response: type=returnGetDigestResponse, direction=OUT
        Reset: possible-ap-error=UndefinedApplicationError
          arg macId: type=uint8_t, direction=IN
          arg response: type=uint8_t, direction=OUT
        SetKey: possible-ap-error=[IncompatibleObject, UsageViolation, UndefinedApplicationError]
          4 x arg:
            macId: type=uint8_t, direction=IN
            keyInstanceId: type=uint16_t, direction=IN
            transformationType: type=uint16_t, direction=IN
            response: type=uint64_t, direction=OUT
        StartReadOnlyMemRegion: possible-ap-error=[UndefinedApplicationError, UninitializedContext, InvalidInputSize, Unsupported]
          arg macId: type=uint8_t, direction=IN
          arg input: type=ByteArray, direction=IN
          arg response: type=uint64_t, direction=OUT
        StartSecretSeed: possible-ap-error=[UndefinedApplicationError, UninitializedContext, Unsupported, InvalidInputSize, UsageViolation]
          4 x arg:
            macId: type=uint8_t, direction=IN
            secretSeedInstanceId: type=uint16_t, direction=IN
            whichObject: type=bool, direction=IN
            response: type=uint64_t, direction=OUT
        UpdateReadOnlyMemRegion: possible-ap-error=[ProcessingNotStarted, UndefinedApplicationError]
          arg macId: type=uint8_t, direction=IN
          arg input: type=ByteArray, direction=IN
          arg response: type=uint64_t, direction=OUT
        Update: possible-ap-error=[UndefinedApplicationError, ProcessingNotStarted]
          arg macId: type=uint8_t, direction=IN
          arg input: type=uint8_t, direction=IN
          arg response: type=uint64_t, direction=OUT
        UpdateRestrictedUseObject: possible-ap-error=[UndefinedApplicationError, ProcessingNotStarted]
          arg macId: type=uint8_t, direction=IN
          arg restrictedInstanceId: type=uint16_t, direction=IN
          arg response: type=uint64_t, direction=OUT
        isInitialized: possible-ap-error=UndefinedApplicationError
          arg macId: type=uint8_t, direction=IN
          arg response: type=returnBool, direction=OUT
        GetCryptoPrimitiveId: possible-ap-error=UndefinedApplicationError
          arg macId: type=uint8_t, direction=IN
          arg cryptoPrimitiveObjectId: type=uint8_t, direction=IN
          arg response: type=uint32_t, direction=OUT
        VerifyMyProvider: possible-ap-error=UndefinedApplicationError
          arg macId: type=uint8_t, direction=IN
          arg algName: type=String, direction=IN
          arg response: type=uint64_t, direction=OUT
