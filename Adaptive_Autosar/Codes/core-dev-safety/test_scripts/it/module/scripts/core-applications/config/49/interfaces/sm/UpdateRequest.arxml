AUTOSAR XML (schema 00049)
package /ara/sm/portinterfaces
  service interface UpdateRequest: is-service=true
    namespaces:
      symbol props ara
      symbol props sm
    methods:
      6 x operation:
        PrepareRollback: fire-and-forget=false, possible-ap-error=[Rejected, RollbackFailed]  # Has to be called by Update And Configuration Management after State Management allowed to update
          arg FunctionGroupList: type=FunctionGroupListType, direction=IN
        PrepareUpdate: fire-and-forget=false, possible-ap-error=[PrepareFailed, Rejected]  # Has to be called by Update And Configuration Management after State Management allowed to update. State Management will decline this request when StartUpdateSession was not called before successfully.
          arg FunctionGroupList: type=FunctionGroupListType, direction=IN
        ResetMachine: fire-and-forget=false, possible-ap-error=Rejected  # Requests a reset of the machine. Before the reset is performed all information within the machine shall be persisted. Request will be rejected when StartUpdateSession was not called successfully before.
        StartUpdateSession: fire-and-forget=false, possible-ap-error=Rejected  # Has to be called by Update And Configuration Management once it has to start interaction with State Management. State Management might decline this request when machine is not in a state to be updated.
        StopUpdateSession: fire-and-forget=true  # Has to be called by Update And Configuration Management once the update is finished to let State Managemen know that update is done and Machine is in a stable state. Request will be rejected when StartUpdateSession was not called successfully before.
        VerifyUpdate: fire-and-forget=false, possible-ap-error=[Rejected, VerifyFailed]  # Has to be called by Update And Configuration Management after State Management allowed to update and the update preparation has been done. State Management will decline this request when Prepare Update was not called before successfully
          arg FunctionGroupList: type=FunctionGroupListType, direction=IN
