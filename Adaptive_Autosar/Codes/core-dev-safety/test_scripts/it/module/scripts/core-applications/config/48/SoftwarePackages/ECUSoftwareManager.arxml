AUTOSAR XML (schema 00048)
package /arPackage
  software cluster TEST_SWCL: category=SWCL, conflicts-to=operator=LOGICAL-AND, depends-on=operator=LOGICAL-OR, design=SwClusterDesign, software-cluster-doip-diagnostic-address{address-semantics=FUNCTIONAL-ADDRESS, diagnostic-address=17473}, type-approval=None, vendor-id=1447315780, version=0.1.2.328
  software package sw_pkg_main: category=TestPackage, action-type=INSTALL, compressed-software-package-size=524288, maximum-supported-ucm-version=1.4.0.2, minimum-supported-ucm-version=1.1.0.0, packager-id=1347111236, software-cluster=TEST_SWCL, uncompressed-software-cluster-size=655360
  software cluster SoftwareCluster_A: design=SwClusterDesign_A
  software cluster SoftwareCluster_B: design=SwClusterDesign_B
  software cluster design SwClusterDesign
  software cluster design SwClusterDesign_A
  software cluster design SwClusterDesign_B
  mode declaration group UCMPackageManagerStates
    mode on
    mode off
    mode Verify
