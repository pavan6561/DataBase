AUTOSAR XML (schema 00048)
package /ServiceInstances
  provided someip service instance VerifierPublicCtx: service-interface-deployment=VerifierPublicCtx_Someip, sd-server-config=SomeipSdServerServiceInstance, service-instance-id=1
