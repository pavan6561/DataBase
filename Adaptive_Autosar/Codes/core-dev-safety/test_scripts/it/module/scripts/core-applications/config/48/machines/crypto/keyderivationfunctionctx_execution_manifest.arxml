AUTOSAR XML (schema 00048)
package /ServiceInstanceToPortMapping
  service instance to port prototype mapping KeyDerivationFunctionCtxToPortMapping: port-prototype=rootSwComponentPrototype.PPortKeyDerivationFunctionCtx, process=qt_crypto_instance1, service-instance=KeyDerivationFunctionCtx
