AUTOSAR XML (schema 00049)
package /ServiceInstances
  provided someip service instance BlockService: service-interface-deployment=BlockService_Someip, sd-server-config=SomeipSdServerServiceInstance, service-instance-id=1
package /ServiceInstanceToMachineMappings
  someip service instance to machine mapping BlockServiceToMachineMapping: communication-connector=EthernetCommunicationConnector, service-instance=BlockService, udp-port=4017
