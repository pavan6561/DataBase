AUTOSAR XML (schema 00048)
package /ServiceInstanceToPortMapping
  service instance to port prototype mapping X509DNToPortMapping: port-prototype=rootSwComponentPrototype.PPortX509DN, process=qt_crypto_instance1, service-instance=X509DN
