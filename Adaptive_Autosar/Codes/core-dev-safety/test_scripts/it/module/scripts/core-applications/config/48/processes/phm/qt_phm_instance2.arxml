AUTOSAR XML (schema 00048)
package /Processes
  process qt_phm_instance2: design=qt_phm_instance2, executable=qt_phm_instance2, state-dependent-startup-config{function-group-state=PHMApplicationStates.PHM_Instance2, resource-group=ResourceGroup, startup-config=qt_phm_instance2_startupconfig}
