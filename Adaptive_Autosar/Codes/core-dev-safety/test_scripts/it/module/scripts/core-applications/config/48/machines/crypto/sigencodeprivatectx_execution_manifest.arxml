AUTOSAR XML (schema 00048)
package /ServiceInstanceToPortMapping
  service instance to port prototype mapping SigEncodePrivateCtxToPortMapping: port-prototype=rootSwComponentPrototype.PPortSigEncodePrivateCtx, process=qt_crypto_instance1, service-instance=SigEncodePrivateCtx
