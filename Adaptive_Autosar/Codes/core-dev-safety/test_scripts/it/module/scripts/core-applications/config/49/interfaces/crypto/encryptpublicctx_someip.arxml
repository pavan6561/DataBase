AUTOSAR XML (schema 00049)
package /SomeIpServiceInterfaceDeployment
  someip service interface deployment EncryptPublicCtx_Someip: service-interface=EncryptorPublicCtx, service-interface-id=70, service-interface-version={major-version=0, minor-version=0}
    someip method deployment SetKey: method=SetKey, method-id=1, transport-protocol=UDP
    someip method deployment Reset: method=Reset, method-id=2, transport-protocol=UDP
    someip method deployment ProcessBlock: method=ProcessBlock, method-id=3, transport-protocol=UDP
