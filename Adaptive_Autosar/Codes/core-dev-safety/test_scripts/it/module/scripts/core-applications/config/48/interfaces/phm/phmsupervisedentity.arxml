AUTOSAR XML (schema 00048)
package /ServiceInterfaces
  service interface PhmSupervisedEntity
    namespaces:
      symbol props ara
      symbol props com
    methods:
      13 x operation:
        SupervisedEntity
          arg instanceSpecifier: type=String, direction=IN
          arg response: type=uint8_t, direction=OUT
        ReportCheckpoint
          arg instanceSpecifier: type=String, direction=IN
          arg response: type=uint8_t, direction=OUT
          arg checkpointid: type=uint8_t, direction=IN
        GetLocalSupervision
          arg instanceSpecifier: type=String, direction=IN
          arg response: type=returnResponse, direction=OUT
        GetGlobalSupervision
          arg instanceSpecifier: type=String, direction=IN
          arg response: type=returnResponse, direction=OUT
        HealthChannel
          arg instanceSpecifier: type=String, direction=IN
          arg response: type=returnResponse, direction=OUT
        ReportHealthStatus
          arg instanceSpecifier: type=String, direction=IN
          arg healthStatusid: type=uint32_t, direction=IN
          arg response: type=returnResponse, direction=OUT
        ApplicationRecoveryAction
          arg response: type=returnResponse, direction=OUT
        RestartAction
          arg response: type=returnResponse, direction=OUT
        ResetAction
          arg response: type=returnResponse, direction=OUT
        Offer
          arg instanceSpecifier: type=String, direction=IN
          arg response: type=uint8_t, direction=OUT
        StopOffer
          arg instanceSpecifier: type=String, direction=IN
          arg response: type=uint8_t, direction=OUT
        StopWatchdog
          arg response: type=returnResponse, direction=OUT
        WrongTriggerWatchdog
          arg response: type=returnResponse, direction=OUT
