AUTOSAR XML (schema 00049)
package /Processes
  process qt_cm_instance1: design=qt_cm_instance1, executable=qt_cm_instance1, state-dependent-startup-config{function-group-state=ComApplicationStates.Com_Instance1, resource-group=ResourceGroup, startup-config=qt_cm_instance1_startupconfig}
package /ProcessDesigns
  process design qt_cm_instance1: executable=qt_cm_instance1
package /ProcessToMachineMappings
  process to machine mapping set CMProcessToMachineMappingSet
    15 x process to machine mapping, all with machine=QtMachine:
      QTCMInstance1ToMachineMappings: process=qt_cm_instance1, shall-run-on=Cores0
      StateManagerToMachineMappings: process=qt_statemanager, shall-not-run-on=Cores0
      QtCryptoInstance1ToMachineMappings: process=qt_crypto_instance1, shall-not-run-on=Cores0
      packageManagerToMachineMappings: process=package_manager, shall-not-run-on=Cores0
      QtUCMUpdateAdapterToMachineMappings: process=qt_ucm_updateadapter, shall-not-run-on=Cores0
      QTUcmInstance1ToMachineMappings: process=qt_ucm_instance1, shall-not-run-on=Cores0
      QtPhmInstance1ToMachineMappings: process=qt_phm_instance1, shall-not-run-on=Cores0
      QtPhmInstance2ToMachineMappings: process=qt_phm_instance2, shall-not-run-on=Cores0
      AraCryptoCoreToMachineMappings: process=crypto_core, shall-not-run-on=Cores0
      RoutingManagerRDToMachineMappings: process=ara_someip_routing_daemon, shall-not-run-on=Cores0
      QTOtaClientToMachineMappings: process=qt_ota_client, shall-not-run-on=Cores0
      QTDriverApplicationToMachineMappings: process=qt_driver_application, shall-not-run-on=Cores0
      QTCMInstance{2..4}ToMachineMappings: process=qt_cm_instance{2..4}, shall-run-on=Cores0
