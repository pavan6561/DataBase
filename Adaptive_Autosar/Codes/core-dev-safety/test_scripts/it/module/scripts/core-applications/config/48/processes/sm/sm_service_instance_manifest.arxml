AUTOSAR XML (schema 00048)
package /ServiceInstances
  required user defined service instance RequiredSomeIpUpdateRequestInstance: service-interface-deployment=UpdateRequestSomeIp
  user defined service instance to machine mapping UpdateRequestInstanceToMachineMapping3: communication-connector=EthernetCommunicationConnector, service-instance=RequiredSomeIpUpdateRequestInstance
