AUTOSAR XML (schema 00048)
package /ServiceInterface
  service interface Certificate
    namespaces:
      4 x symbol props:
        qt
        crypto
        x509
        certificate
    methods:
      18 x operation:
        AuthorityKeyId: possible-ap-error=[InsufficientCapacity, UndefinedApplicationError]
          arg certificateId: type=uint8_t, direction=IN
          arg response: type=returnByteArray, direction=OUT
        EndTime: possible-ap-error=UndefinedApplicationError
          arg certificateId: type=uint8_t, direction=IN
          arg response: type=uint64_t, direction=OUT
        GetFingerprint: possible-ap-error=[IncompleteArgState, UndefinedApplicationError]
          4 x arg:
            certificateId: type=uint8_t, direction=IN
            hashCtx: type=uint8_t, direction=IN
            fingerprint: type=ByteArray, direction=INOUT
            response: type=uint64_t, direction=OUT
        GetStatus: possible-ap-error=UndefinedApplicationError
          arg certificateId: type=uint8_t, direction=IN
          arg response: type=uint64_t, direction=OUT
        IsRoot: possible-ap-error=UndefinedApplicationError
          arg certificateId: type=uint8_t, direction=IN
          arg response: type=uint64_t, direction=OUT
        IssuerDn: possible-ap-error=UndefinedApplicationError
          arg certificateId: type=uint8_t, direction=IN
          arg x509DnId: type=uint8_t, direction=IN
          arg response: type=uint64_t, direction=OUT
        SerialNumber: possible-ap-error=[InsufficientCapacity, UndefinedApplicationError]
          arg certificateId: type=uint8_t, direction=IN
          arg response: type=returnByteArray, direction=OUT
        StartTime: possible-ap-error=UndefinedApplicationError
          arg certificateId: type=uint8_t, direction=IN
          arg response: type=uint64_t, direction=OUT
        SubjectKeyId: possible-ap-error=[InsufficientCapacity, UndefinedApplicationError]
          arg certificateId: type=uint8_t, direction=IN
          arg response: type=returnByteArray, direction=OUT
        VerifyMe: possible-ap-error=UndefinedApplicationError
          arg certificateId: type=uint8_t, direction=IN
          arg caCert: type=uint8_t, direction=IN
          arg response: type=returnBool, direction=OUT
        X509Version: possible-ap-error=UndefinedApplicationError
          arg certificateId: type=uint8_t, direction=IN
          arg response: type=uint64_t, direction=OUT
        GetConstraints
          arg basicCertId: type=uint8_t, direction=IN
          arg KeyConstraints: type=uint64_t, direction=OUT
        GetPathLimit
          arg basicCertId: type=uint8_t, direction=IN
          arg response: type=uint32_t, direction=OUT
        IsCa
          arg basicCertId: type=uint8_t, direction=IN
          arg response: type=bool, direction=OUT
        SubjectDn
          arg basicCertId: type=uint8_t, direction=IN
          arg toStoreX509dn: type=uint8_t, direction=IN
          arg response: type=uint64_t, direction=OUT
        SubjectPubKey
          4 x arg:
            basicCertId: type=uint8_t, direction=IN
            cryptoProvider: type=String, direction=IN
            x509PubKeyInfoId: type=uint8_t, direction=IN
            response: type=uint64_t, direction=OUT
        VerifyMyProvider: possible-ap-error=UndefinedApplicationError
          4 x arg:
            objectId: type=uint8_t, direction=IN
            cert: type=String, direction=IN
            formatId: type=uint8_t, direction=IN
            response: type=uint64_t, direction=OUT
        ExportPublicly: possible-ap-error=[InsufficientCapacity, UnknownIdentifier, UnsupportedFormat, UndefinedApplicationError]
          arg objectId: type=uint8_t, direction=IN
          arg formatId: type=uint8_t, direction=IN
          arg response: type=returnByteArray, direction=OUT
