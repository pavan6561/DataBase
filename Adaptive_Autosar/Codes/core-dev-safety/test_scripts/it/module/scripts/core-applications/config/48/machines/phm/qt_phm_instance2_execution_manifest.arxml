AUTOSAR XML (schema 00048)
package /ServiceInstanceToPortPrototypeMappings
  service instance to port prototype mapping QtPHMInstance2PortMapping0001: port-prototype=rootSwComponentPrototype2.PAliveSupervision0002, process=qt_phm_instance2, service-instance=qt_phm_instance2
