AUTOSAR XML (schema 00049)
package /ara/ucm/pkgmgr/ServiceInterfaces
  service interface PackageManagement
    namespaces:
      symbol props ara
      symbol props ucm
      symbol props pkgmgr
    field CurrentStatus: type=PackageManagerStatusType, has-getter=true, has-notifier=true, has-setter=false
    methods:
      17 x operation, all with fire-and-forget=false:
        Activate: possible-ap-error=[MissingDependencies, OperationNotPermitted, UpdateSessionRejected, PreActivationFailed, VerificationFailed]  # This method activates the processed components.
        Cancel: possible-ap-error=[CancelFailed, InvalidTransferId, OperationNotPermitted]  # This method aborts an ongoing processing of a Software Package.
          arg id: type=TransferIdType, direction=IN  # The Transfer ID.
        DeleteTransfer: possible-ap-error=[InvalidTransferId, OperationNotPermitted]  # Delete a transferred Software Package.
          arg id: type=TransferIdType, direction=IN  # Transfer ID of the currently running request.
        Finish: possible-ap-error=OperationNotPermitted  # This method finishes the processing for the current set of processed Software Packages. It does a cleanup of all data of the processing including the sources of the Software Packages.
        GetHistory
          arg history: type=GetHistoryVectorType, direction=OUT
          arg timestampGE: type=uint64_t, direction=IN
          arg timestampLT: type=uint64_t, direction=IN
        GetId
          arg id: type=UCMIdentifierType, direction=OUT
        GetSwClusterChangeInfo
          arg SwInfo: type=SwClusterInfoVectorType, direction=OUT
        GetSwClusterDescription  # This method returns the general information of the Software Clusters present in the platform
          arg SwCluster: type=SwDescVectorType, direction=OUT  # List of SoftwareClusters present in the platform.
        GetSwClusterInfo
          arg SwInfo: type=SwClusterInfoVectorType, direction=OUT
        GetSwPackages
          arg Packages: type=SwPackageInfoVectorType, direction=OUT
        GetSwProcessProgress: possible-ap-error=InvalidTransferId  # Get the progress (0 - 100%) of the currently processed Software Package.
          arg id: type=TransferIdType, direction=IN  # The Transfer ID of the Software Package.
          arg progress: type=uint8_t, direction=OUT  # The progress of the current package processing (0% - 100%). 0x00 ... 0x64, 0xFF for "No information available"
        ProcessSwPackage: possible-ap-error=[AuthenticationFailed, IncompatibleDelta, IncompatiblePackageVersion, InsufficientComputationPower, InsufficientMemory, InvalidPackageManifest, InvalidTransferId, OperationNotPermitted, ProcessedSoftwarePackageInconsistent, ProcessSwPackageCancelled, ServiceBusy]  # Process a previously transferred Software Package.
          arg id: type=TransferIdType, direction=IN  # The Transfer ID of this Software Package.
        RevertProcessedSwPackages: possible-ap-error=[NotAbleToRevertPackages, OperationNotPermitted]  # Revert the changes done by processing (ProcessSwPackage) of one or several software packages.
        Rollback: possible-ap-error=[NotAbleToRollback, OperationNotPermitted]  # Rollback the system to the state before the packages were processed.
        TransferData: possible-ap-error=[AuthenticationFailed, IncorrectBlock, IncorrectBlockSize, IncorrectSize, InsufficientComputationPower, InsufficientMemory, InvalidTransferId, OperationNotPermitted, PackageInconsistent, BlockInconsistent, IncompatiblePackageVersion, TransferInterrupted]  # Block-wise transfer of a Software Package to UCM.
          arg id: type=TransferIdType, direction=IN  # Transfer ID.
          arg data: type=ByteVectorType, direction=IN  # Data block of the Software Package.
          arg blockCounter: type=uint64_t, direction=IN  # Block counter value of the current block.
        TransferExit: possible-ap-error=[AuthenticationFailed, InsufficientData, InvalidPackageManifest, InvalidTransferId, OldVersion, OperationNotPermitted, PackageInconsistent, IncompatiblePackageVersion, MissingDependencies]  # Finish the transfer of a Software Package to UCM.
          arg id: type=TransferIdType, direction=IN  # Transfer ID of the currently running request.
        TransferStart: possible-ap-error=[InsufficientComputationPower, InsufficientMemory]  # Start the transfer of a Software Package. The size of the Software Package to be transferred to UCM must be provided. UCM will generate a Transfer ID for subsequent calls to TransferData, TransferExit, ProcessSwPackage, DeleteTransfer.
          arg size: type=uint64_t, direction=IN  # Size (in bytes) of the Software Package to be transferred.
          arg id: type=TransferIdType, direction=OUT  # Return TransferId.
          arg blockSize: type=uint32_t, direction=OUT  # Return the size of the blocks to be used inside TransferData method.
