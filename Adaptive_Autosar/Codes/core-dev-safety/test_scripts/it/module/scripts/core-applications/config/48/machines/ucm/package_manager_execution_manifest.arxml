AUTOSAR XML (schema 00048)
package /Processes
  process package_manager: design=package_manager, executable=package_manager, state-dependent-startup-config{function-group-state=MachineFG.Startup, resource-group=ResourceGroup, startup-config=package_manager_startupconfig}
package /ServiceInstanceToPortPrototypeMappings
  service instance to port prototype mapping PackageManagementToRequiredPortMapping: port-prototype=rootSwComponentPrototype.RPortPackageManagement, process=qt_cm_instance1, service-instance=PackageManagementRequired
  service instance to port prototype mapping PackageManagementToProvidedPortMapping: port-prototype=rootSwComponentPrototype.PPortPackageManagement, process=package_manager, service-instance=PackageManagementProvided
  service instance to port prototype mapping UpdateAdapterToProvidedPortMapping: port-prototype=rootSwComponentPrototype.PUpdateAdapter, process=package_manager, service-instance=UpdateAdapterProvided
