AUTOSAR XML (schema 00049)
package /ServiceInstanceToPortMappings
  service instance to port prototype mapping QtUCMInstance1ToPortMapping: port-prototype=rootSwComponentPrototype.PPortApplicationPackageManagement, process-design=qt_ucm_instance1, process=qt_ucm_instance1, service-instance=qt_ucm_instance1
