AUTOSAR XML (schema 00049)
package /PersistencyInterface
  persistency key value storage qt_phm_instance1_persistance: update-strategy=KEEP-EXISTING, uri=/opt/qt_phm_instance1/var/restartaction.json
  persistency key value storage qt_phm_instance3_persistance: update-strategy=KEEP-EXISTING, uri=/opt/qt_phm_instance3/var/restartaction.json
