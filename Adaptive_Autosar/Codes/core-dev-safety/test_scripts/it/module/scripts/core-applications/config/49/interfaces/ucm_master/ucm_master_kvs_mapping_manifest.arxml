AUTOSAR XML (schema 00049)
package /PersistencyPortToKeyValueStorageMapping
  persistency port prototype to key value storage mapping vehicle_package_manager: port-prototype=vehicle_package_manager_root.VehiclePackageTransferStatusPRPort, process=vehicle_package_manager, key-value-storage=VehiclePackageTransferStatusDatabase
