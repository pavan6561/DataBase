AUTOSAR XML (schema 00049)
package /ServiceInstances
  provided someip service instance qt_phm_instance1: service-interface-deployment=PhmSupervisedEntity_Someip, sd-server-config=SomeipSdServerServiceInstance, service-instance-id=1
package /ServiceInstanceToMachineMappings
  someip service instance to machine mapping QtPHMInstance1SomeipServiceInstanceToMachineMapping: communication-connector=EthernetCommunicationConnector, service-instance=qt_phm_instance1, udp-port=5001
