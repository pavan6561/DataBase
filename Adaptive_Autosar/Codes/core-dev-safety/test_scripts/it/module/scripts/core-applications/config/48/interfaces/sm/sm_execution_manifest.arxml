AUTOSAR XML (schema 00048)
package /ServiceInstanceToPortMappings
  service instance to port prototype mapping RequiredSomeIpUpdateRequestInstanceToPortPrototypeMapping: port-prototype=rootSwComponentPrototype.RUpdateRequest, process=package_manager, service-instance=RequiredSomeIpUpdateRequestInstance
