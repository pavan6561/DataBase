AUTOSAR XML (schema 00049)
package /AdaptiveApplicationSwComponent
  adaptive application sw component type vehicle_state_manager
    require port RPortPrototypeVehicleStateManager: required-interface=VehicleStateManager
package /Executables
  executable vehicle_state_manager
    root sw component prototype vehicle_state_manager_root: application-type=vehicle_state_manager
package /ProcessDesign
  process design vehicle_state_manager: executable=vehicle_state_manager
