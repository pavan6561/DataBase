AUTOSAR XML (schema 00048)
package /ServiceInterface
  service interface AuthCipherCtx
    namespaces:
      4 x symbol props:
        qt
        crypto
        cryptoprovider_001
        acc
    methods:
      14 x operation:
        StartReadOnlyMemRegion: possible-ap-error=[InvalidInputSize, UninitializedContext, Unsupported, UndefinedApplicationError]
          arg authId: type=uint8_t, direction=IN
          arg iv: type=ByteArray, direction=IN
          arg response: type=uint64_t, direction=OUT
        UpdateAssociatedDataReadOnlyMemRegion: possible-ap-error=[InvalidUsageOrder, ProcessingNotStarted, UndefinedApplicationError]
          arg authId: type=uint8_t, direction=IN
          arg input: type=ByteArray, direction=IN
          arg response: type=uint64_t, direction=OUT
        UpdateAssociatedData: possible-ap-error=[ProcessingNotStarted, InvalidUsageOrder, UndefinedApplicationError]
          arg authId: type=uint8_t, direction=IN
          arg input: type=uint8_t, direction=IN
          arg response: type=uint64_t, direction=OUT
        Reset: possible-ap-error=UndefinedApplicationError
          arg authId: type=uint8_t, direction=IN
          arg response: type=uint64_t, direction=OUT
        GetMaxAssociatedDataSize: possible-ap-error=UndefinedApplicationError
          arg authId: type=uint8_t, direction=IN
          arg response: type=uint64_t, direction=OUT
        GetDigest: possible-ap-error=[ProcessingNotStarted, UsageViolation, UndefinedApplicationError]
          arg authId: type=uint8_t, direction=IN
          arg offset: type=uint8_t, direction=IN
          arg digestResult: type=returnGetDigestResponse, direction=OUT
        GetTransformation: possible-ap-error=[UninitializedContext, UndefinedApplicationError]
          arg authId: type=uint8_t, direction=IN
          arg response: type=returnCryptoTransform, direction=OUT
        Check: possible-ap-error=[ProcessingNotFinished, IncompatibleObject, UndefinedApplicationError]
          arg authId: type=uint8_t, direction=IN
          arg signatureInstanceId: type=uint16_t, direction=IN
          arg response: type=uint64_t, direction=OUT
        ProcessConfidentialData: possible-ap-error=[InvalidInputSize, ProcessingNotStarted, AuthTagNotValid, UndefinedApplicationError]
          4 x arg:
            authId: type=uint8_t, direction=IN
            input: type=ByteArray, direction=IN
            expectedTag: type=ByteArray, direction=IN
            response: type=returnEncryptData, direction=OUT
        ProcessConfidentialDataReadWrite: possible-ap-error=[InvalidUsageOrder, ProcessingNotStarted, AuthTagNotValid, UndefinedApplicationError]
          4 x arg:
            authId: type=uint8_t, direction=IN
            inOut: type=ByteArray, direction=INOUT
            expectedTag: type=ByteArray, direction=IN
            response: type=uint64_t, direction=OUT
        SetKey: possible-ap-error=[IncompatibleObject, UsageViolation, UndefinedApplicationError]
          4 x arg:
            authId: type=uint8_t, direction=IN
            key: type=uint16_t, direction=IN
            transform: type=uint64_t, direction=IN
            response: type=uint64_t, direction=OUT
        StartSecretSeed: possible-ap-error=[UninitializedContext, InvalidInputSize, Unsupported, UsageViolation, UndefinedApplicationError]
          arg authId: type=uint8_t, direction=IN
          arg secretSeedIv: type=uint16_t, direction=IN
          arg response: type=uint64_t, direction=OUT
        UpdateAssociatedDataRestrictedUseObject: possible-ap-error=[ProcessingNotStarted, InvalidUsageOrder, UndefinedApplicationError]
          arg authId: type=uint8_t, direction=IN
          arg input: type=uint16_t, direction=IN
          arg response: type=uint64_t, direction=OUT
        isInitialized: possible-ap-error=UndefinedApplicationError
          arg authId: type=uint8_t, direction=IN
          arg response: type=returnBool, direction=OUT
