AUTOSAR XML (schema 00048)
package /Executables
  executable qt_ucm_updateadapter
    root sw component prototype rootSwComponentPrototype: application-type=qt_ucm_updateadapter
package /ProcessDesign
  process design qt_ucm_updateadapter: executable=qt_ucm_updateadapter
package /Processes
  process qt_ucm_updateadapter: design=qt_ucm_updateadapter, executable=qt_ucm_updateadapter, state-dependent-startup-config{function-group-state=MachineFG.Startup, resource-group=ResourceGroup, startup-config=update_adapter_startupconfig}
