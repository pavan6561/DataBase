AUTOSAR XML (schema 00049)
package /CompuMethods/UpdateAdapter
  compu method PackageManagerStatusTypeEnum: 0x00=kIdle, 0x01=kReady, 0x02=kBusy, 0x03=kExternalActivate, 0x04=kExternalRollback
  compu method DataCopyStatusTypeEnum: 0x00=kUnknown, 0x01=kSuccess, 0x02=kFailure
package /CppImplementationDataTypes
  10 x std cpp implementation data type:
    PackageManagerStatusType: compu {0x00=kIdle, 0x01=kReady, 0x02=kProcessing, 0x03=kActivating, 0x04=kActivated, 0x05=kRollingBack, 0x06=kRolledBack, 0x07=kCleaningUp, 0x08=kVerifying}, implementation-data-type=uint8_t, type-emitter=TYPE_EMITTER_ARA
    ByteVectorType: category=VECTOR, cpp-template-argument=uint8_t
    TransferIdType: category=ARRAY, array-size=16, cpp-template-argument=uint8_t, type-emitter=TYPE_EMITTER_ARA
      namespaces:
        symbol props ara
        symbol props ucm
        symbol props pkgmgr
    boolean: category=VALUE, base-type=cpp_bool, type-emitter=TYPE_EMITTER_ARA
    ActivateStatusType: compu {0x00=kUnknown, 0x01=kSuccess, 0x02=kErrorDuringActivation}, type-emitter=TYPE_EMITTER_ARA, type-reference=uint8_t
      namespaces:
        symbol props ara
        symbol props ucm
        symbol props pkgmgr
    IsFinishedType: compu {0x00=kWorking, 0x01=kFinished}, type-emitter=TYPE_EMITTER_ARA, type-reference=uint8_t
    RollbackStatusType: compu {0x00=kUnknown, 0x02=kErrorDuringRollback, 0x01=kSuccess}, type-emitter=TYPE_EMITTER_ARA, type-reference=uint8_t
      namespaces:
        symbol props ara
        symbol props ucm
        symbol props pkgmgr
    DataCopyStatusType: compu {0x00=kUnknown, 0x02=kErrorDuringRollback, 0x01=kSuccess}, type-emitter=TYPE_EMITTER_ARA, type-reference=uint8_t
    UAPackageManagerStatusType: compu-method=UpdateAdapter/PackageManagerStatusTypeEnum, type-emitter=TYPE_EMITTER_ARA, type-reference=uint8_t
      namespaces:
        symbol props ara
        symbol props ucm
        symbol props pkgmgr
    UpdateStatusType: compu-method=UpdateAdapter/PackageManagerStatusTypeEnum, type-emitter=TYPE_EMITTER_ARA, type-reference=uint8_t
      namespaces:
        symbol props ara
        symbol props ucm
        symbol props pkgmgr
package /ara/ucm/compu_methods
  compu method TransferStartSuccessTypeEnum: 0x00=kSuccess (Transfer of data has been successfully initiated.), 0x01=kInsufficientMemory (Not enough memory to store the Software Package.)
  compu method TransferDataReturnTypeEnum: 0x00=kSuccess (Data has been successfully transmitted and stored.), 0x01=kIncorrectBlock (The block counter value is not as expected by UCM.), 0x02=kIncorrectSize (The size of the Software Package exceeds the provided size in TransferStart.), 0x03=kInsufficientMemory (Not enough memory to store the Software Package.), 0x04=kInvalidTransferId (The Transfer ID is invalid.), 0x05=kOperationNotPermitted (The operation is not permitted in the current state.), 0x06=IncorrectBlockSize (The size of the block exceeds the provided block size from TransferStart.)
  compu method TransferExitReturnTypeEnum: 0x00=kSuccess (Data transmission has been successfully finished. The complete Software Package has been received.), 0x01=kInsufficientData (TransferExit has been called but total transferred data size does not match expected data size provided with TransferStart call.), 0x02=kPackageInconsistent (Transferred package integrity or authentication check failed.), 0x03=kInvalidTransferId (The Transfer ID is invalid.), 0x04=kOperationNotPermitted (The operation is not permitted in the current state.)
  compu method ProcessResultTypeEnum: 0x00=kSuccess (Software package has been successfully processed.), 0x01=kReject (Another processing is already ongoing and therefore the current processing request has to be rejected.), 0x02=kInvalidManifest (Package manifest could not be read.), 0x03=kInsufficientMemory (Insufficient memory to perform processing.), 0x04=kInvalidTransferId (The Transfer ID is invalid.), 0x05=kOperationNotPermitted (The operation is not permitted in the current state.), 0x06=kErrorAuthenticationFailed (Authentication of the software package failed.)
  compu method SwPackageStateTypeEnum: 0x00=kTransferring (Software package is being transferred, i.e. not completely received.), 0x01=kTransferred (Software package is completely transferred and ready to be processed.), 0x02=kProcessing (Software package is currently being processed.), 0x03=kProcessed (Software package is currently being processed.), 0x04=kProcessingStream (Software package is currently being processed.)
  compu method SwClusterInfoStateTypeEnum: 0x00=kPresent (State of a SoftwareCluster that is installed on the adaptive platform and installation has finished.), 0x01=kAdded (State of a SoftwareCluster that has been newly installed.), 0x02=kUpdated (State of a SoftwareCluster that has been updated but not yet activated.), 0x03=kRemoved (State of a SoftwareCluster that has been removed.)
  compu method LogLevelTypeEnum: 0x00=kOff (Logging is deactivated.), 0x01=kFatal (Only fatal messages are logged.), 0x02=kError (Only messages up to error level are logged.), 0x03=kWarning (Only messages up to warning level are logged.), 0x04=kInfo (Only messages up to info level are logged.), 0x05=kDebug (Only messages up to debug level are logged.), 0x06=kVerbose (Only messages up to verbose level are logged.)
  compu method PackageManagerStatusTypeEnum: 0x00=kIdle (UCM is ready to receive software packages or start processing if software packages are present.), 0x01=kReady (UCM has processed one or several packages and waits for additional packages, activation or reversion of processed packages.), 0x02=kProcessing (UCM is currently in the middle of processing a Software Package, i.e. a client has called ProcessSwPackage.), 0x03=kActivating (UCM is activating the processed packages.), 0x04=kActivated, 0x05=kRollingBack, 0x06=kRolledBack, 0x07=kCleaningUp, 0x08=kVerifying
  compu method ActivateReturnTypeEnum: 0x00=kSuccess (Activation successful.), 0x01=kErrorNoProcessedPackages (Activate failed because no packages where processed.), 0x02=kErrorDuringActivation (Activate failed.), 0x03=kErrorNoValidProcessing (Activate cannot be performed because previous processing is invalid.), 0x04=kMissingDependencies (Activate cannot be performed because of missing dependencies.)
  compu method CancelReturnTypeEnum: 0x00=kSuccess (Cancel successful.), 0x01=kError (Cancel failed.), 0x02=kOperationNotPermitted (The operation is not permitted in the current state.)
  compu method RevertProcessedSwPackagesReturnTypeEnum: 0x00=kSuccess (Packages have been reverted successfully.), 0x01=kNothingToRevert (RevertProcessedSwPackages has been called without prior processing of a Software Package.), 0x02=kNotAbleToRevertPackages (RevertProcessedSwPackages failed.)
  compu method RollbackReturnTypeEnum: 0x00=kSuccess (Rollback successful.), 0x01=kNothingToRollback (Rollback cannot be performed due to no rollback data available.), 0x02=kNotAbleToRollback (Rollback failed.)
  compu method GeneralResponseTypeEnum: 0x00=kSuccess (Request successful.), 0x01=kGeneralReject (General reject.), 0x02=kGeneralMemoryError (A general memory error occured.), 0x03=kTransferIdInvalid (The transfer ID parameter is invalid.), 0x04=kOperationNotPermitted (The operation is not supported in the current context.)
  compu method FinishReturnTypeEnum: 0x00=kSuccess (Finish successful.), 0x01=kUndefinedError (Undefined error.), 0x02=kOperationNotPermitted (The operation is not permitted in the current state.)
  compu method SwClusterStateTypeEnum: 0x00=kPresent, 0x01=kAdded, 0x02=kUpdated, 0x03=kRemoved
  compu method CampaignStateTypeEnum: 0x000x00=kIdle, 0x010x01=kSyncing, 0x020x02=kVehiclePackageTransferring, 0x030x03=kTransferApproving, 0x040x04=kTransferring, 0x05=kProcessApproving, 0x06=kProcessing, 0x07=kActivateApproving, 0x08=kActivating, 0x09=kVehicleChecking, 0x10=kRollingBack, 
  compu method ResultTypeEnum: 0x00=kSuccessfull, 0x01=kFailed
package /qt/ucm/compu_methods
  compu method ActivateStatusTypeEnum: 0x00=kUnknown (Activate not yet requested.), 0x01=kSuccess (Activation successful.), 0x02=kErrorDuringActivation (Activate failed.)
  compu method RollbackStatusTypeEnum: 0x00=kUnknown (Rollback not yet requested.), 0x01=kSuccess (Rollback successful.), 0x02=kErrorDuringRollback (Rollback failed.)
  compu method PackageManagerStatusTypeEnum: 0x00=kIdle (UCM is ready to receive software packages or start processing if software packages are present.), 0x01=kReady (UCM has processed one or several packages and waits for additional packages, activation or reversion of processed packages.), 0x02=kBusy (UCM is currently in the middle of processing a Software Package, i.e. a client has called ProcessSwPackage.), 0x03=kExternalActivate (UCM is waiting for external entity to perform the activate of the processed packages.), 0x04=kExternalRollback (UCM is waiting for external entity to perform the rollback of the processed packages.)
  compu method DataCopyStatusTypeEnum: 0x00=kUnknown (Data copy status not yet provided.), 0x01=kSuccess (Successfully copied data.), 0x02=kFailure (Failure while copying data.)
  compu method IsFinishedTypeEnum: 0x00=kWorking (UCM is working and is NOT finished.), 0x01=kFinished (UCM is finished.)
  compu method ActionTypeEnum: 0x00=kUpdate, 0x01=kInstall, 0x02=kRemove
