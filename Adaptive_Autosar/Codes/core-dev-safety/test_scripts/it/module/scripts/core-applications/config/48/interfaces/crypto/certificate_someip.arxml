AUTOSAR XML (schema 00048)
package /SomeIpServiceInterfaceDeployment
  someip service interface deployment Certificate_Someip: service-interface=Certificate, service-interface-id=43, service-interface-version={major-version=0, minor-version=0}
    18 x someip method deployment, all with transport-protocol=TCP:
      AuthorityKeyId: method=AuthorityKeyId, method-id=1
      EndTime: method=EndTime, method-id=2
      GetFingerprint: method=GetFingerprint, method-id=3
      GetStatus: method=GetStatus, method-id=4
      IsRoot: method=IsRoot, method-id=5
      IssuerDn: method=IssuerDn, method-id=6
      SerialNumber: method=SerialNumber, method-id=7
      StartTime: method=StartTime, method-id=8
      SubjectKeyId: method=SubjectKeyId, method-id=9
      VerifyMe: method=VerifyMe, method-id=10
      X509Version: method=X509Version, method-id=11
      GetConstraints: method=GetConstraints, method-id=12
      GetPathLimit: method=GetPathLimit, method-id=13
      IsCa: method=IsCa, method-id=14
      SubjectDn: method=SubjectDn, method-id=15
      SubjectPubKey: method=SubjectPubKey, method-id=16
      VerifyMyProvider: method=VerifyMyProvider, method-id=17
      ExportPublicly: method=ExportPublicly, method-id=18
