AUTOSAR XML (schema 00048)
package /ara
  std cpp implementation data type returnStringStructure: category=STRUCTURE, type-emitter=TYPE_EMITTER_ARA
    cpp implementation data type element Name: type-reference=String
    cpp implementation data type element Version: type-reference=String
    cpp implementation data type element State: type-reference=String
package /ara/ucm/ApApplicationErrors
  28 x ap application error, all with error-domain=UCMErrorDomain:
    AuthenticationFailed: error-code=8  # Software Package authentication failed.
    BlockInconsistent: error-code=25  # Consistency check for transferred block failed.
    CancelFailed: error-code=16  # Cancel failed.
    IncompatibleDelta: error-code=29  # Delta package dependency check failed.
    IncompatiblePackageVersion: error-code=24  # The version of the Software Package to be processed is not compatible with the current version of UCM.
    IncorrectBlock: error-code=2  # The block counter value is not as expected.
    IncorrectBlockSize: error-code=30  # The size of the block exceeds the provided block size from TransferStart or TransferVehiclePackage
    IncorrectSize: error-code=3  # The size of the Software Package exceeds the provided size in TransferStart.
    InsufficientComputationPower: error-code=28  # Insufficient computation power to perform the requested operation.
    InsufficientData: error-code=6  # TransferExit has been called but total transferred data size does not match expected data size provided with TransferStart call.
    InsufficientMemory: error-code=1  # Insufficient memory to perform operation.
    InvalidPackageManifest: error-code=13  # Package manifest could not be read.
    InvalidTransferId: error-code=4  # The Transfer ID is invalid.
    MissingDependencies: error-code=21  # Activate cannot be performed because of missing dependencies.
    NewCampaignDisabled: error-code=31  # New campaigns are disabled, calling AllowCampaign will enable new campaigns.
    NotAbleToRevertPackages: error-code=15  # RevertProcessedSwPackages failed.
    NotAbleToRollback: error-code=18  # Rollback failed.
    OldVersion: error-code=9  # Software Package version is too old.
    OperationNotPermitted: error-code=5  # The operation is not supported in the current context.
    PackageInconsistent: error-code=7  # Package integrity check failed.
    PreActivationFailed: error-code=19  # Error during preActivation step.
    ProcessSwPackageCancelled: error-code=22  # The processing operation has been interrupted by a Cancel() call.
    ProcessedSoftwarePackageInconsistent: error-code=23  # The processed Software Package integrity check has failed.
    ServiceBusy: error-code=12  # Another processing is already ongoing and therefore the current processing request has to be rejected.
    TransferInterrupted: error-code=26  # Transfer has been interrupted.
    UnexpectedPackage: error-code=32  # The Software Package name does not correspond to the RequestedPackage field value.
    UpdateSessionRejected: error-code=33  # Start of an update session was rejected by State Management
    VerificationFailed: error-code=27  # Error during verification step.
package /ara/ucm/datatypes/CPPImplementationDataTypes
  32 x std cpp implementation data type:
    ActionType: compu {0x00=kUpdate (Update of a SoftwareCluster.), 0x01=kInstall (Installation of a new SoftwareCluster.), 0x02=kRemove (Removal of a SoftwareCluster.)}, range raw 0x00..0x02, type-emitter=TYPE_EMITTER_ARA, type-reference=uint8_t  # Represents the UCM action.
      namespaces:
        symbol props ara
        symbol props ucm
        symbol props pkgmgr
    ByteVectorType: category=VECTOR, array-size=2000, cpp-template-argument=uint8_t, type-emitter=TYPE_EMITTER_ARA  # Byte vector representing raw data.
      namespaces:
        symbol props ara
        symbol props ucm
        symbol props pkgmgr
    CampaignErrorType: category=STRUCTURE, type-emitter=TYPE_EMITTER_ARA  # Campaign Error
      namespaces:
        symbol props ara
        symbol props ucm
        symbol props pkgmgr
      cpp implementation data type element CampaignFailure: type-reference={inplace=false, type-reference=CampaignFailureType}  # Campaign failure
      cpp implementation data type element UCMStepError: type-reference={inplace=false, type-reference=UCMStepErrorType}  # Error from UCM at what Software Package Step
    CampaignFailureType:  # Campaign failure
      compu {0x01=kUCMError (UCM error), 0x02=kInvalidVehiclePackageManifest (Vehicle Package manifest is invalid), 0x03=kSubordinateNotAvailableOnTheNetwork (UCM subordinate not reachable), 0x04=kVehicleStateManagerCommunicationError (Communication error with Vehicle State Manager), 0x05=kVehicleDriverInterfaceCommunicationError (Communication error with Vehicle Driver Interface), 0x06=kCampaignCancelled (Campaign was cancelled)}
      range raw 0x00..0x06
      type-emitter=TYPE_EMITTER_ARA
      type-reference=uint8_t
      namespaces:
        symbol props ara
        symbol props ucm
        symbol props pkgmgr
    CampaignHistoryType: category=STRUCTURE, type-emitter=TYPE_EMITTER_ARA  # Campaign history
      namespaces:
        symbol props ara
        symbol props ucm
        symbol props pkgmgr
      cpp implementation data type element CampaignError: type-reference={inplace=false, type-reference=CampaignErrorType}  # Campaign Error
      cpp implementation data type element HistoryVector: type-reference={inplace=false, type-reference=HistoryVectorType}  # History Vector
    CampaignStateType:  # Represents the status of Campaign.
      compu {0x00=kIdle (UCM Master is ready to start a software update campaign.), 0x01=kSyncing (UCM master is providing the list of installed SWCLs (GetSwClusterInfo) or computing the list of SWCLs to install (SwPackageInventory).), 0x02=kVehiclePackageTransferring (A vehicle package is being transferred to UCM Master.), 0x03=kSoftwarePackage_Transferring (kSoftwarePackageTransferring) (UCM Master is transferring software packages to the UCM subordinates.), 0x04=kProcessing (The processing of software packages on UCM subordinates is ongoing. The transferring of software packages may still occur.), 0x05=kActivating (The activation of SWCLs on UCM subordinates is ongoing.), 0x06=kVehicleChecking (UCM Master is performing post-activation checks (OEM specific).), 0x07=kCancelling (UCM Master is rolling-back the activated SWCLs on the UCM subordinates.)}
      range raw 0x00..0x10
      type-emitter=TYPE_EMITTER_ARA
      type-reference=uint8_t
      namespaces:
        symbol props ara
        symbol props ucm
        symbol props pkgmgr
    GetHistoryType: category=STRUCTURE, type-emitter=TYPE_EMITTER_ARA  # Time refers to the activation time of the software cluster. It is represented in milliseconds of UCM’s action resolution since 01.01.1970 (UTC).
      namespaces:
        symbol props ara
        symbol props ucm
        symbol props pkgmgr
      5 x cpp implementation data type element:
        Time: type-reference={inplace=false, type-reference=uint64_t}  # Date and time of UCM’s action resolution.
        Name: type-reference={inplace=false, type-reference=SwNameType}  # Name of the SoftwareCluster
        Version: type-reference={inplace=false, type-reference=StrongRevisionLabelString}  # Version of the SoftwareCluster
        Action: type-reference={inplace=false, type-reference=ActionType}  # What action was performed by UCM
        Resolution: type-reference={inplace=false, type-reference=ResultType}  # What action was performed by UCM
    GetHistoryVectorType: category=VECTOR, cpp-template-argument=GetHistoryType, type-emitter=TYPE_EMITTER_ARA  # Represents a list of UCM actions
      namespaces:
        symbol props ara
        symbol props ucm
        symbol props pkgmgr
    HistoryVectorType: category=STRUCTURE, type-emitter=TYPE_EMITTER_ARA  # History of an UCM
      namespaces:
        symbol props ara
        symbol props ucm
        symbol props pkgmgr
      cpp implementation data type element id: type-reference={inplace=false, type-reference=UCMIdentifierType}  # UCM's identifier
      cpp implementation data type element HistoryVector: type-reference={inplace=false, type-reference=GetHistoryVectorType}  # Returned value of UCM Subordinate from GetHistoryMethod
    PackageManagerStatusType:  # Represents the state of UCM.
      compu {0x00=kIdle (UCM is ready to start processing if software packages are present.), 0x01=kReady (UCM has processed one or several packages and waits for additional packages, activation or reversion of processed packages.), 0x02=kProcessing (UCM is currently in the middle of processing a Software Package, i.e. a client has called ProcessSwPackage.), 0x03=kActivating (UCM is performing the dependency check and preparing the activation of the processed Software packages.), 0x04=kActivated (Software changes introduced with processed Software Packages has been activated and executed.), 0x05=kRollingBack (UCM is reverting changes introduced with processed packages.), 0x06=kRolledBack (Software changes introduced with processed Software Packages has been deactivated and original software is executed.), 0x07=kCleaningUp (Making sure that the system is in a clean state.), 0x08=kVerifying (UCM (via State Management) is checking that the processed packages have been properly restarted.)}
      range raw 0x00..0x08
      type-emitter=TYPE_EMITTER_ARA
      type-reference=uint8_t
      namespaces:
        symbol props ara
        symbol props ucm
        symbol props pkgmgr
    ResultType: compu {0x00=kSuccessfull (UCM’s action was successful.), 0x01=kFailed (UCM’s action failed.)}, range raw 0x00..0x01, type-emitter=TYPE_EMITTER_ARA, type-reference=uint8_t  # Represents the result of UCM action.
      namespaces:
        symbol props ara
        symbol props ucm
        symbol props pkgmgr
    SafetyPolicyType: category=STRING, type-emitter=TYPE_EMITTER_ARA  # The type of the Safety Policy.
      namespaces:
        symbol props ara
        symbol props ucm
        symbol props pkgmgr
    SoftwarePackageStepType: compu {0x00=kTransfer (Software Package transfer), 0x01=kProcess (Software Package processing), 0x02=kPreActivate (Software Cluster pre activation), 0x03=kVerify (Software Cluster verification)}, range raw 0x00..0x03, type-emitter=TYPE_EMITTER_ARA, type-reference=uint8_t  # UCM Software Package step at which error occured
      namespaces:
        symbol props ara
        symbol props ucm
        symbol props pkgmgr
    StrongRevisionLabelString: category=STRING, type-emitter=TYPE_EMITTER_ARA  # Represents a generic string data type
      namespaces:
        symbol props ara
        symbol props ucm
        symbol props pkgmgr
    SwClusterInfoType: category=STRUCTURE, type-emitter=TYPE_EMITTER_ARA  # Represents the information of a SoftwareCluster.
      namespaces:
        symbol props ara
        symbol props ucm
        symbol props pkgmgr
      cpp implementation data type element Name: type-reference={inplace=false, type-reference=SwNameType}  # Name of the SoftwareCluster
      cpp implementation data type element Version: type-reference={inplace=false, type-reference=StrongRevisionLabelString}  # SoftwareCluster version
      cpp implementation data type element State: type-reference={inplace=false, type-reference=SwClusterStateType}  # State of the SoftwareCluster
    SwClusterInfoVectorType: category=VECTOR, cpp-template-argument=SwClusterInfoType, type-emitter=TYPE_EMITTER_ARA  # Represents a dynamic size array of SoftwareClusters
      namespaces:
        symbol props ara
        symbol props ucm
        symbol props pkgmgr
    SwClusterStateType:  # Represents the state of a SoftwareCluster on the adaptive platform.
      compu {0x00=kPresent (State of a SoftwareCluster that is installed on the adaptive platform and installation has finished.), 0x01=kAdded (State of a SoftwareCluster that has been newly installed.), 0x02=kUpdated (State of a SoftwareCluster that has been updated.), 0x03=kRemoved (State of a SoftwareCluster that has been removed.)}
      range raw 0x00..0x03
      type-emitter=TYPE_EMITTER_ARA
      type-reference=uint8_t
      namespaces:
        symbol props ara
        symbol props ucm
        symbol props pkgmgr
    SwDescType: category=STRUCTURE, type-emitter=TYPE_EMITTER_ARA  # Contains general information related to SoftwareCluster that can be used by Vehicle Driver Application or Human Interface.
      namespaces:
        symbol props ara
        symbol props ucm
        symbol props pkgmgr
      6 x cpp implementation data type element:
        Name: type-reference={inplace=false, type-reference=SwNameType}  # SoftwareCluster name
        Version: type-reference={inplace=false, type-reference=StrongRevisionLabelString}  # SoftwareCluster version
        TypeApproval: type-reference={inplace=false, type-reference=String}  # TypeApproval carries the homologation information that may be specific for a given country.
        License: type-reference={inplace=false, type-reference=String}  # License has the full text of a license of the enclosing SoftwareCluster.
        ReleaseNotes: type-reference={inplace=false, type-reference=String}  # ReleaseNotes for the explanations of changes since the previous version.
        Size: type-reference={inplace=false, type-reference=uint64_t}  # Size of compressed Software Package or of Software Cluster.
    SwDescVectorType: category=VECTOR, cpp-template-argument=SwDescType, type-emitter=TYPE_EMITTER_ARA  # Represents a dynamic size array of SoftwareCluster description
      namespaces:
        symbol props ara
        symbol props ucm
        symbol props pkgmgr
    SwInfoName: category=STRING, type-emitter=TYPE_EMITTER_ARA  # SoftwareCluster name.
      namespaces:
        symbol props ara
        symbol props ucm
        symbol props pkgmgr
    SwNameType: category=STRING, type-emitter=TYPE_EMITTER_ARA  # SoftwareCluster (SoftwarePackage) name.
      namespaces:
        symbol props ara
        symbol props ucm
        symbol props pkgmgr
    SwNameVectorType: category=VECTOR, cpp-template-argument=SwNameType, type-emitter=TYPE_EMITTER_ARA  # Represents a dynamic size array of Software Cluster names.
      namespaces:
        symbol props ara
        symbol props ucm
        symbol props pkgmgr
    SwNameVersionType: category=STRUCTURE, type-emitter=TYPE_EMITTER_ARA  # Represents the information of a Software Package (Software Cluster) name and version.
      namespaces:
        symbol props ara
        symbol props ucm
        symbol props pkgmgr
      cpp implementation data type element Name: type-reference={inplace=false, type-reference=SwNameType}  # Software name
      cpp implementation data type element Version: type-reference={inplace=false, type-reference=StrongRevisionLabelString}  # Software version
    SwNameVersionVectorType: category=VECTOR, cpp-template-argument=SwNameVersionType, type-emitter=TYPE_EMITTER_ARA  # Represents a dynamic size array of Software Name and Version
      namespaces:
        symbol props ara
        symbol props ucm
        symbol props pkgmgr
    SwPackageInfoType: category=STRUCTURE, type-emitter=TYPE_EMITTER_ARA  # Represents the information of a Software Package.
      namespaces:
        symbol props ara
        symbol props ucm
        symbol props pkgmgr
      6 x cpp implementation data type element:
        Name: type-reference={inplace=false, type-reference=SwNameType}  # SoftwarePackage name.
        Version: type-reference={inplace=false, type-reference=StrongRevisionLabelString}  # SoftwarePackage version
        TransferID: type-reference={inplace=false, type-reference=TransferIdType}  # TransferID of the Software Package
        ConsecutiveBytesReceived: type-reference={inplace=false, type-reference=uint64_t}  # Received Software Package size (in bytes)
        ConsecutiveBlocksReceived: type-reference={inplace=false, type-reference=uint64_t}  # Received Software Package Block number
        State: type-reference={inplace=false, type-reference=SwPackageStateType}  # State of the Software Package
    SwPackageInfoVectorType: category=VECTOR, cpp-template-argument=SwPackageInfoType, type-emitter=TYPE_EMITTER_ARA  # Represents a dynamic size array of Software Packages
      namespaces:
        symbol props ara
        symbol props ucm
        symbol props pkgmgr
    SwPackageStateType:  # Represents the state of a Software Package on the Platform.
      compu {0x00=kTransferring (Software package is being transferred, i.e. not completely received.), 0x01=kTransferred (Software package is completely transferred and ready to be processed.), 0x02=kProcessing (Software package is currently being processed.), 0x03=kProcessed (Software package processing finished.), 0x04=kProcessingStream}
      range raw 0x00..0x03
      type-emitter=TYPE_EMITTER_ARA
      type-reference=uint8_t
      namespaces:
        symbol props ara
        symbol props ucm
        symbol props pkgmgr
    TransferIdType: category=ARRAY, array-size=16, cpp-template-argument=uint8_t  # Represents a handle identifier used to reference a particular transfer request.
      namespaces:
        symbol props ara
        symbol props ucm
        symbol props pkgmgr
    BlockSizeType: type-emitter=TYPE_EMITTER_ARA, type-reference=uint32_t  # Represents the size of a data block handled by TransferData method.
      namespaces:
        symbol props ara
        symbol props ucm
        symbol props pkgmgr
    TransferStateType: compu {0x00=kIdle (UCM Master is ready to start a software update campaign.), 0x01=kTransferring (Vehicle or Software Packages are being transferred.), 0x02=kUpdating (Software Clusters are being updated in the vehicle.), 0x03=kCancelling (An error occurred, campaign is being cancelled, reverting changes.)}, range raw 0x00..0x03, type-emitter=TYPE_EMITTER_ARA, type-reference=uint8_t  # Represents the state of an update from OTA Client perspective.
      namespaces:
        symbol props ara
        symbol props ucm
        symbol props pkgmgr
    UCMIdentifierType: category=STRING, type-emitter=TYPE_EMITTER_ARA  # UCM Module Instantiation Identifier.
      namespaces:
        symbol props ara
        symbol props ucm
        symbol props pkgmgr
    UCMStepErrorType: category=STRUCTURE, type-emitter=TYPE_EMITTER_ARA  # UCM Error
      namespaces:
        symbol props ara
        symbol props ucm
        symbol props pkgmgr
      cpp implementation data type element id: type-reference={inplace=false, type-reference=UCMIdentifierType}  # UCM's identifier
      cpp implementation data type element SoftwarePackageStep: type-reference={inplace=false, type-reference=SoftwarePackageStepType}  # Error occured at this Software Package Step as modelled in Vehicle Package
      cpp implementation data type element ReturnedError: type-reference={inplace=false, type-reference=uint8_t}  # Error returned from UCMErrorDomain
package /ara/ucm/pkgmgr
  ap application error domain UCMErrorDomain: value=42
    namespaces:
      symbol props ara
      symbol props ucm
      symbol props pkgmgr
