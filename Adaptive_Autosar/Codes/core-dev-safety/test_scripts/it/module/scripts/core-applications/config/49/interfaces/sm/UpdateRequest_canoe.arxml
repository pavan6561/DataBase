AUTOSAR XML (schema 00049)
package /ServiceInterfaces
  service interface UpdateRequest_Canoe
    namespaces:
      symbol props qt
      symbol props ucm_sm_stub
    methods:
      6 x operation:
        PrepareRollback_Canoe
          arg returnValue: type=returnValues, direction=OUT
        PrepareUpdate_Canoe
          arg returnValue: type=returnValues, direction=OUT
        ResetMachine_Canoe
          arg returnValue: type=returnValues, direction=OUT
        StartUpdateSession_Canoe
          arg returnValue: type=returnValues, direction=OUT
        StopUpdateSession_Canoe
          arg returnValue: type=returnValues, direction=OUT
        VerifyUpdate_Canoe
          arg returnValue: type=returnValues, direction=OUT
