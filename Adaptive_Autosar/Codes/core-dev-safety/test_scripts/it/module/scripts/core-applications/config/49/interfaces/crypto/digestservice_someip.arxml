AUTOSAR XML (schema 00049)
package /SomeIpServiceInterfaceDeployment
  someip service interface deployment DigestService_Someip: service-interface=DigestService, service-interface-id=75, service-interface-version={major-version=0, minor-version=0}
    4 x someip method deployment, all with transport-protocol=UDP:
      Compare: method=Compare, method-id=1
      GetDigestSize: method=GetDigestSize, method-id=2
      IsFinished: method=IsFinished, method-id=3
      IsStarted: method=IsStarted, method-id=4
