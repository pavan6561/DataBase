AUTOSAR XML (schema 00049)
package /ServiceInterface
  service interface X509DN
    namespaces:
      4 x symbol props:
        qt
        crypto
        x509
        dn
    methods:
      6 x operation:
        GetAttribute: possible-ap-error=[InsufficientCapacity, UnknownIdentifier, UndefinedApplicationError]
          arg dnId: type=uint8_t, direction=IN
          arg AttributeId: type=uint32_t, direction=IN
          arg response: type=returnString, direction=OUT
        GetDnString: possible-ap-error=[InsufficientCapacity, UndefinedApplicationError]
          arg dnId: type=uint8_t, direction=IN
          arg response: type=returnString, direction=OUT
        SetAttribute: possible-ap-error=[UnknownIdentifier, UnexpectedValue, UndefinedApplicationError]
          4 x arg:
            dnId: type=uint8_t, direction=IN
            AttributeId: type=uint32_t, direction=IN
            attribute: type=String, direction=IN
            response: type=uint64_t, direction=OUT
        SetDn: possible-ap-error=UndefinedApplicationError
          arg dnId: type=uint8_t, direction=IN
          arg dn: type=String, direction=IN
          arg response: type=uint64_t, direction=OUT
        VerifyMyProvider: possible-ap-error=UndefinedApplicationError
          4 x arg:
            objectId: type=uint8_t, direction=IN
            cert: type=String, direction=IN
            formatId: type=uint8_t, direction=IN
            response: type=uint64_t, direction=OUT
        ExportPublicly: possible-ap-error=[InsufficientCapacity, UnknownIdentifier, UnsupportedFormat, UndefinedApplicationError]
          arg objectId: type=uint8_t, direction=IN
          arg formatId: type=uint8_t, direction=IN
          arg response: type=returnByteArray, direction=OUT
