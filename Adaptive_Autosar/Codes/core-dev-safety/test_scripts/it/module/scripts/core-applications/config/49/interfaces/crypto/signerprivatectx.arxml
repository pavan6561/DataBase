AUTOSAR XML (schema 00049)
package /ServiceInterface
  service interface SignerPrivateCtx
    namespaces:
      4 x symbol props:
        qt
        crypto
        cryptoprovider_001
        signer
    methods:
      7 x operation:
        GetSignatureService: possible-ap-error=UndefinedApplicationError
          arg sinerId: type=uint8_t, direction=IN
          arg response: type=uint64_t, direction=OUT
        Reset: possible-ap-error=UndefinedApplicationError
          arg signerId: type=uint8_t, direction=IN
          arg response: type=uint64_t, direction=OUT
        SetKey: possible-ap-error=[IncompatibleObject, UsageViolation, UndefinedApplicationError]
          arg signerId: type=uint8_t, direction=IN
          arg key: type=uint16_t, direction=IN
          arg response: type=uint64_t, direction=OUT
        SignPreHashed: possible-ap-error=[InvalidArgument, InvalidInputSize, ProcessingNotFinished, UninitializedContext, UndefinedApplicationError]
          5 x arg:
            signerId: type=uint8_t, direction=IN
            hashFn: type=uint64_t, direction=IN
            context: type=ByteArray, direction=IN
            signatureId: type=uint16_t, direction=IN
            response: type=uint64_t, direction=OUT
        SignPreHashedConst: possible-ap-error=[InvalidArgument, InvalidInputSize, UninitializedContext, UndefinedApplicationError]
          6 x arg:
            signerId: type=uint8_t, direction=IN
            hashAlgId: type=uint16_t, direction=IN
            hashValue: type=ByteArray, direction=IN
            context: type=ByteArray, direction=IN
            signatureId: type=uint16_t, direction=IN
            response: type=uint64_t, direction=OUT
        Sign: possible-ap-error=[InvalidInputSize, UninitializedContext, UndefinedApplicationError]
          4 x arg:
            signerId: type=uint8_t, direction=IN
            value: type=ByteArray, direction=IN
            context: type=ByteArray, direction=IN
            response: type=returnByteArray, direction=OUT
        IsInitialized
          arg signerId: type=uint8_t, direction=IN
          arg response: type=uint16_t, direction=OUT
