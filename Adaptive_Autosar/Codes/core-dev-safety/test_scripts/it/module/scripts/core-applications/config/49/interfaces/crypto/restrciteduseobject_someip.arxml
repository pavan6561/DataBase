AUTOSAR XML (schema 00049)
package /SomeIpServiceInterfaceDeployment
  someip service interface deployment RestrictedUseObject_Someip: service-interface=RestrictedUseObject, service-interface-id=81, service-interface-version={major-version=0, minor-version=0}
    someip method deployment GetAllowedUsage: method=GetAllowedUsage, method-id=1, transport-protocol=UDP
