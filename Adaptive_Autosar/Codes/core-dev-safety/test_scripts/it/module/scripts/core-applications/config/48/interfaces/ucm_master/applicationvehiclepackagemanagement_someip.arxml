AUTOSAR XML (schema 00048)
package /SomeIpServiceInterfaceDeployment
  someip service interface deployment ApplicationVehiclePackageManagement_Someip: service-interface=ApplicationVehiclePackageManagement, service-interface-id=777, service-interface-version={major-version=1, minor-version=0}
    someip field deployment TransferStateField: field=TransferStateField
      get get: method-id=555, transport-protocol=UDP
      notifier notifier: event-id=666, transport-protocol=UDP
    14 x someip method deployment, all with transport-protocol=UDP:
      TransferStart: method=TransferStart, method-id=100
      TransferVehiclePackage: method=TransferVehiclePackage, method-id=101
      TransferData: method=TransferData, method-id=102
      TransferExit: method=TransferExit, method-id=103
      LoadBinaryPackage: method=LoadBinaryPackage, method-id=104
      TransferState: method=TransferState, method-id=105
      RequestedPackage: method=RequestedPackage, method-id=106
      GetSwClusterInfo: method=GetSwClusterInfo, method-id=107
      SwPackageInventory: method=SwPackageInventory, method-id=108
      DeleteTransfer: method=DeleteTransfer, method-id=109
      GetSwPackages: method=GetSwPackages, method-id=110
      CancelCampaign: method=CancelCampaign, method-id=111
      AllowCampaign: method=AllowCampaign, method-id=112
      GetCampaignHistory: method=GetCampaignHistory, method-id=113
    someip event group VpmSomeipEventGroup: event-group-id=300, event=notifier
