AUTOSAR XML (schema 00048)
package /ServiceInstances
  provided someip service instance CryptoProvider: service-interface-deployment=CryptoProvider_Someip, sd-server-config=SomeipSdServerServiceInstance, service-instance-id=1
package /ServiceInstanceToMachineMappings
  15 x someip service instance to machine mapping, all with communication-connector=EthernetCommunicationConnector:
    CryptoProviderInterfaceToMachineMapping: service-instance=CryptoProvider, udp-port=4001
    RandomGeneratorCtxToMachineMapping: service-instance=RandomGeneratorCtx, udp-port=4002
    HashFunctionCtxToMachineMapping: service-instance=HashFunctionCtx, udp-port=4003
    AuthCipherCtxToMachineMapping: service-instance=AuthCipherCtx, udp-port=4004
    KeyDerivationfunctionCtxToMachineMapping: service-instance=KeyDerivationFunctionCtx, udp-port=4005
    MessageAuthCodeCtxToMachineMapping: service-instance=MessageAuthCodeCtx, udp-port=4006
    StreamCipherCtxToMachineMapping: service-instance=StreamCipherCtx, udp-port=4007
    SymmetricBlockCipherCtxToMachineMapping9: service-instance=SymmetricBlockCipherCtx, udp-port=4008
    SymmetricKeyWrapperCtxToMachineMapping: service-instance=SymmetricKeyWrapperCtx, udp-port=4009
    EncryptPublicCtxToMachineMapping: service-instance=EncryptPublicCtx, udp-port=4010
    DecryptPrivateCtxToMachineMapping: service-instance=DecryptPrivateCtx, udp-port=4011
    SigEncodePrivateCtxToMachineMapping: service-instance=SigEncodePrivateCtx, udp-port=4014
    SignerPrivateCtxToMachineMapping: service-instance=SignerPrivateCtx, udp-port=4013
    VerifierPublicCtxToMachineMapping: service-instance=VerifierPublicCtx, udp-port=4012
    MsgRecoveryPublicCtxToMachineMapping: service-instance=MsgRecoveryPublicCtx, udp-port=4016
