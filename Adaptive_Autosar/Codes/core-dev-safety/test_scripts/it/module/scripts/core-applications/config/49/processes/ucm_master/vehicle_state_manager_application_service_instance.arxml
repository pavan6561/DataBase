AUTOSAR XML (schema 00049)
package /ServiceInstance
  provided someip service instance ProvidedSomeipApplicationVehicleStateManagerInstance: service-interface-deployment=ApplicationVehicleStateManager_Someip, sd-server-config=SomeipSdServerServiceInstance, service-instance-id=7
    someip provided event group providedEventGroupsVSM: event-group=SafetyPolicyEvent, multicast-threshold=1
  required someip service instance RequiredVehicleStateManager: service-interface-deployment=VehicleStateManagersomeip, required-service-instance-id=920, sd-client-config=SomeipSdClientServiceInstance
package /ServiceInstanceToPortMapping
  service instance to port prototype mapping ProvidedApplicationVehicleStateManagerToPortPrototypeMapping: port-prototype=qt_vehicle_state_manager_root.VSMApplicationPPort, process-design=qt_vehicle_state_manager, process=qt_vehicle_state_manager, service-instance=ProvidedSomeipApplicationVehicleStateManagerInstance
  service instance to port prototype mapping RequiredVehicleStateManagerToPortPrototypeMapping: port-prototype=qt_vehicle_state_manager_root.VSMCoreRPort, process-design=qt_vehicle_state_manager, process=qt_vehicle_state_manager, service-instance=RequiredVehicleStateManager
