AUTOSAR XML (schema 00048)
package /SomeIpServiceInterfaceDeployment
  someip service interface deployment DecryptPrivateCtx_Someip: service-interface=DecryptorPrivateCtx, service-interface-id=71, service-interface-version={major-version=0, minor-version=0}
    someip method deployment SetKey: method=SetKey, method-id=1, transport-protocol=UDP
    someip method deployment Reset: method=Reset, method-id=2, transport-protocol=UDP
    someip method deployment ProcessBlock: method=ProcessBlock, method-id=3, transport-protocol=UDP
