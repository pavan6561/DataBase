AUTOSAR XML (schema 00048)
package /Machines
  machine QtMachine: default-application-timeout=exit-timeout-value=1.0, machine-design=QtMachine
    function-groups:
      8 x mode declaration group prototype:
        MachineFG: type=MachineState
        ComApplicationStates: type=ComApplicationStates
        PHMApplicationStates: type=PHMApplicationStates
        CryptoApplicationStates: type=CryptoApplicationStates
        UCMApplicationStates: type=UCMApplicationStates
        TSyncApplicationStates: type=TSyncApplicationStates
        UCMPackageManagerStates: type=UCMPackageManagerStates
        UcmMasterApplicationStates: type=UcmMasterApplicationStates
    os module instantiation Linux
      resource group ResourceGroup: cpu-usage=95, mem-usage=2000000000
      resource group ResourceGroups2: cpu-usage=95, mem-usage=2000000000
    crypto module instantiation CryptoModuleInstantiation
    ucm module instantiation UcmModuleInstantiation: identifier=1
    processor Processors
      processor core Cores0: core-id=0
