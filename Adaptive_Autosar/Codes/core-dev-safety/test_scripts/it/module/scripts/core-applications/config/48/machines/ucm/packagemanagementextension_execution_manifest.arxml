AUTOSAR XML (schema 00048)
package /ServiceInstanceToPortPrototypeMappings
  service instance to port prototype mapping UpdateAdapterToRequiredPortMapping: port-prototype=rootSwComponentPrototype.UpdateAdapterRport, process=qt_ucm_updateadapter, service-instance=UpdateAdapterRequired
