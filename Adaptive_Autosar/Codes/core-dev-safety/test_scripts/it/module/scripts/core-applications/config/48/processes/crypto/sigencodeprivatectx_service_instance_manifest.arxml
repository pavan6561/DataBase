AUTOSAR XML (schema 00048)
package /ServiceInstances
  provided someip service instance SigEncodePrivateCtx: service-interface-deployment=SigEncodePrivateCtx_Someip, sd-server-config=SomeipSdServerServiceInstance, service-instance-id=1
