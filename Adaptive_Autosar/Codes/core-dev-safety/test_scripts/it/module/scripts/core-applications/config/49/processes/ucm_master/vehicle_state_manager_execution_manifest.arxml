AUTOSAR XML (schema 00049)
package /Processes
  process vehicle_state_manager: design=vehicle_state_manager, executable=vehicle_state_manager
