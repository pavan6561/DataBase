AUTOSAR XML (schema 00049)
package /ServiceInstances
  required user defined service instance PackageManagementRequired: service-interface-deployment=PackageManagement
  provided user defined service instance PackageManagementProvided: service-interface-deployment=PackageManagement
  provided someip service instance UpdateAdapterProvided: service-interface-deployment=UpdateAdapter_Someip, sd-server-config=SomeipSdServerServiceInstance, service-instance-id=1
package /ServiceInstanceToMachineMappings
  user defined service instance to machine mapping PackageManagementToMachineMapping: communication-connector=EthernetCommunicationConnector, service-instance=PackageManagementRequired
  user defined service instance to machine mapping PackageManagementProvidedToMachineMapping: communication-connector=EthernetCommunicationConnector, service-instance=PackageManagementProvided
