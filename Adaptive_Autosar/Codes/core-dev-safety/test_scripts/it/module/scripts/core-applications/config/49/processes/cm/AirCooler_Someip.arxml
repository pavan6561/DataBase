AUTOSAR XML (schema 00049)
package /ServiceInterfaceDeployments
  someip service interface deployment AirCooler_Someip: service-interface=AirCooler, service-interface-id=102, service-interface-version={major-version=0, minor-version=0}
    someip method deployment AirCooler_Temperature_Someip: method=AirCooler_Temperature, method-id=301, transport-protocol=UDP
package /ServiceInstances
  provided someip service instance AirCooler_qt_cm_instance4_ProvidedSomeipServiceInstance: service-interface-deployment=AirCooler_Someip, sd-server-config=SomeipSdServerServiceInstance, service-instance-id=103
  required someip service instance AirCooler_qt_cm_instance3_RequiredSomeipServiceInstance: service-interface-deployment=AirCooler_Someip, required-service-instance-id=103, sd-client-config=SomeipSdClientServiceInstance
package /ServiceInstanceToMachineMappings
  someip service instance to machine mapping AirCooler_qt_cm_instance4_Provided_ServiceInstance_toMachine: communication-connector=EthernetCommunicationConnector, service-instance=AirCooler_qt_cm_instance4_ProvidedSomeipServiceInstance, udp-port=3005
  someip service instance to machine mapping AirCooler_qt_cm_instance3_Required_ServiceInstance_toMachine: communication-connector=EthernetCommunicationConnector, service-instance=AirCooler_qt_cm_instance3_RequiredSomeipServiceInstance, udp-port=0
package /ServiceInstanceToPortPrototypeMappings
  service instance to port prototype mapping AirCooler_qt_cm_instance4_ProvidedSomeipInstance_PAirCooler_toPort: port-prototype=rootSwComponentPrototype.PAirCooler, process-design=qt_cm_instance4, process=qt_cm_instance4, service-instance=AirCooler_qt_cm_instance4_ProvidedSomeipServiceInstance
  service instance to port prototype mapping AirCooler_qt_cm_instance3_RequiredSomeipInstance_RAirCooler_toPort: port-prototype=rootSwComponentPrototype.RAirCooler, process-design=qt_cm_instance3, process=qt_cm_instance3, service-instance=AirCooler_qt_cm_instance3_RequiredSomeipServiceInstance
package /SomeipSdTimingConfigs
  someip sd client event group timing config SomeipSdClientEventGroupTimingConfig: request-response-delay={max-value=1.0, min-value=0.0}, time-to-live=10
