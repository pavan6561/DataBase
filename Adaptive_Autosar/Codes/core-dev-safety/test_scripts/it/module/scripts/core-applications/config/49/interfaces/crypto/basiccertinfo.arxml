AUTOSAR XML (schema 00049)
package /ServiceInterface
  service interface BasicCertInfo
    namespaces:
      4 x symbol props:
        qt
        crypto
        x509
        basic
    methods:
      5 x operation:
        GetConstraints
          arg basicCertId: type=uint8_t, direction=IN
          arg KeyConstraints: type=uint64_t, direction=OUT
        GetPathLimit
          arg basicCertId: type=uint8_t, direction=IN
          arg response: type=uint32_t, direction=OUT
        IsCa
          arg basicCertId: type=uint8_t, direction=IN
          arg response: type=bool, direction=OUT
        SubjectDn
          arg basicCertId: type=uint8_t, direction=IN
          arg toStoreX509dn: type=uint8_t, direction=IN
          arg response: type=uint64_t, direction=OUT
        SubjectPubKey
          4 x arg:
            basicCertId: type=uint8_t, direction=IN
            cryptoProvider: type=String, direction=IN
            x509PubKeyInfoId: type=uint8_t, direction=IN
            response: type=uint64_t, direction=OUT
