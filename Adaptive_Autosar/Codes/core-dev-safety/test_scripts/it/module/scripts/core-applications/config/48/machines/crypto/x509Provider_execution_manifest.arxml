AUTOSAR XML (schema 00048)
package /ServiceInstanceToPortMapping
  service instance to port prototype mapping X509ProviderToPortMapping: port-prototype=rootSwComponentPrototype.PPortX509Provider, process=qt_crypto_instance1, service-instance=X509Provider
