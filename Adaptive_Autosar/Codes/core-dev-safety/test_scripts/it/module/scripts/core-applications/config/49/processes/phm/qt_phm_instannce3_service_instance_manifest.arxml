AUTOSAR XML (schema 00049)
package /ServiceInstances
  provided someip service instance qt_phm_instance3: service-interface-deployment=PhmSupervisedEntity_Someip, sd-server-config=SomeipSdServerServiceInstance, service-instance-id=3
package /ServiceInstanceToMachineMappings
  someip service instance to machine mapping QtPHMInstance3SomeipServiceInstanceToMachineMapping: communication-connector=EthernetCommunicationConnector, service-instance=qt_phm_instance3, udp-port=5003
