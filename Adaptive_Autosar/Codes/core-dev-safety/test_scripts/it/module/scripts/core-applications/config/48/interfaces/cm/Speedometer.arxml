AUTOSAR XML (schema 00048)
package /ServiceInterfaces
  service interface Speedometer
    namespaces:
      symbol props ara
      symbol props com
      symbol props sample
    events:
      18 x data:
        Event_ArrayLengthOne: type=ArrayLengthOne
        Event_ArrayLength2MSBFirst: type=ArrayLength2MSBFirst
        Event_ArrayLength4MSBFirst: type=ArrayLength4MSBFirst
        Event_ArrayByteOrderMSBF: type=ArrayByteOrderMSBF
        Event_ArrayLength2MSBLast: type=ArrayLength2MSBLast
        Event_ArrayLength4MSBLast: type=ArrayLength4MSBLast
        Event_Array_NoLengthField: type=ArrayNoLengthField
        Event_ArrayNoByteOrder: type=ArrayNoByteOrder
        Event_Array2D: type=Array2D
        Event_VectorLengthOne: type=VectorLengthOne
        Event_VectorLength2MSBFirst: type=VectorLength2MSBFirst
        Event_VectorLength4MSBFirst: type=VectorLength4MSBFirst
        Event_VectorByteOrderMSBF: type=VectorByteOrderMSBF
        Event_VectorLength2MSBLast: type=VectorLength2MSBLast
        Event_VectorLength4MSBLast: type=VectorLength4MSBLast
        Event_Vector_NoLengthField: type=VectorNoLengthField
        Event_VectorNoByteOrder: type=VectorNoByteOrder
        Event_ArrayLengthZero: type=ArrayLengthZero
  service interface Speedometer_Canoe
    namespaces:
      symbol props ara
      symbol props com
      symbol props sample
    events:
      18 x data:
        Event_ArrayLengthOne: type=ArrayLengthOne
        Event_ArrayLength2MSBFirst: type=ArrayLength2MSBFirst
        Event_ArrayLength4MSBFirst: type=ArrayLength4MSBFirst
        Event_ArrayByteOrderMSBF: type=ArrayByteOrderMSBF
        Event_ArrayLength2MSBLast: type=ArrayLength2MSBLast
        Event_ArrayLength4MSBLast: type=ArrayLength4MSBLast
        Event_Array_NoLengthField: type=ArrayNoLengthField
        Event_ArrayNoByteOrder: type=ArrayNoByteOrder
        Event_Array2D: type=Array2D
        Event_VectorLengthOne: type=VectorLengthOne
        Event_VectorLength2MSBFirst: type=VectorLength2MSBFirst
        Event_VectorLength4MSBFirst: type=VectorLength4MSBFirst
        Event_VectorByteOrderMSBF: type=VectorByteOrderMSBF
        Event_VectorLength2MSBLast: type=VectorLength2MSBLast
        Event_VectorLength4MSBLast: type=VectorLength4MSBLast
        Event_Vector_NoLengthField: type=VectorNoLengthField
        Event_VectorNoByteOrder: type=VectorNoByteOrder
        Event_ArrayLengthZero: type=ArrayLengthZero
package /TransformationPropsSets
  transformation props set ArrayVectorTransformationPropsSet
    18 x ap someip transformation props:
      Array_NoLengthField
      Array_OneLengthField: size-of-array-length-field=1
      Array_ByteOrderMSBF: byte-order=big-endian, size-of-array-length-field=2
      Array_NoByteOrder: size-of-array-length-field=2
      ArrayLength2MSBFirst: byte-order=big-endian, size-of-array-length-field=2
      ArrayLength4MSBFirst: byte-order=big-endian, size-of-array-length-field=4
      ArrayLength2MSBLast: byte-order=little-endian, size-of-array-length-field=2
      ArrayLength4MSBLast: byte-order=little-endian, size-of-array-length-field=4
      Array_2DLengthFieldMSBFMapping: byte-order=big-endian, size-of-array-length-field=4
      Vector_NoLengthField
      Vector_OneLengthField: size-of-array-length-field=1
      Vector_ByteOrderMSBF: byte-order=big-endian, size-of-array-length-field=2
      Vector_NoByteOrder: size-of-array-length-field=2
      VectorLength2MSBFirst: byte-order=big-endian, size-of-array-length-field=2
      VectorLength4MSBFirst: byte-order=big-endian, size-of-array-length-field=4
      VectorLength2MSBLast: byte-order=little-endian, size-of-array-length-field=2
      VectorLength4MSBLast: byte-order=little-endian, size-of-array-length-field=4
      Array_ZeroLengthField: size-of-array-length-field=0
  transformation props set ArrayVectorCanoeTransformationPropsSet
    18 x ap someip transformation props:
      Array_NoLengthField
      Array_OneLengthField: size-of-array-length-field=1
      Array_ByteOrderMSBF: byte-order=big-endian, size-of-array-length-field=2
      Array_NoByteOrder: size-of-array-length-field=2
      ArrayLength2MSBFirst: byte-order=big-endian, size-of-array-length-field=2
      ArrayLength4MSBFirst: byte-order=big-endian, size-of-array-length-field=4
      ArrayLength2MSBLast: byte-order=little-endian, size-of-array-length-field=2
      ArrayLength4MSBLast: byte-order=little-endian, size-of-array-length-field=4
      Array_2DLengthFieldMSBFMapping: byte-order=big-endian, size-of-array-length-field=4
      Vector_NoLengthField
      Vector_OneLengthField: size-of-array-length-field=1
      Vector_ByteOrderMSBF: byte-order=big-endian, size-of-array-length-field=2
      Vector_NoByteOrder: size-of-array-length-field=2
      VectorLength2MSBFirst: byte-order=big-endian, size-of-array-length-field=2
      VectorLength4MSBFirst: byte-order=big-endian, size-of-array-length-field=4
      VectorLength2MSBLast: byte-order=little-endian, size-of-array-length-field=2
      VectorLength4MSBLast: byte-order=little-endian, size-of-array-length-field=4
      Array_ZeroLengthField: size-of-array-length-field=0
package /TransformationPropsToServiceInterfaceMappingSets
  transformation props to service interface element mapping set ArrayVectorTransformationPropsToServiceInterfaceElementMappingSet
    18 x transformation props to service interface element mapping:
      Array_NoLengthFieldMapping: event=Speedometer/Event_Array_NoLengthField, transformation-props=ArrayVectorTransformationPropsSet/Array_NoLengthField
      Array_OneLenghtFieldMapping: event=[Speedometer/Event_ArrayLengthOne, Speedometer/Event_Array_NoLengthField], transformation-props=ArrayVectorTransformationPropsSet/Array_OneLengthField
      Array_ByteOrderMapping: event=[Speedometer/Event_ArrayNoByteOrder, Speedometer/Event_ArrayByteOrderMSBF], transformation-props=ArrayVectorTransformationPropsSet/Array_ByteOrderMSBF
      Array_NoByteOrderMapping: event=Speedometer/Event_ArrayNoByteOrder, transformation-props=ArrayVectorTransformationPropsSet/Array_NoByteOrder
      Array_Length2MSBFirstMapping: event=Speedometer/Event_ArrayLength2MSBFirst, transformation-props=ArrayVectorTransformationPropsSet/ArrayLength2MSBFirst
      Array_Length4MSBFirstMapping: event=Speedometer/Event_ArrayLength4MSBFirst, transformation-props=ArrayVectorTransformationPropsSet/ArrayLength4MSBFirst
      Array_Length2MSBLastMapping: event=Speedometer/Event_ArrayLength2MSBLast, transformation-props=ArrayVectorTransformationPropsSet/ArrayLength2MSBLast
      Array_Length4MSBLastMapping: event=Speedometer/Event_ArrayLength4MSBLast, transformation-props=ArrayVectorTransformationPropsSet/ArrayLength4MSBLast
      Vector_NoLengthFieldMapping: event=Speedometer/Event_Vector_NoLengthField, transformation-props=ArrayVectorTransformationPropsSet/Vector_NoLengthField
      Vector_OneLenghtFieldMapping: event=[Speedometer/Event_VectorLengthOne, Speedometer/Event_Vector_NoLengthField], transformation-props=ArrayVectorTransformationPropsSet/Vector_OneLengthField
      Vector_ByteOrderMapping: event=[Speedometer/Event_VectorNoByteOrder, Speedometer/Event_VectorByteOrderMSBF], transformation-props=ArrayVectorTransformationPropsSet/Vector_ByteOrderMSBF
      Vector_NoByteOrderMapping: event=Speedometer/Event_VectorNoByteOrder, transformation-props=ArrayVectorTransformationPropsSet/Vector_NoByteOrder
      Vector_Length2MSBFirstMapping: event=Speedometer/Event_VectorLength2MSBFirst, transformation-props=ArrayVectorTransformationPropsSet/VectorLength2MSBFirst
      Vector_Length4MSBFirstMapping: event=Speedometer/Event_VectorLength4MSBFirst, transformation-props=ArrayVectorTransformationPropsSet/VectorLength4MSBFirst
      Vector_Length2MSBLastMapping: event=Speedometer/Event_VectorLength2MSBLast, transformation-props=ArrayVectorTransformationPropsSet/VectorLength2MSBLast
      Vector_Length4MSBLastMapping: event=Speedometer/Event_VectorLength4MSBLast, transformation-props=ArrayVectorTransformationPropsSet/VectorLength4MSBLast
      Array_ZeroLenghtFieldMapping: event=Speedometer/Event_ArrayLengthZero, transformation-props=ArrayVectorTransformationPropsSet/Array_ZeroLengthField
      Array_2DMapping: event=Speedometer/Event_Array2D, transformation-props=ArrayVectorTransformationPropsSet/Array_2DLengthFieldMSBFMapping
  transformation props to service interface element mapping set ArrayVectorCanoeTransformationPropsToServiceInterfaceElementMappingSet
    18 x transformation props to service interface element mapping:
      Array_NoLengthFieldMapping: event=Speedometer_Canoe/Event_Array_NoLengthField, transformation-props=ArrayVectorCanoeTransformationPropsSet/Array_NoLengthField
      Array_OneLenghtFieldMapping: event=[Speedometer_Canoe/Event_Array_NoLengthField, Speedometer_Canoe/Event_ArrayLengthOne], transformation-props=ArrayVectorCanoeTransformationPropsSet/Array_OneLengthField
      Array_ByteOrderMapping: event=[Speedometer_Canoe/Event_ArrayNoByteOrder, Speedometer_Canoe/Event_ArrayByteOrderMSBF], transformation-props=ArrayVectorCanoeTransformationPropsSet/Array_ByteOrderMSBF
      Array_NoByteOrderMapping: event=Speedometer_Canoe/Event_ArrayNoByteOrder, transformation-props=ArrayVectorCanoeTransformationPropsSet/Array_NoByteOrder
      Array_Length2MSBFirstMapping: event=Speedometer_Canoe/Event_ArrayLength2MSBFirst, transformation-props=ArrayVectorCanoeTransformationPropsSet/ArrayLength2MSBFirst
      Array_Length4MSBFirstMapping: event=Speedometer_Canoe/Event_ArrayLength4MSBFirst, transformation-props=ArrayVectorCanoeTransformationPropsSet/ArrayLength4MSBFirst
      Array_Length2MSBLastMapping: event=Speedometer_Canoe/Event_ArrayLength2MSBLast, transformation-props=ArrayVectorCanoeTransformationPropsSet/ArrayLength2MSBLast
      Array_Length4MSBLastMapping: event=Speedometer_Canoe/Event_ArrayLength4MSBLast, transformation-props=ArrayVectorCanoeTransformationPropsSet/ArrayLength4MSBLast
      Vector_NoLengthFieldMapping: event=Speedometer_Canoe/Event_Vector_NoLengthField, transformation-props=ArrayVectorCanoeTransformationPropsSet/Vector_NoLengthField
      Vector_OneLengthFieldMapping: event=[Speedometer_Canoe/Event_VectorLengthOne, Speedometer_Canoe/Event_Vector_NoLengthField], transformation-props=ArrayVectorCanoeTransformationPropsSet/Vector_OneLengthField
      Vector_ByteOrderMapping: event=[Speedometer_Canoe/Event_VectorNoByteOrder, Speedometer_Canoe/Event_VectorByteOrderMSBF], transformation-props=ArrayVectorCanoeTransformationPropsSet/Vector_ByteOrderMSBF
      Vector_NoByteOrderMapping: event=Speedometer_Canoe/Event_VectorNoByteOrder, transformation-props=ArrayVectorCanoeTransformationPropsSet/Vector_NoByteOrder
      Vector_Length2MSBFirstMapping: event=Speedometer_Canoe/Event_VectorLength2MSBFirst, transformation-props=ArrayVectorCanoeTransformationPropsSet/VectorLength2MSBFirst
      Vector_Length4MSBFirstMapping: event=Speedometer_Canoe/Event_VectorLength4MSBFirst, transformation-props=ArrayVectorCanoeTransformationPropsSet/VectorLength4MSBFirst
      Vector_Length2MSBLastMapping: event=Speedometer_Canoe/Event_VectorLength2MSBLast, transformation-props=ArrayVectorCanoeTransformationPropsSet/VectorLength2MSBLast
      Vector_Length4MSBLastMapping: event=Speedometer_Canoe/Event_VectorLength4MSBLast, transformation-props=ArrayVectorCanoeTransformationPropsSet/VectorLength4MSBLast
      Array_ZeroLengthFieldMapping: event=Speedometer_Canoe/Event_ArrayLengthZero, transformation-props=ArrayVectorCanoeTransformationPropsSet/Array_ZeroLengthField
      Array_2DMapping: event=Speedometer_Canoe/Event_Array2D, transformation-props=ArrayVectorCanoeTransformationPropsSet/Array_2DLengthFieldMSBFMapping
package /SomeipDataPrototypeTransformationProps
  36 x someip data prototype transformation props:
    Array_NoLengthField: data-prototypes=Event_Array_NoLengthField, someip-transformation-props=ArrayVectorTransformationPropsSet/Array_NoLengthField
    Array_LengthOne: data-prototypes=Event_ArrayLengthOne, someip-transformation-props=ArrayVectorTransformationPropsSet/Array_OneLengthField
    Array_ByteOrderMSBF: data-prototypes=Event_ArrayByteOrderMSBF, someip-transformation-props=ArrayVectorTransformationPropsSet/Array_ByteOrderMSBF
    Array_NoByteOrder: data-prototypes=Event_ArrayNoByteOrder, someip-transformation-props=ArrayVectorTransformationPropsSet/Array_NoByteOrder
    Array_Length2MSBFirst: data-prototypes=Event_ArrayLength2MSBFirst, someip-transformation-props=ArrayVectorTransformationPropsSet/ArrayLength2MSBFirst
    Array_Length4MSBFirst: data-prototypes=Event_ArrayLength4MSBFirst, someip-transformation-props=ArrayVectorTransformationPropsSet/ArrayLength4MSBFirst
    Array_Length2MSBLast: data-prototypes=Event_ArrayLength2MSBLast, someip-transformation-props=ArrayVectorTransformationPropsSet/ArrayLength2MSBLast
    Array_Length4MSBLast: data-prototypes=Event_ArrayLength4MSBLast, someip-transformation-props=ArrayVectorTransformationPropsSet/ArrayLength4MSBLast
    Array2D_MSBFirst: data-prototypes=Event_Array2D, someip-transformation-props=ArrayVectorTransformationPropsSet/Array_2DLengthFieldMSBFMapping
    Vector_NoLengthField: data-prototypes=Event_Vector_NoLengthField, someip-transformation-props=ArrayVectorTransformationPropsSet/Vector_NoLengthField
    Vector_LengthOne: data-prototypes=Event_VectorLengthOne, someip-transformation-props=ArrayVectorTransformationPropsSet/Vector_OneLengthField
    Vector_ByteOrderMSBF: data-prototypes=Event_VectorByteOrderMSBF, someip-transformation-props=ArrayVectorTransformationPropsSet/Vector_ByteOrderMSBF
    Vector_NoByteOrder: data-prototypes=Event_VectorNoByteOrder, someip-transformation-props=ArrayVectorTransformationPropsSet/Vector_NoByteOrder
    Vector_Length2MSBFirst: data-prototypes=Event_VectorLength2MSBFirst, someip-transformation-props=ArrayVectorTransformationPropsSet/VectorLength2MSBFirst
    Vector_Length4MSBFirst: data-prototypes=Event_VectorLength4MSBFirst, someip-transformation-props=ArrayVectorTransformationPropsSet/VectorLength4MSBFirst
    Vector_Length2MSBLast: data-prototypes=Event_VectorLength2MSBLast, someip-transformation-props=ArrayVectorTransformationPropsSet/VectorLength2MSBLast
    Vector_Length4MSBLast: data-prototypes=Event_VectorLength4MSBLast, someip-transformation-props=ArrayVectorTransformationPropsSet/VectorLength4MSBLast
    Array_LengthZero: data-prototypes=Event_ArrayLengthZero, someip-transformation-props=ArrayVectorTransformationPropsSet/Array_ZeroLengthField
    Canoe_Array_NoLengthField: data-prototypes=Event_Array_NoLengthField, someip-transformation-props=ArrayVectorCanoeTransformationPropsSet/Array_NoLengthField
    Canoe_Array_LengthOne: data-prototypes=Event_ArrayLengthOne, someip-transformation-props=ArrayVectorCanoeTransformationPropsSet/Array_OneLengthField
    Canoe_Array_ByteOrderMSBF: data-prototypes=Event_ArrayByteOrderMSBF, someip-transformation-props=ArrayVectorCanoeTransformationPropsSet/Array_ByteOrderMSBF
    Canoe_Array_NoByteOrder: data-prototypes=Event_ArrayNoByteOrder, someip-transformation-props=ArrayVectorCanoeTransformationPropsSet/Array_NoByteOrder
    Canoe_Array_Length2MSBFirst: data-prototypes=Event_ArrayLength2MSBFirst, someip-transformation-props=ArrayVectorCanoeTransformationPropsSet/ArrayLength2MSBFirst
    Canoe_Array_Length4MSBFirst: data-prototypes=Event_ArrayLength4MSBFirst, someip-transformation-props=ArrayVectorCanoeTransformationPropsSet/ArrayLength4MSBFirst
    Canoe_Array_Length2MSBLast: data-prototypes=Event_ArrayLength2MSBLast, someip-transformation-props=ArrayVectorCanoeTransformationPropsSet/ArrayLength2MSBLast
    Canoe_Array_Length4MSBLast: data-prototypes=Event_ArrayLength4MSBLast, someip-transformation-props=ArrayVectorCanoeTransformationPropsSet/ArrayLength4MSBLast
    Canoe_Array2D_MSBFirst: data-prototypes=Event_Array2D, someip-transformation-props=ArrayVectorCanoeTransformationPropsSet/Array_2DLengthFieldMSBFMapping
    Canoe_Vector_NoLengthField: data-prototypes=Event_Vector_NoLengthField, someip-transformation-props=ArrayVectorCanoeTransformationPropsSet/Vector_NoLengthField
    Canoe_Vector_LengthOne: data-prototypes=Event_VectorLengthOne, someip-transformation-props=ArrayVectorCanoeTransformationPropsSet/Vector_OneLengthField
    Canoe_Vector_ByteOrderMSBF: data-prototypes=Event_VectorByteOrderMSBF, someip-transformation-props=ArrayVectorCanoeTransformationPropsSet/Vector_ByteOrderMSBF
    Canoe_Vector_NoByteOrder: data-prototypes=Event_VectorNoByteOrder, someip-transformation-props=ArrayVectorCanoeTransformationPropsSet/Vector_NoByteOrder
    Canoe_Vector_Length2MSBFirst: data-prototypes=Event_VectorLength2MSBFirst, someip-transformation-props=ArrayVectorCanoeTransformationPropsSet/VectorLength2MSBFirst
    Canoe_Vector_Length4MSBFirst: data-prototypes=Event_VectorLength4MSBFirst, someip-transformation-props=ArrayVectorCanoeTransformationPropsSet/VectorLength4MSBFirst
    Canoe_Vector_Length2MSBLast: data-prototypes=Event_VectorLength2MSBLast, someip-transformation-props=ArrayVectorCanoeTransformationPropsSet/VectorLength2MSBLast
    Canoe_Vector_Length4MSBLast: data-prototypes=Event_VectorLength4MSBLast, someip-transformation-props=ArrayVectorCanoeTransformationPropsSet/VectorLength4MSBLast
    Canoe_Array_LengthZero: data-prototypes=Event_ArrayLengthZero, someip-transformation-props=ArrayVectorCanoeTransformationPropsSet/Array_ZeroLengthField
