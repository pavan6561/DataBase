AUTOSAR XML (schema 00048)
package /Executables
  executable qt_crypto_instance1
    root sw component prototype rootSwComponentPrototype: application-type=qt_crypto_instance1
package /ProcessDesign
  process design qt_crypto_instance1: executable=qt_crypto_instance1
package /Processes
  process qt_crypto_instance1: design=qt_crypto_instance1, executable=qt_crypto_instance1, state-dependent-startup-config{function-group-state=CryptoApplicationStates.Crypto_Instance1, resource-group=ResourceGroup, startup-config=qt_crypto_instance1_startupconfig}
