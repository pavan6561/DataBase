AUTOSAR XML (schema 00048)
package /ServiceInstanceToPortMapping
  service instance to port prototype mapping SignatureToPortPrototypeMapping: port-prototype=rootSwComponentPrototype.PPortSignature, process=qt_crypto_instance1, service-instance=Signature
