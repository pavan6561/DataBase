AUTOSAR XML (schema 00049)
package /ara/ucm/types/portinterfaces
  service interface VehiclePackageManagement: is-service=true
    namespaces:
      symbol props ara
      symbol props ucm
    field RequestedPackage: type=SwNameType, has-getter=true, has-notifier=true, has-setter=false  # The requested package name.
    field SafetyState: type=bool, has-getter=true, has-notifier=true, has-setter=false  # Vehicle state computed by the Vehicle State Manager Adaptive Application.
    field TransferState: type=TransferStateType, has-getter=true, has-notifier=true, has-setter=false  # The current status of Campaign.
    methods:
      11 x operation, all with fire-and-forget=false:
        AllowCampaign  # To allow a new campaign to start
        CancelCampaign: possible-ap-error=[CancelFailed, InvalidTransferId, OperationNotPermitted]  # This method aborts an ongoing processing of a Software Package.
          arg DisableCampaign: type=bool, direction=IN  # To forbid new campaign
        DeleteTransfer: possible-ap-error=[InvalidTransferId, OperationNotPermitted]  # Delete a transferred Software Package.
          arg id: type=TransferIdType, direction=IN  # Transfer ID of the currently running request.
        GetCampaignHistory  # Getter method to retrieve all actions that have been performed by UCM.
          arg timestampGE: type=uint64_t, direction=IN  # Earliest timestamp (inclusive)
          arg timestampLT: type=uint64_t, direction=IN  # Latest timestamp (exclusive)
          arg CampaignHistory: type=CampaignHistoryType, direction=OUT  # The history of all actions that have been performed by UCM Master.
        GetSwClusterInfo  # This method returns a list of SoftwareClusters that are in state kPresent.
          arg SwInfo: type=SwClusterInfoVectorType, direction=OUT  # List of installed SoftwareClusters that are in state kPresent.
        GetSwPackages  # This method returns the Software Packages that available in UCM.
          arg Packages: type=SwPackageInfoVectorType, direction=OUT  # List of Software Packages.
        SwPackageInventory
          arg AvailableSoftwarePackages: type=SwNameVersionVectorType, direction=IN  # List of available Software Packages in Backend corresponding to VIN.
          arg RequiredSoftwarePackages: type=SwNameVersionVectorType, direction=OUT  # List of Software Packages to be sent to UCM Master.
        TransferData: possible-ap-error=[AuthenticationFailed, BlockInconsistent, IncompatiblePackageVersion, IncorrectBlock, IncorrectBlockSize, IncorrectSize, InsufficientMemory, InvalidTransferId, OperationNotPermitted, PackageInconsistent, TransferInterrupted]  # Block-wise transfer of a Software Package to UCM.
          arg id: type=TransferIdType, direction=IN  # Transfer ID.
          arg data: type=ByteVectorType, direction=IN  # Data block of the Software Package.
          arg blockCounter: type=uint64_t, direction=IN  # Block counter value of the current block.
        TransferExit: possible-ap-error=[AuthenticationFailed, IncompatiblePackageVersion, InsufficientData, InvalidTransferId, OldVersion, OperationNotPermitted, PackageInconsistent, InvalidPackageManifest]  # Finish the transfer of a Software Package to UCM.
          arg id: type=TransferIdType, direction=IN  # Transfer ID of the currently running request.
        TransferStart: possible-ap-error=[InsufficientMemory, UnexpectedPackage, InsufficientComputationPower]
          arg SoftwarePackageName: type=SwNameType, direction=IN  # Software Package Short Name of the Software Package to be transferred.
          arg id: type=TransferIdType, direction=OUT  # Return TransferId.
          arg blockSize: type=BlockSizeType, direction=OUT  # Return the size of the blocks to be used inside TransferData method.
        TransferVehiclePackage: possible-ap-error=InsufficientMemory  # Start the transfer of a Software Package. The size of the Software Package to be transferred to UCM must be provided. UCM will generate a Transfer ID for subsequent calls to TransferData, TransferExit, ProcessSwPackage, DeleteTransfer.
          arg size: type=uint64_t, direction=IN  # Size (in bytes) of the Software Package to be transferred.
          arg id: type=TransferIdType, direction=OUT  # Return TransferId.
          arg blockSize: type=BlockSizeType, direction=OUT  # Return the size of the blocks to be used inside TransferData method.
