AUTOSAR XML (schema 00048)
package /ServiceInterfaces
  service interface UpdateAdapter
    namespaces:
      symbol props ara
      symbol props ucm
      symbol props pkgmgr
    field UpdateStatus: type=UpdateStatusType, has-getter=true, has-notifier=true, has-setter=false
    methods:
      operation SetActivateStatus
        arg status: type=UAActivateStatusType, direction=IN
      operation SetRollbackStatus
        arg status: type=UARollbackStatusType, direction=IN
