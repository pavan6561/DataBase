AUTOSAR XML (schema 00048)
package /ServiceInterfaceDeployement
  someip service interface deployment ApplicationVehicleStateManager_Someip: service-interface=ApplicationVehicleStateManager, service-interface-id=888, service-interface-version={major-version=1, minor-version=0}
    someip field deployment VsmSafetyPolicy: field=VsmSafetyPolicy
      get get: method-id=444, transport-protocol=UDP
      notifier notifier: event-id=555, transport-protocol=UDP
      set set: method-id=666, transport-protocol=UDP
    someip method deployment SafetyState: method=SafetyState, method-id=777, transport-protocol=UDP
    someip event group SafetyPolicyEvent: event-group-id=202, event=notifier
