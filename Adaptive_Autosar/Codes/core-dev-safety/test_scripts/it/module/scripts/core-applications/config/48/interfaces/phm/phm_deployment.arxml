AUTOSAR XML (schema 00048)
package /PlatformHealthManagementContributions
  platform health management contribution PlatformHealthManagementContribution1
    22 x supervision checkpoint:
      SCInitializing: phm-checkpoint=rootSwComponentPrototype.RAlive.kInitialize, process=qt_phm_instance1
      SCWindowSource: phm-checkpoint=rootSwComponentPrototype.RDeadline.kDoorSource, process=qt_phm_instance1
      SCWindowTarget: phm-checkpoint=rootSwComponentPrototype.RDeadline.kDoorTarget, process=qt_phm_instance1
      SCStart: phm-checkpoint=rootSwComponentPrototype.RLogical.kStart, process=qt_phm_instance1
      SCStop: phm-checkpoint=rootSwComponentPrototype.RLogical.kStop, process=qt_phm_instance1
      SCResume: phm-checkpoint=rootSwComponentPrototype.RLogical.kResume, process=qt_phm_instance1
      SCShutdown: phm-checkpoint=rootSwComponentPrototype.RLogical.kShutdown, process=qt_phm_instance1
      SCOK: phm-checkpoint=rootSwComponentPrototype.RGlobalExpiredToStopped.kOK, process=qt_phm_instance1
      SCFailed: phm-checkpoint=rootSwComponentPrototype.RGlobalExpiredToStopped.kFailed, process=qt_phm_instance1
      SCExpired: phm-checkpoint=rootSwComponentPrototype.RGlobalExpiredToStopped.kExpired, process=qt_phm_instance1
      SCAliveMultiple: phm-checkpoint=rootSwComponentPrototype2.RAliveMultiple.kAliveMultiple, process=qt_phm_instance2
      SCLightOn: phm-checkpoint=rootSwComponentPrototype.RDeadlineNegative.kLightOn, process=qt_phm_instance1
      SCLightOff: phm-checkpoint=rootSwComponentPrototype.RDeadlineNegative.kLightOff, process=qt_phm_instance1
      SCIndicatorOn: phm-checkpoint=rootSwComponentPrototype.RWatchdog.kIndicatorOn, process=qt_phm_instance3
      SCIndicatorOff: phm-checkpoint=rootSwComponentPrototype.RWatchdog.kIndicatorOff, process=qt_phm_instance3
      SCPlay: phm-checkpoint=rootSwComponentPrototype.RWatchdog.kPlay, process=qt_phm_instance3
      SCPause: phm-checkpoint=rootSwComponentPrototype.RWatchdog.kPause, process=qt_phm_instance3
      SCReverse: phm-checkpoint=rootSwComponentPrototype.RWatchdog.kReverse, process=qt_phm_instance3
      SCWiperTimer1On: phm-checkpoint=rootSwComponentPrototype2.RFunctionGrpMode.kWiperTimer1On, process=qt_phm_instance2
      SCWiperTimerOff: phm-checkpoint=rootSwComponentPrototype2.RFunctionGrpMode.KWiperTimer1Off, process=qt_phm_instance2
      SCRoofTopOpen: phm-checkpoint=rootSwComponentPrototype2.RPlatformReset.kRoofTopOpen, process=qt_phm_instance2
      SCRoofTopClose: phm-checkpoint=rootSwComponentPrototype2.RPlatformReset.kRoofTopClose, process=qt_phm_instance2
    9 x local supervision:
      AliveSupervision: failed-supervision-cycles-tolerance=5
        alive supervision AliveInitializing: alive-reference-cycle=0.5, checkpoint=SCInitializing, expected-alive-indications=5, max-margin=1, min-margin=1
      DeadlineSupervision: failed-supervision-cycles-tolerance=1
        deadline supervision DeadlineRunning: checkpoint-transition=WindowTransition, max-deadline=0.5, min-deadline=0.1
        checkpoint transition WindowTransition: source=SCWindowSource, target=SCWindowTarget
      LogicalSupervision: failed-supervision-cycles-tolerance=1
        logical supervision logicalSupervisions1: initial-checkpoint=SCStart, final-checkpoint=SCShutdown, transition=[SCStartToStop, SCStopToResume, SCResumeToShutDown]
        checkpoint transition SCStartToStop: source=SCStart, target=SCStop
        checkpoint transition SCStopToResume: source=SCStop, target=SCResume
        checkpoint transition SCResumeToShutDown: source=SCResume, target=SCShutdown
      GlobalExpiredToStopped: failed-supervision-cycles-tolerance=2
        logical supervision GlobalExpiredToStopped: initial-checkpoint=SCOK, final-checkpoint=SCExpired, transition=[kOKToKFailed, kFailedTokExpired]
        checkpoint transition kOKToKFailed: source=SCOK, target=SCFailed
        checkpoint transition kFailedTokExpired: source=SCFailed, target=SCExpired
      AliveMultipleSupervision: failed-supervision-cycles-tolerance=1
        alive supervision AliveMultiple: alive-reference-cycle=1.0, checkpoint=SCAliveMultiple, expected-alive-indications=5, max-margin=1, min-margin=1
      DeadlineNegative: failed-supervision-cycles-tolerance=1
        deadline supervision DeadlineNegative: checkpoint-transition=OnToOff, max-deadline=6.0, min-deadline=1.0
        checkpoint transition OnToOff: source=SCLightOn, target=SCLightOff
      Watchdog: failed-supervision-cycles-tolerance=2
        deadline supervision WatchdogDeadlineSupervision: checkpoint-transition=IndicatorOnToIndicatorOff, max-deadline=2.0, min-deadline=0.5
        logical supervision WatchdogLogicalSupervisions1: initial-checkpoint=SCPlay, final-checkpoint=SCReverse, transition=[PlayToPause, PauseToReverse]
        checkpoint transition IndicatorOnToIndicatorOff: source=SCIndicatorOn, target=SCIndicatorOff
        checkpoint transition PlayToPause: source=SCPlay, target=SCPause
        checkpoint transition PauseToReverse: source=SCPause, target=SCReverse
      FunctionGrpModeRequest: failed-supervision-cycles-tolerance=1
        deadline supervision deadlineSupervisions1: checkpoint-transition=WiperTimer1, max-deadline=2.0, min-deadline=0.2
        checkpoint transition WiperTimer1: source=SCWiperTimer1On, target=SCWiperTimerOff
      PlatformReset: failed-supervision-cycles-tolerance=1
        deadline supervision PlatformResetDeadlineSupervision: checkpoint-transition=RoofTopOpenToClose, max-deadline=1.0, min-deadline=0.2
        checkpoint transition RoofTopOpenToClose: source=SCRoofTopOpen, target=SCRoofTopClose
    4 x global supervision, all with expired-supervision-cycles-tolerance=1, supervision-cycle=1.0:
      GlobalSupervisionAlive: local-supervision=AliveSupervision
      GlobalSupervisionExpiedToStopped: local-supervision=GlobalExpiredToStopped
      GlobalSupervisionDeadlineLogical: local-supervision=[DeadlineSupervision, LogicalSupervision]
      globalSupervisionAliveMultiple: local-supervision=AliveMultipleSupervision
    health channel external status HC_SupervisionExternalStatus: mode-condition=EQUAL, process=qt_phm_instance1, status=rootSwComponentPrototype.RHCInterfaceRPort.kHigh
    4 x health channel supervision:
      HCGlobalStatusStopped: supervision-condition=IS-STOPPED, supervision=GlobalSupervisionExpiedToStopped
      HCLocalAliveFailed: supervision-condition=IS-FAILED, supervision=AliveSupervision
      HCLocalDeadlineExpired: supervision-condition=IS-EXPIRED, supervision=DeadlineSupervision
      HCGlobalExpied: supervision-condition=IS-EXPIRED, supervision=GlobalSupervisionDeadlineLogical
    health channel external status HealthChannelExternalStatus2: mode-condition=NOT-EQUAL, process=qt_phm_instance3, status=rootSwComponentPrototype.RHCExt2.kLow
    4 x health channel supervision:
      HCWatchdog: supervision-condition=IS-EXPIRED, supervision=WatchdogDeadlineSupervision
      HCWatchdog2: supervision-condition=IS-EXPIRED, supervision=WatchdogLogicalSupervisions1
      HCPlatformReset: supervision-condition=IS-FAILED, supervision=PlatformResetDeadlineSupervision
      HCFunctionGrpModeRequest: supervision-condition=IS-FAILED, supervision=FunctionGrpModeRequest
    12 x phm logical expression:
      logicalExpressionsNOT: health-channel-argument=HCLocalAliveFailed, logical-operator=NOT
      logicalExpressionAND: health-channel-argument=[HCLocalAliveFailed, HCGlobalExpied], logical-operator=AND
      logicalExpressionOR: health-channel-argument=[HCLocalDeadlineExpired, HCGlobalExpied], logical-operator=OR
      logicalExpressionNAND: health-channel-argument=[HCGlobalStatusStopped, HCGlobalExpied], logical-operator=NAND
      logicalExpressionsXOR: health-channel-argument=[HCLocalAliveFailed, HCLocalDeadlineExpired], logical-operator=XOR
      logicalExpressionsHCInterfaceExternalNot: health-channel-argument=HC_SupervisionExternalStatus, logical-operator=NOT
      logicalExpressionORDeadlineExpired: health-channel-argument=[HCLocalDeadlineExpired, HCGlobalStatusStopped], logical-operator=OR
      logicalExpressionsHCInterfaceExternal2Not: health-channel-argument=HealthChannelExternalStatus2, logical-operator=NOT
      logicalExpressionsORWatchdogDeadline: health-channel-argument=[HCWatchdog, HCLocalDeadlineExpired], logical-operator=OR
      logicalExpressionORWatchdogLogical: health-channel-argument=[HCWatchdog2, HCGlobalStatusStopped], logical-operator=OR
      logicalExpressionsNANDPlatformReset: health-channel-argument=[HCPlatformReset, HCFunctionGrpModeRequest], logical-operator=NAND
      LogicalExpressionsNANDFunctionGrp: health-channel-argument=[HCFunctionGrpModeRequest, HC_SupervisionExternalStatus], logical-operator=NAND
    11 x phm rule:
      RuleUndefinedState_LE_AND_OnChng: expression=logicalExpressionAND, false-action-list=ActionListFalseOnChange, rule-init-state=UNDEFINED, true-action-list=ActionListTrueOnChange
      RuleFalseState_LE_NAND_OnEv: expression=logicalExpressionNAND, false-action-list=ActionListFalseOnEvaluation, rule-init-state=FALSE, true-action-list=ActionListtrueOnEvaluation
      RuleTruestate_LE_OR_OnChng: expression=logicalExpressionOR, false-action-list=ActionListFalseOnChange, rule-init-state=TRUE, true-action-list=ActionListTrueOnChange
      RuleUndefinedState_LE_NOT_OnEv: expression=logicalExpressionsNOT, false-action-list=ActionListFalseOnEvaluation, rule-init-state=UNDEFINED, true-action-list=ActionListtrueOnEvaluation
      RuleTrueState_LE_XOR_OnEv: expression=logicalExpressionsXOR, false-action-list=ActionListFalseOnEvaluation, rule-init-state=TRUE, true-action-list=ActionListtrueOnEvaluation
      RuleFalseState_LE_HCinterface_OnChng: expression=logicalExpressionsHCInterfaceExternalNot, false-action-list=ActionListFalseOnChange, rule-init-state=FALSE, true-action-list=ActionListTrueOnChange
      RuleTrueState_LE_HCinterface2_OnChng: expression=logicalExpressionsHCInterfaceExternal2Not, false-action-list=ActionListTrueOnChangeHC, rule-init-state=TRUE, true-action-list=ActionListTrueOnChangeHC
      RuleUndefinedStateWatchdogStopTrigger: expression=logicalExpressionsORWatchdogDeadline, false-action-list=WatchdogStopTrigger, rule-init-state=UNDEFINED, true-action-list=WatchdogStopTrigger
      RuleundefinedStateWatchdogWrongTrigger: expression=logicalExpressionORWatchdogLogical, false-action-list=WatchdogStopTrigger, rule-init-state=UNDEFINED, true-action-list=WatchdogWrongTrigger
      RuleTruePlatformReset: expression=logicalExpressionsNANDPlatformReset, false-action-list=PlatformReset, rule-init-state=TRUE, true-action-list=PlatformReset
      RuleFalseFunctionGrpModeRequest: expression=LogicalExpressionsNANDFunctionGrp, false-action-list=FunctionGrpModeRequest, rule-init-state=FALSE, true-action-list=FunctionGrpModeRequest
    9 x phm action list:
      ActionListTrueOnChange: action-list-execution=TRIGGERED-ON-CHANGE, action-list-item=RecoveryViaApplicationAction
      ActionListFalseOnChange: action-list-execution=TRIGGERED-ON-CHANGE, action-list-item=RecoveryViaApplicationAction
      ActionListtrueOnEvaluation: action-list-execution=TRIGGERED-ON-EVALUATION, action-list-item=RecoveryViaApplicationAction
      ActionListFalseOnEvaluation: action-list-execution=TRIGGERED-ON-EVALUATION, action-list-item=RecoveryViaApplicationAction
      ActionListTrueOnChangeHC: action-list-execution=TRIGGERED-ON-CHANGE, action-list-item=RecoveryViaApplicationAction2
      WatchdogStopTrigger: action-list-execution=TRIGGERED-ON-CHANGE, action-list-item=WatchdogStopTiggerPhmActionItem
      WatchdogWrongTrigger: action-list-execution=TRIGGERED-ON-CHANGE, action-list-item=WatchdogWrongTriggerPhmActionItem
      PlatformReset: action-list-execution=TRIGGERED-ON-EVALUATION, action-list-item=PlatformPhmActionItem1
      FunctionGrpModeRequest: action-list-execution=TRIGGERED-ON-EVALUATION, action-list-item=FunctionGroupModeRequestPhmActionItem1
    recovery via application action RecoveryViaApplicationAction
    recovery via application action RecoveryViaApplicationAction2
    watchdog phm action item WatchdogStopTiggerPhmActionItem: action-type=STOP-TRIGGER
    watchdog phm action item WatchdogWrongTriggerPhmActionItem: action-type=WRONG-TRIGGER
    platform phm action item PlatformPhmActionItem1: action-type=RESET-MACHINE
    function group mode request phm action item FunctionGroupModeRequestPhmActionItem1: requested-mode=PHMApplicationStates.PHM_Instance2
  phm supervised entity interface PhmSupervisedEntityInterface_PlatformrReset
    namespaces:
      symbol props ara
      symbol props phm
    phm checkpoint kRoofTopOpen: checkpoint-id=23
    phm checkpoint kRoofTopClose: checkpoint-id=24
package /RecoveryViaApplicationActionToClientServerOperation
  recovery via application action to client server operation mapping RecoveryViaApplicationActionToClientServerOperationMapping1: process=qt_phm_instance1, recovery-action=rootSwComponentPrototype.PRecoveryPort.RecoveryMethod, recovery-via-application-action=RecoveryViaApplicationAction
  recovery via application action to client server operation mapping RecoveryViaApplicationActionToClientServerOperationMapping2: process=qt_phm_instance3, recovery-action=rootSwComponentPrototype.PApplicationRecovery2_instance3.RecoveryMethod, recovery-via-application-action=RecoveryViaApplicationAction2
