AUTOSAR XML (schema 00048)
package /ServiceInstanceToPortMapping
  service instance to port prototype mapping DecryptPrivateCtxToPortMapping: port-prototype=rootSwComponentPrototype.PPortDecryptPrivateCtx, process=qt_crypto_instance1, service-instance=DecryptPrivateCtx
